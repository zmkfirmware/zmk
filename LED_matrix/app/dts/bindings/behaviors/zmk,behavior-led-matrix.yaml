## LED_matrix/app/module/drivers/Kconfig
```kconfig
# Copyright (c) 2020 The ZMK Contributors
# SPDX-License-Identifier: MIT

rsource "gpio/Kconfig"
rsource "kscan/Kconfig"
rsource "sensor/Kconfig"
rsource "display/Kconfig"
rsource "input/Kconfig"
rsource "led/Kconfig"
rsource "led_strip/Kconfig"
rsource "ext_power/Kconfig"
```

## LED_matrix/app/module/drivers/ext_power/Kconfig
```kconfig
config ZMK_EXT_POWER_MOCK
    bool "ZMK EXT power mock"
    default y
    depends on ZMK_EXT_POWER
    depends on DT_HAS_ZMK_EXT_POWER_MOCK_ENABLED
```

## LED_matrix/app/module/dts/bindings/led/zmk,is31fl3737.yaml
```yaml
# Copyright (c) 2026 The ZMK Contributors
# SPDX-License-Identifier: MIT

description: ZMK-managed IS31FL3737 LED Matrix Driver

compatible: "zmk,is31fl3737"

include: "i2c-device.yaml"

properties:
  sdb-gpios:
    type: phandle-array
    description: |
      Hardware shutdown pin. If routed on the board, this property must be
      present. Set to a logical 1 at boot to exit the device from hardware
      shutdown.

  current-limit:
    type: int
    default: 0xFF
    description: |
      Global current limit written to the device global current control
      register. Defaults to the maximum value of 0xFF.
```

## LED_matrix/app/module/dts/bindings/led/zmk,led-composite.yaml
```yaml
# Copyright (c) 2026 The ZMK Contributors
# SPDX-License-Identifier: MIT

description: |
  Virtual LED controller that composes multiple matrix and LED strip backends
  into one flattened RGB channel space.

  Child ranges must start at 0 and be declared in ascending contiguous order
  with no overlaps or holes.

  Each child must define exactly one of:
  - led-device: a Zephyr LED device with write_channels support
  - led-strip-device: a Zephyr LED strip device

  Strip children may optionally reference a shared ext-power-device.

compatible: "zmk,led-composite"

include: ["led-controller.yaml"]

child-binding:
  description: Child LED backend mapped into the flattened channel space

  properties:
    led-device:
      type: phandle
      required: false
      description: Matrix-style LED device that receives forwarded write_channels calls.

    led-strip-device:
      type: phandle
      required: false
      description: |
        LED strip backend that receives forwarded writes in the flattened RGB
        channel space.

    channel-offset:
      type: int
      required: true
      description: Starting offset in the flattened output channel space.

    channel-count:
      type: int
      required: true
      description: |
        Number of writable RGB channels exposed by this child backend. Strip
        children must use a multiple of 3.

    ext-power-device:
      type: phandle
      required: false
      description: |
        Optional shared external power controller used by strip children.
```

## app/boards/bmk/bl654b/Kconfig
```kconfig
# Copyright (c) 2021 Nick Winans
# SPDX-License-Identifier: MIT

config BOARD_ENABLE_DCDC
	bool "Enable DCDC mode"
	select SOC_DCDC_NRF52X
	default y
	depends on (BOARD_BL654B)


config BOARD_ENABLE_DCDC_HV
    bool "High voltage DCDC converter"
    select SOC_DCDC_NRF52X_HV
    default y
    depends on (BOARD_BL654B)
```

## app/boards/bmk/bl654b/Kconfig.defconfig
```kconfig
# Copyright (c) 2021 Nick Winans
# SPDX-License-Identifier: MIT

if BOARD_BL654B

config ZMK_KEYBOARD_NAME
	default "bl654b"

if USB_DEVICE_STACK

config USB_NRFX
    default y

endif # USB_DEVICE_STACK

config BT_CTLR
	default BT

if DISPLAY
    
config SPI
    default y

if LVGL

config LV_Z_VDB_SIZE
    default 64

config LV_DPI_DEF
    default 148

config LV_Z_BITS_PER_PIXEL
    default 1

choice LV_COLOR_DEPTH
    default LV_COLOR_DEPTH_1
endchoice

endif # LVG
endif # DISPLAY

endif # BOARD_BL654B
```

## app/boards/bmk/bl654b/bl654b_nrf52840_zmk_defconfig
```kconfig
# Copyright (c) 2021 Nick Winans
# SPDX-License-Identifier: MIT

# Enable MPU
CONFIG_ARM_MPU=y

CONFIG_PINCTRL=y

# enable GPIO
CONFIG_GPIO=y

CONFIG_USE_DT_CODE_PARTITION=y
CONFIG_BUILD_OUTPUT_UF2=y

CONFIG_MPU_ALLOW_FLASH_WRITE=y
CONFIG_NVS=y
CONFIG_SETTINGS_NVS=y
CONFIG_FLASH=y
CONFIG_FLASH_PAGE_LAYOUT=y
CONFIG_FLASH_MAP=y
CONFIG_CLOCK_CONTROL_NRF=y
CONFIG_CLOCK_CONTROL_NRF_K32SRC_RC=y

CONFIG_ZMK_HID_INDICATORS=y

#CONFIG_ZMK_SLEEP=y
#CONFIG_ZMK_IDLE_SLEEP_TIMEOUT=5000

CONFIG_ZMK_USB=y
CONFIG_ZMK_BLE=y

CONFIG_ZMK_BATTERY_REPORTING=y


#Backlighting configuration
#CONFIG_PWM=y
#CONFIG_LED_PWM=y
#CONFIG_ZMK_BACKLIGHT=y
#CONFIG_ZMK_BACKLIGHT_AUTO_OFF_IDLE=y
#CONFIG_ZMK_BACKLIGHT_ON_START=y


# Enable nice!view
#CONFIG_ZMK_DISPLAY=y
#CONFIG_ZMK_DISPLAY_STATUS_SCREEN_CUSTOM=y
# Disable idle blanking
#CONFIG_ZMK_DISPLAY_BLANK_ON_IDLE=y
#CONFIG_ZMK_WIDGET_WPM_STATUS=y
#CONFIG_ZMK_LV_FONT_DEFAULT_SMALL_MONTSERRAT_20=y
#CONFIG_LVGL=y
#CONFIG_LV_FONT_DEFAULT_MONTSERRAT_28=y



CONFIG_ZMK_DISPLAY_STATUS_SCREEN_BUILT_IN=y
CONFIG_ZMK_DISPLAY_WORK_QUEUE_DEDICATED=y

# Enable SPI for LEDS
#CONFIG_SPI=y
#CONFIG_SPI_NRFX=y


#Enable 在 ZMK 中配置 ST7789V (135x240) display driver

# --- ZMK 显示屏基础支持 ---
CONFIG_ZMK_DISPLAY=y
#CONFIG_DISPLAY=y
# CONFIG_ST7789V=y
# CONFIG_ZMK_WIDGET_OUTPUT_STATUS=y
# CONFIG_ZMK_WIDGET_LAYER_STATUS=y
# CONFIG_ZMK_WIDGET_BATTERY_STATUS=y
#CONFIG_ZMK_DISPLAY_INVERT=y
#CONFIG_DISPLAY=y
#CONFIG_ST7789V=y
#CONFIG_MIPI_DBI=y


CONFIG_ZMK_DISPLAY_BLANK_ON_IDLE=y
#CONFIG_ZMK_LV_FONT_DEFAULT_SMALL_MONTSERRAT_42=y
#CONFIG_LVGL=y
CONFIG_LV_Z_MEM_POOL_SIZE=8192

# --- ZMK 背光支持 ---
#CONFIG_ZMK_BACKLIGHT=y

# --- Zephyr LED 和 PWM 驱动支持 ---
#CONFIG_LED=y
#CONFIG_PWM=y

# --- (可选) 配置亮度和步进 ---
#CONFIG_ZMK_BACKLIGHT_BRT_STEP=10 
#CONFIG_ZMK_BACKLIGHT_BRT_START=50
#CONFIG_ZMK_BACKLIGHT_AUTO_OFF_IDLE=y
#CONFIG_NICE_OLED_WIDGET_HID_INDICATORS_LUNA_ONLY_CAPSLOCK=y

CONFIG_BT_CTLR_PHY_2M=n

#CONFIG_ZMK_USB_LOGGING=y
CONFIG_ZMK_RTT_LOGGING=y
```

## app/boards/bmk/bl654b/board.yml
```yaml
boards:
  - name: bl654b
    vendor: moergo
    socs:
      - name: nrf52840
        variants:
          - name: zmk
```

## app/boards/bmk/bmk4SGK/Kconfig.bmk4SGK
```kconfig
# Copyright (c) 2021 Nick Winans
# SPDX-License-Identifier: MIT

config BOARD_BMK4SGK
    select SOC_NRF52840_QIAA
    select ZMK_BOARD_COMPAT
    imply RETAINED_MEM
    imply RETENTION
    imply RETENTION_BOOT_MODE
```

## app/boards/bmk/bmk4SGK/Kconfig.defconfig
```kconfig
# Copyright (c) 2021 Nick Winans
# SPDX-License-Identifier: MIT

if BOARD_BMK4SGK

config ZMK_KEYBOARD_NAME
	default "BMK4SGK"

if USB

config USB_NRFX
	default y

config USB_DEVICE_STACK
	default y

endif # USB

config BT_CTLR
	default BT

config ZMK_BLE
	default y

config ZMK_USB
	default y

config ZMK_BATTERY_VOLTAGE_DIVIDER
	default y


endif # BOARD_BMK4SGK
```

## app/boards/bmk/bmk4SGK/bmk4SGK_nrf52840_defconfig
```kconfig
# Copyright (c) 2021 Nick Winans
# SPDX-License-Identifier: MIT

# Enable MPU
CONFIG_ARM_MPU=y
CONFIG_PINCTRL=y

# enable GPIO
CONFIG_GPIO=y

CONFIG_LED_GPIO=y
CONFIG_USE_DT_CODE_PARTITION=y
CONFIG_BUILD_OUTPUT_UF2=y

CONFIG_MPU_ALLOW_FLASH_WRITE=y
CONFIG_NVS=y
CONFIG_SETTINGS_NVS=y
CONFIG_FLASH=y
CONFIG_FLASH_PAGE_LAYOUT=y
CONFIG_FLASH_MAP=y

CONFIG_ZMK_HID_INDICATORS=y
CONFIG_ZMK_LED_MATRIX=y
CONFIG_ZMK_LED_MATRIX_AUTO_OFF_IDLE=y

CONFIG_ZMK_USB=y
CONFIG_ZMK_BLE=y

CONFIG_ZMK_STUDIO_LOCKING=n
```

## app/boards/bmk/bmk4SGK/board.yml
```yaml
board:
  name: bmk4SGK
  vendor: bmk
  socs:
    - name: nrf52840
      variants:
        - name: zmk
```

## app/boards/bmk/bmk60/Kconfig.board
```kconfig
# Copyright (c) 2021 Nick Winans
# SPDX-License-Identifier: MIT

config BOARD_BMK60
	bool "bmk60"
	depends on SOC_NRF52840_QIAA
```

## app/boards/bmk/bmk60/Kconfig.defconfig
```kconfig
# Copyright (c) 2021 Nick Winans
# SPDX-License-Identifier: MIT

if BOARD_BMK60

config ZMK_KEYBOARD_NAME
	default "Roy's Keyboard"

if USB

config USB_NRFX
	default y

config USB_DEVICE_STACK
	default y

endif # USB

config BT_CTLR
	default BT

config ZMK_BLE
	default y

config ZMK_USB
	default y

config ZMK_BATTERY_VOLTAGE_DIVIDER
	default n

config ZMK_BATTERY_NRF_VDDH
	default y

endif # BOARD_BMK60
```

## app/boards/bmk/bmk60/bmk60_defconfig
```kconfig
# Copyright (c) 2021 Nick Winans
# SPDX-License-Identifier: MIT

CONFIG_SOC_SERIES_NRF52X=y
CONFIG_SOC_NRF52840_QIAA=y
CONFIG_BOARD_BMK60=y

# Enable MPU
CONFIG_ARM_MPU=y

# enable GPIO
CONFIG_GPIO=y

CONFIG_USE_DT_CODE_PARTITION=y

CONFIG_MPU_ALLOW_FLASH_WRITE=y
CONFIG_NVS=y
CONFIG_SETTINGS_NVS=y
CONFIG_FLASH=y
CONFIG_FLASH_PAGE_LAYOUT=y
CONFIG_FLASH_MAP=y

#CONFIG_ZMK_SLEEP=y
#CONFIG_ZMK_IDLE_SLEEP_TIMEOUT=5000
```

## app/boards/bmk/corne54/Kconfig.defconfig
```kconfig
#
# Copyright (c) 2023 The ZMK Contributors
# SPDX-License-Identifier: MIT
#

if BOARD_CORNE54_LEFT

config ZMK_KEYBOARD_NAME
    default "Corne54"
config ZMK_SPLIT_ROLE_CENTRAL
    default y

endif # BOARD_CORNE54_LEFT

if BOARD_CORNE54_RIGHT

config ZMK_KEYBOARD_NAME
    default "Corne54 right"
    
endif # BOARD_CORNE54_RIGHT


if BOARD_CORNE54_LEFT || BOARD_CORNE54_RIGHT


config ZMK_SPLIT
    default y

config BT_CTLR
    default BT

if USB

config USB_NRFX
    default y

config USB_DEVICE_STACK
    default y

endif # USB

config ZMK_BATTERY_VOLTAGE_DIVIDER
    default y

if ZMK_DISPLAY

config I2C
    default y

config SSD1306
    default y

endif # ZMK_DISPLAY

if ZMK_RGB_UNDERGLOW || ZMK_LED_MATRIX

config SPI
    default y

endif # ZMK_RGB_UNDERGLOW || ZMK_LED_MATRIX


if LVGL

config LV_Z_VDB_SIZE
    default 64

config LV_DPI_DEF
    default 148

config LV_Z_BITS_PER_PIXEL
    default 1

choice LV_COLOR_DEPTH
    default LV_COLOR_DEPTH_1
endchoice

endif # LVG


endif # BOARD_CORNE54_LEFT || BOARD_CORNE54_RIGHT
```

## app/boards/bmk/corne54/board.yml
```yaml
boards:
  - name: corne54_left
    vendor: bmk
    socs:
      - name: nrf52840
        variants:
          - name: zmk
  - name: corne54_right
    vendor: bmk
    socs:
      - name: nrf52840
        variants:
          - name: zmk
```

## app/boards/bmk/corne54/corne54_right_defconfig
```kconfig
#
# Copyright (c) 2023 The ZMK Contributors
# SPDX-License-Identifier: MIT
#


# Enable MPU
CONFIG_ARM_MPU=y

# enable GPIO
CONFIG_GPIO=y

# Enable SPI for LEDS
#CONFIG_PINCTRL=y
#CONFIG_SPI=y
#CONFIG_SPI_NRFX=y

# Work-around for Windows bug with battery notifications
CONFIG_BT_GATT_ENFORCE_SUBSCRIPTION=n

# Enable writing to flash
CONFIG_USE_DT_CODE_PARTITION=y
CONFIG_MPU_ALLOW_FLASH_WRITE=y
CONFIG_NVS=y
CONFIG_SETTINGS_NVS=y
CONFIG_FLASH=y
CONFIG_FLASH_PAGE_LAYOUT=y
CONFIG_FLASH_MAP=y

# Keyboard IDs
#CONFIG_ZMK_KEYBOARD_NAME="Corne54R OLED"
CONFIG_USB_DEVICE_PID=0x27de
CONFIG_USB_DEVICE_VID=0x16c1
CONFIG_USB_DEVICE_MANUFACTURER="BMK"
CONFIG_USB_DEVICE_SN="CORNE54R2025030001"

CONFIG_BT_DIS_PNP_PID=0x27de
CONFIG_BT_DIS_PNP_VID=0x16c1
CONFIG_BT_DIS_MANUF="BMK"
CONFIG_BT_DIS_MODEL="Corne54"

# Enable 32kHz crystal
CONFIG_CLOCK_CONTROL_NRF_K32SRC_XTAL=y
#CONFIG_CLOCK_CONTROL_NRF_K32SRC_30PPM=y
#CONFIG_CLOCK_CONTROL_NRF_K32SRC_RC=n


CONFIG_ZMK_EXT_POWER=y

#RGB leds config
CONFIG_ZMK_LED_MATRIX=y
CONFIG_ZMK_LED_MATRIX_EXT_POWER=y
CONFIG_ZMK_LED_MATRIX_ON_START=n
CONFIG_ZMK_LED_MATRIX_BRT_START=40
CONFIG_ZMK_LED_MATRIX_BRT_STEP=10
CONFIG_ZMK_LED_MATRIX_PROFILE_START=0
CONFIG_ZMK_LED_MATRIX_AUTO_OFF_IDLE=y

#Backlighting configuration
#CONFIG_PWM=y
#CONFIG_LED_PWM=y
#CONFIG_ZMK_BACKLIGHT=y
#CONFIG_ZMK_BACKLIGHT_BRT_START=20
#CONFIG_ZMK_BACKLIGHT_AUTO_OFF_IDLE=y

#Misc configuration
#CONFIG_BT_CTLR_TX_PWR_PLUS_8=y
CONFIG_ZMK_HID_REPORT_TYPE_NKRO=y
#CONFIG_ZMK_HID_CONSUMER_REPORT_USAGES_BASIC=y
CONFIG_BUILD_OUTPUT_UF2=y
CONFIG_ZMK_BLE=y
CONFIG_ZMK_USB=y

CONFIG_ZMK_DISPLAY=y
CONFIG_ZMK_DISPLAY_STATUS_SCREEN_BUILT_IN=y
CONFIG_ZMK_DISPLAY_WORK_QUEUE_DEDICATED=y
#CONFIG_ZMK_DISPLAY_STATUS_SCREEN_CUSTOM=y
#CONFIG_ZMK_WIDGET_WPM_STATUS=y
CONFIG_ZMK_DISPLAY_TICK_PERIOD_MS=250

CONFIG_ZMK_LV_FONT_DEFAULT_SMALL_MONTSERRAT_14=y


CONFIG_EC11=y
#CONFIG_EC11_TRIGGER_OWN_THREAD=y
CONFIG_EC11_TRIGGER_GLOBAL_THREAD=y

CONFIG_ZMK_STUDIO_LOCKING=n

#CONFIG_ZMK_POINTING=y

CONFIG_ZMK_IDLE_TIMEOUT=15000
CONFIG_ZMK_SLEEP=y
CONFIG_ZMK_IDLE_SLEEP_TIMEOUT=3600000

CONFIG_ZMK_BATTERY_REPORTING=y
#CONFIG_ZMK_SPLIT_BLE_CENTRAL_BATTERY_LEVEL_PROXY=y
#CONFIG_ZMK_SPLIT_BLE_CENTRAL_BATTERY_LEVEL_FETCHING=y

#CONFIG_ZMK_BLE_EXPERIMENTAL_CONN=n

CONFIG_LV_Z_MEM_POOL_SIZE=8192

#BT configuration
#CONFIG_BT_MAX_CONN=4
#CONFIG_BT_MAX_PAIRED=4

# Log via USB or Segger RTT
CONFIG_ZMK_USB_LOGGING=n
CONFIG_ZMK_RTT_LOGGING=n
```

## app/boards/bmk/corne54v2/Kconfig
```kconfig
# SPDX-License-Identifier: MIT

config BOARD_ENABLE_DCDC
    bool "Enable DCDC mode"
    select SOC_DCDC_NRF52X
    default y
    depends on BOARD_CORNE54V2_LEFT || BOARD_CORNE54V2_RIGHT

config BOARD_ENABLE_DCDC_HV
    bool "High voltage DCDC converter"
    select SOC_DCDC_NRF52X_HV
    default y
    depends on BOARD_CORNE54V2_LEFT || BOARD_CORNE54V2_RIGHT
    
```

## app/boards/bmk/corne54v2/Kconfig.defconfig
```kconfig
#
# Copyright (c) 2023 The ZMK Contributors
# SPDX-License-Identifier: MIT
#

if BOARD_CORNE54V2_LEFT

config ZMK_KEYBOARD_NAME
    default "CORNE54V2"

config ZMK_SPLIT_ROLE_CENTRAL
    default y

endif # BOARD_CORNE54V2_LEFT

if BOARD_CORNE54V2_RIGHT

config ZMK_KEYBOARD_NAME
    default "CORNE54V2 right"

endif # BOARD_CORNE54V2_RIGHT


if BOARD_CORNE54V2_LEFT || BOARD_CORNE54V2_RIGHT

config BOARD
    default "CORNE54V2"

config ZMK_SPLIT
    default y

config SPI
    default y

config BT_CTLR
    default BT

if USB

config USB_NRFX
    default y

config USB_DEVICE_STACK
    default y

endif # USB

config ZMK_BATTERY_VOLTAGE_DIVIDER
    default y

if ZMK_DISPLAY

config I2C
    default y

config SSD1306
    default y

endif # ZMK_DISPLAY

if ZMK_RGB_UNDERGLOW

config SPI
    default y

endif # ZMK_RGB_UNDERGLOW


if LVGL

config LV_Z_VDB_SIZE
    default 64

config LV_DPI_DEF
    default 148

config LV_Z_BITS_PER_PIXEL
    default 1

choice LV_COLOR_DEPTH
    default LV_COLOR_DEPTH_1
endchoice

endif # LVG


endif # BOARD_CORNE54V2_LEFT || BOARD_CORNE54V2_RIGHT
```

## app/boards/bmk/corne54v2/board.yml
```yaml
boards:
  - name: corne54v2_left
    vendor: bmk
    socs:
      - name: nrf52840
        variants:
          - name: zmk
  - name: corne54v2_right
    vendor: bmk
    socs:
      - name: nrf52840
        variants:
          - name: zmk
```

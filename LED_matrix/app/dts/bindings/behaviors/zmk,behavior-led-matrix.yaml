## LED_matrix/app/dts/bindings/behaviors/zmk,behavior-led-matrix.yaml
```yaml
# Copyright (c) 2026 The ZMK Contributors
# SPDX-License-Identifier: MIT

description: LED Matrix behavior

compatible: "zmk,behavior-led-matrix"

include: two_param.yaml
```

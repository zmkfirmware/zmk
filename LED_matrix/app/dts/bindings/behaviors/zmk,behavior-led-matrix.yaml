## app/boards/bmk/corne54v2/corne54v2_right_defconfig
```kconfig
#
# Copyright (c) 2023 The ZMK Contributors
# SPDX-License-Identifier: MIT
#


# Enable MPU
CONFIG_ARM_MPU=y

# enable GPIO
#CONFIG_GPIO=y

# Enable SPI for LEDS
#CONFIG_PINCTRL=y
#CONFIG_SPI=y
#CONFIG_SPI_NRFX=y

# Enable writing to flash
CONFIG_USE_DT_CODE_PARTITION=y
CONFIG_MPU_ALLOW_FLASH_WRITE=y
CONFIG_NVS=y
CONFIG_SETTINGS_NVS=y
CONFIG_FLASH=y
#CONFIG_FLASH_PAGE_LAYOUT=y
CONFIG_FLASH_MAP=y

# Keyboard IDs
#CONFIG_ZMK_KEYBOARD_NAME="Corne54 Right"
CONFIG_USB_DEVICE_PID=0x27db
CONFIG_USB_DEVICE_VID=0x16c0
CONFIG_USB_DEVICE_MANUFACTURER="BMK"
CONFIG_USB_DEVICE_SN="0123456789ABCDEF"

CONFIG_BT_DIS_PNP_PID=0x27db
CONFIG_BT_DIS_PNP_VID=0x16c0
CONFIG_BT_DIS_MANUF="BMK"
CONFIG_BT_DIS_MODEL="Corne54"

# Enable 32kHz crystal
#CONFIG_CLOCK_CONTROL_NRF_K32SRC_XTAL=y
#CONFIG_CLOCK_CONTROL_NRF_K32SRC_150PPM=y

CONFIG_ZMK_EXT_POWER=y

#RGB leds config
#CONFIG_WS2812_STRIP=y
#CONFIG_ZMK_RGB_UNDERGLOW=y
#CONFIG_ZMK_RGB_UNDERGLOW_EXT_POWER=y
#CONFIG_ZMK_RGB_UNDERGLOW_ON_START=n
#CONFIG_ZMK_RGB_UNDERGLOW_EFF_START=0
#CONFIG_ZMK_RGB_UNDERGLOW_AUTO_OFF_IDLE=y
#CONFIG_ZMK_RGB_UNDERGLOW_BRT_MAX=50
#CONFIG_ZMK_RGB_UNDERGLOW_EFF_START=3
#CONFIG_ZMK_RGB_UNDERGLOW_HUE_START=285
#CONFIG_ZMK_RGB_UNDERGLOW_SAT_START=75
#CONFIG_ZMK_RGB_UNDERGLOW_BRT_START=16
#CONFIG_ZMK_RGB_UNDERGLOW_BRT_STEP=4

#Backlighting configuration
#CONFIG_PWM=y
#CONFIG_LED_PWM=y
#CONFIG_ZMK_BACKLIGHT=y
#CONFIG_ZMK_BACKLIGHT_BRT_START=20
#CONFIG_ZMK_BACKLIGHT_AUTO_OFF_IDLE=y

#Misc configuration
#CONFIG_BT_CTLR_TX_PWR_PLUS_8=y
CONFIG_ZMK_HID_REPORT_TYPE_NKRO=y
CONFIG_ZMK_HID_CONSUMER_REPORT_USAGES_BASIC=y
CONFIG_BUILD_OUTPUT_UF2=y
CONFIG_ZMK_BLE=y

CONFIG_ZMK_DISPLAY=y
#CONFIG_ZMK_DISPLAY_STATUS_SCREEN_BUILT_IN=y
CONFIG_ZMK_DISPLAY_WORK_QUEUE_DEDICATED=y
#CONFIG_ZMK_DISPLAY_STATUS_SCREEN_CUSTOM=y
CONFIG_ZMK_WIDGET_WPM_STATUS=y

CONFIG_EC11=y
#CONFIG_EC11_TRIGGER_OWN_THREAD=y
CONFIG_EC11_TRIGGER_GLOBAL_THREAD=y

CONFIG_ZMK_STUDIO_LOCKING=n
CONFIG_ZMK_HID_INDICATORS=y

#CONFIG_ZMK_POINTING=y

CONFIG_ZMK_BATTERY_REPORTING=y
CONFIG_ZMK_SPLIT_BLE_CENTRAL_BATTERY_LEVEL_PROXY=y
CONFIG_ZMK_SPLIT_BLE_CENTRAL_BATTERY_LEVEL_FETCHING=y
```

#include <../boards/native/nrf_bsim/nrf52_bsim.dts>

#include <behaviors.dtsi>
#include <dt-bindings/zmk/keys.h>
#include <dt-bindings/zmk/input_matrix_mock.h>

/ {
    chosen {
        zmk,matrix-input = &matrix;
    };

    matrix: matrix {
        compatible = "zmk,input-matrix-mock";

        rows = <2>;
        columns = <2>;
    };
};

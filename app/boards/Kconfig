## app/boards/adafruit/kb2040/board.yml
```yaml
board:
  extend: adafruit_kb2040
  variants:
    - name: zmk
      qualifier: rp2040
```

## app/boards/adafruit/qt_py_rp2040/Kconfig.adafruit_qt_py_rp2040
```kconfig
# Copyright (c) 2026 The ZMK Contributors
# SPDX-License-Identifier: MIT

config BOARD_ADAFRUIT_QT_PY_RP2040
    select ZMK_BOARD_COMPAT if BOARD_ADAFRUIT_QT_PY_RP2040_RP2040_ZMK
    imply RETAINED_MEM if BOARD_ADAFRUIT_QT_PY_RP2040_RP2040_ZMK
    imply RETENTION if BOARD_ADAFRUIT_QT_PY_RP2040_RP2040_ZMK
    imply RETENTION_BOOT_MODE if BOARD_ADAFRUIT_QT_PY_RP2040_RP2040_ZMK
```

## app/boards/adafruit/qt_py_rp2040/board.yml
```yaml
board:
  extend: adafruit_qt_py_rp2040
  variants:
    - name: zmk
      qualifier: rp2040
```

## app/boards/arm/Retic1337_BTCTRL/Kconfig
```kconfig
# nRF52840-KEYBOARD board configuration

config BOARD_ENABLE_DCDC
	bool "Enable DCDC mode"
	select SOC_DCDC_NRF52X
	default y
	depends on BOARD_RETIC1337_BTCTRL
```

## app/boards/arm/Retic1337_BTCTRL/Kconfig.board
```kconfig
# nRF52840-KEYBOARD board configuration

config BOARD_RETIC1337_BTCTRL
	bool "Retic1337_btctrl"
	depends on SOC_NRF52840_QIAA
```

## app/boards/arm/Retic1337_BTCTRL/Kconfig.defconfig
```kconfig
# Retic1337_BTCTRL board configuration

if BOARD_RETIC1337_BTCTRL

config BOARD
    default "BTCTRL"

config ZMK_KEYBOARD_NAME
    default "REtic1337_BTCTRL"

if USB

config USB_NRFX
	default y

config USB_DEVICE_STACK
	default y

endif # USB

config BT_CTLR
	default BT

config ZMK_BLE
	default y

config ZMK_USB
	default y

endif # BOARD_RETIC1337_BTCTRL
```

## app/boards/arm/Retic1337_BTCTRL/Retic1337_BTCTRL_defconfig
```kconfig
CONFIG_SOC_SERIES_NRF52X=y
CONFIG_SOC_NRF52840_QIAA=y
CONFIG_BOARD_RETIC1337_BTCTRL=y
# Enable MPU
CONFIG_ARM_MPU=y

# enable GPIO
CONFIG_GPIO=y

CONFIG_USE_DT_CODE_PARTITION=y

CONFIG_MPU_ALLOW_FLASH_WRITE=y
CONFIG_NVS=y
CONFIG_SETTINGS_NVS=y
CONFIG_FLASH=y
CONFIG_FLASH_PAGE_LAYOUT=y
CONFIG_FLASH_MAP=y

# Turn on logging, and set ZMK logging to debug output
CONFIG_LOG=y
CONFIG_ZMK_LOG_LEVEL_DBG=y
CONFIG_ZMK_USB_LOGGING=y

# additional board options
CONFIG_GPIO_AS_PINRESET=y

CONFIG_EC11=y
CONFIG_EC11_TRIGGER_GLOBAL_THREAD=y

#I2C
CONFIG_I2C=y
CONFIG_I2C_NRFX=y
CONFIG_I2C_0=y
CONFIG_I2C_1=y
CONFIG_I2C_INIT_PRIORITY=60
CONFIG_IS31FL3733=y
CONFIG_SENSOR=y
CONFIG_BQ274XX=y
CONFIG_ZMK_IDLE_TIMEOUT=3000
CONFIG_ZMK_SLEEP=y
CONFIG_PM_DEVICE=y
CONFIG_ZMK_IDLE_SLEEP_TIMEOUT=10000
CONFIG_ZMK_EXT_POWER=y
CONFIG_DEVICE_POWER_MANAGEMENT=y



CONFIG_BT_CTLR_TX_PWR_PLUS_8=y
```

## app/boards/arm/adafruit_feather_nrf52840/Kconfig.board
```kconfig
# Adafruit Feather nRF52840 Express board configuration

# Copyright (c) 2021 The ZMK Contributors
# SPDX-License-Identifier: MIT

config BOARD_ADAFRUIT_FEATHER_NRF52840
	bool "Adafruit Feather nRF52840 Express"
	depends on SOC_NRF52840_QIAA
```

## app/boards/arm/adafruit_feather_nrf52840/Kconfig.defconfig
```kconfig
# Adafruit Feather nRF52840 Express board configuration

# Copyright (c) 2021 The ZMK Contributors
# SPDX-License-Identifier: MIT

if BOARD_ADAFRUIT_FEATHER_NRF52840

config BOARD
	default "adafruit_feather_nrf52840"

if USB

config USB_NRFX
	default y

config USB_DEVICE_STACK
	default y

endif # USB

config BT_CTLR
	default BT

config ZMK_BLE
	default y

config ZMK_USB
	default y

endif # BOARD_ADAFRUIT_FEATHER_NRF52840
```

## app/boards/arm/adv360pro/Kconfig.board
```kconfig
#
# Copyright (c) 2023 The ZMK Contributors
# SPDX-License-Identifier: MIT
#

config BOARD_ADV360PRO_LEFT
    bool "adv360pro_left"
    depends on SOC_NRF52840_QIAA

config BOARD_ADV360PRO_RIGHT
    bool "adv360pro_right"
    depends on SOC_NRF52840_QIAA
```

## app/boards/arm/adv360pro/adv360pro_right_defconfig
```kconfig
#
# Copyright (c) 2023 The ZMK Contributors
# SPDX-License-Identifier: MIT
#

CONFIG_SOC_SERIES_NRF52X=y
CONFIG_SOC_NRF52840_QIAA=y
CONFIG_BOARD_ADV360PRO_RIGHT=y

# Enable MPU
CONFIG_ARM_MPU=y

# enable GPIO
CONFIG_GPIO=y

# Enable SPI for LEDS
CONFIG_PINCTRL=y
CONFIG_SPI=y
CONFIG_SPI_NRFX=y

# Enable writing to flash
CONFIG_USE_DT_CODE_PARTITION=y
CONFIG_MPU_ALLOW_FLASH_WRITE=y
CONFIG_NVS=y
CONFIG_SETTINGS_NVS=y
CONFIG_FLASH=y
CONFIG_FLASH_PAGE_LAYOUT=y
CONFIG_FLASH_MAP=y

# Enable 32kHz crystal
CONFIG_CLOCK_CONTROL_NRF_K32SRC_XTAL=y
CONFIG_CLOCK_CONTROL_NRF_K32SRC_150PPM=y

#RGB leds config
CONFIG_WS2812_STRIP=y
CONFIG_ZMK_RGB_UNDERGLOW=y
CONFIG_ZMK_RGB_UNDERGLOW_EXT_POWER=y
CONFIG_ZMK_RGB_UNDERGLOW_ON_START=n
CONFIG_ZMK_RGB_UNDERGLOW_EFF_START=0
CONFIG_ZMK_RGB_UNDERGLOW_AUTO_OFF_IDLE=y

#Backlighting configuration
CONFIG_PWM=y
CONFIG_LED_PWM=y
CONFIG_ZMK_BACKLIGHT=y
CONFIG_ZMK_BACKLIGHT_BRT_START=20
CONFIG_ZMK_BACKLIGHT_AUTO_OFF_IDLE=y

#Misc configuration
CONFIG_BT_CTLR_TX_PWR_PLUS_8=y
CONFIG_ZMK_HID_REPORT_TYPE_NKRO=y
CONFIG_ZMK_HID_CONSUMER_REPORT_USAGES_BASIC=y
CONFIG_BUILD_OUTPUT_UF2=y
CONFIG_ZMK_BLE=y
```

## app/boards/arm/ahokore/Kconfig.defconfig
```kconfig
# Copyright (c) 2020 The ZMK Contributors
# SPDX-License-Identifier: MIT

if BOARD_AHOKORE

config ZMK_KEYBOARD_NAME
    default "Ahokore V2"

config BOARD
	default "ahokore"

if USB

config USB_NRFX
	default y

config USB_DEVICE_STACK
	default y

endif # USB

config BT_CTLR
	default BT

config ZMK_BLE
	default y

config ZMK_USB
	default y

config ZMK_BATTERY_VOLTAGE_DIVIDER
	default y

endif # BOARD_AHOKORE
```

## app/boards/arm/ahokore_v2/Kconfig.board
```kconfig
# Copyright (c) 2020 The ZMK Contributors
# SPDX-License-Identifier: MIT

config BOARD_AHOKORE
	bool "ahokore"
	depends on SOC_NRF52840_QIAA
```

## app/boards/arm/bdn9/Kconfig.board
```kconfig
# keeb.io BDN9 board configuration

# Copyright (c) 2020 The ZMK Contributors
# SPDX-License-Identifier: MIT

config BOARD_BDN9
	bool "BDN9 rev2"
	depends on SOC_STM32F072XB
```

## app/boards/arm/bdn9/Kconfig.defconfig
```kconfig
# keeb.io BDN9 board configuration

# Copyright (c) 2020 Pete Johanson
# SPDX-License-Identifier: MIT

if BOARD_BDN9

config BOARD
	default "bdn9_rev2"

config ZMK_KEYBOARD_NAME
	default "BDN9 Rev2"

config ZMK_USB
	default y

endif # BOARD_BDN9
```

## app/boards/arm/bdn9/bdn9_rev2_defconfig
```kconfig
# SPDX-License-Identifier: MIT

CONFIG_SOC_SERIES_STM32F0X=y
CONFIG_SOC_STM32F072XB=y
# 72MHz system clock
CONFIG_SYS_CLOCK_HW_CYCLES_PER_SEC=72000000

# enable GPIO
CONFIG_GPIO=y

# Enable pinctrl
CONFIG_PINCTRL=y

# Poll to avoid interrupt overlap issues
CONFIG_ZMK_KSCAN_DIRECT_POLLING=y

CONFIG_ISR_STACK_SIZE=1024

# clock configuration
CONFIG_CLOCK_CONTROL=y

CONFIG_ZMK_USB=y
```

## app/boards/arm/bluehand/Kconfig.board
```kconfig
# BlueHand board configuration

# Copyright (c) 2024 The ZMK Contributors
# SPDX-License-Identifier: MIT

config BOARD_BLUEHAND
    bool "BlueHand"
    depends on SOC_NRF52840_QIAA
```

## app/boards/arm/bluehand/Kconfig.defconfig
```kconfig
# Copyright (c) 2022 The ZMK Contributors
# SPDX-License-Identifier: MIT

# BlueHand keyboard configuration

if BOARD_BLUEHAND

config ZMK_KEYBOARD_NAME
    default "bluehand"

if USB_DEVICE_STACK

config USB_NRFX
	default y

endif # USB_DEVICE_STACK

config BT_CTLR
	default BT

config ZMK_BLE
	default y

config ZMK_USB
	default y

endif # BOARD_BLUEHAND
```

## app/boards/arm/bluemacro840/Kconfig.board
```kconfig
# BlueMacro840 board configuration

# Copyright (c) 2020 The ZMK Contributors
# SPDX-License-Identifier: MIT

config BOARD_BLUEMACRO840_V1
	bool "BlueMacro840_V1"
	depends on SOC_NRF52840_QIAA
```

## app/boards/arm/bluemicro52840_v1/Kconfig.board
```kconfig
# BlueMicro52840_V1 board configuration

# Copyright (c) 2020 Pete Johanson, Derek Schmell
# SPDX-License-Identifier: MIT

config BOARD_BLUEMICRO52840_V1
	bool "BlueMicro52840_V1"
	depends on SOC_NRF52840_QIAA
```

## app/boards/arm/bluemicro833/Kconfig.board
```kconfig
# BlueMicro833 board configuration

# Copyright (c) 2021 The ZMK Contributors
# SPDX-License-Identifier: MIT

config BOARD_BLUEMICRO833_V1
	bool "BlueMicro833_V1"
	depends on SOC_NRF52833_QIAA
```

## app/boards/arm/bluemicro833/Kconfig.defconfig
```kconfig
# BlueMicro833 board configuration

# Copyright (c) 2020 Pete Johanson, Derek Schmell
# SPDX-License-Identifier: MIT

if BOARD_BLUEMICRO833_V1

config BOARD
	default "bluemicro833_v1"

if USB

config USB_NRFX
	default y

config USB_DEVICE_STACK
	default y

endif # USB

config BT_CTLR
	default BT

config ZMK_BLE
	default y

config ZMK_USB
	default y

config ZMK_BATTERY_NRF_VDDH
	default y

endif # BOARD_BLUEMICRO833_V1
```

## app/boards/arm/bluemicro840/Kconfig
```kconfig
# SPDX-License-Identifier: MIT

config BOARD_ENABLE_DCDC
	bool "Enable DCDC mode"
	select SOC_DCDC_NRF52X
	default y
	depends on BOARD_BLUEMICRO840_V1
```

## app/boards/arm/bluemicro840/Kconfig.defconfig
```kconfig
# BlueMicro840 board configuration

# Copyright (c) 2020 Pete Johanson, Derek Schmell
# SPDX-License-Identifier: MIT

if BOARD_BLUEMICRO840_V1

config BOARD
	default "bluemicro840_v1"

if USB_DEVICE_STACK

config USB_NRFX
	default y

endif # USB_DEVICE_STACK

config BT_CTLR
	default BT

config ZMK_BLE
	default y

config ZMK_USB
	default y

endif # BOARD_BLUEMICRO840_V1
```

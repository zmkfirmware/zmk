## app/boards/makerdiary/nrf52840_m2/board.yml
```yaml
board:
  extend: nrf52840_m2
  variants:
    - name: zmk
      qualifier: nrf52840
```

## app/boards/mechwild/pillbug/Kconfig.pillbug
```kconfig
# Copyright (c) 2022 The ZMK Contributors
# SPDX-License-Identifier: Apache-2.0

config BOARD_PILLBUG
    select SOC_NRF52840_QIAA
    imply RETAINED_MEM if BOARD_PILLBUG_NRF52840_ZMK
    imply RETENTION if BOARD_PILLBUG_NRF52840_ZMK
    imply RETENTION_BOOT_MODE if BOARD_PILLBUG_NRF52840_ZMK
```

## app/boards/mechwild/s40nc/Kconfig.defconfig
```kconfig
# Copyright (c) 2021 The ZMK Contributors
# SPDX-License-Identifier: MIT

if BOARD_S40NC

config ZMK_KEYBOARD_NAME
    default "S40NC"

if USB

config USB_NRFX
    default y

config USB_DEVICE_STACK
    default y

endif # USB

config BT_CTLR
    default BT

endif # BOARD_S40NC
```

## app/boards/mechwild/s40nc/Kconfig.s40nc
```kconfig
# Copyright (c) 2021 The ZMK Contributors
# SPDX-License-Identifier: Apache-2.0

config BOARD_S40NC
    select SOC_NRF52840_QIAA
    imply RETAINED_MEM
    imply RETENTION
    imply RETENTION_BOOT_MODE
```

## app/boards/mechwild/s40nc/board.yml
```yaml
board:
  name: s40nc
  full_name: Shorty 40 No-Cordy
  vendor: mechwild
  socs:
    - name: nrf52840
      variants:
        - name: zmk
```

## app/boards/moergo/glove80/Kconfig.glove80_lh
```kconfig
# Copyright (c) 2021 The ZMK Contributors
# SPDX-License-Identifier: MIT

config BOARD_GLOVE80_LH
    select SOC_NRF52840_QIAA
```

## app/boards/moergo/glove80/Kconfig.glove80_rh
```kconfig
# Copyright (c) 2021 The ZMK Contributors
# SPDX-License-Identifier: MIT

config BOARD_GLOVE80_RH
    select SOC_NRF52840_QIAA
    imply RETAINED_MEM
    imply RETENTION
    imply RETENTION_BOOT_MODE
```

## app/boards/moergo/glove80/board.yml
```yaml
boards:
  - name: glove80_rh
    full_name: Glove80 (Right)
    vendor: moergo
    socs:
      - name: nrf52840
  - name: glove80_lh
    full_name: Glove80 (Left)
    vendor: moergo
    socs:
      - name: nrf52840
```

## app/boards/native/native_sim/Kconfig
```kconfig
config BOARD_NATIVE_SIM
    bool
    select POSIX_ARCH_CONSOLE
    select NATIVE_LIBRARY
    select NATIVE_POSIX_TIMER
    select 64BIT if BOARD_NATIVE_SIM_NATIVE_ZMK_TEST_MOCK || BOARD_NATIVE_SIM_NATIVE_ZMK_DISPLAY_TESTING
    imply BOARD_NATIVE_POSIX if NATIVE_SIM_NATIVE_POSIX_COMPAT
    help
      Native simulator (Single Core)
      Will produce a console Linux process which can be executed natively.
```

## app/boards/native/native_sim/board.yml
```yaml
board:
  extend: native_sim
  variants:
    - name: zmk_display_testing
      qualifier: native
    - name: zmk_test_mock
      qualifier: native
```

## app/boards/native/native_sim/native_sim_native_zmk_display_testing_defconfig
```kconfig
# SPDX-License-Identifier: MIT

CONFIG_ZMK_DISPLAY=y

CONFIG_CONSOLE=y
CONFIG_SYS_CLOCK_HW_CYCLES_PER_SEC=1000000

CONFIG_LOG=y
CONFIG_LOG_BACKEND_SHOW_COLOR=n
CONFIG_ZMK_LOG_LEVEL_DBG=y
CONFIG_DEBUG=y
CONFIG_SYS_CLOCK_TICKS_PER_SEC=1000
```

## app/boards/native/nrf_bsim/board.yml
```yaml
board:
  extend: nrf52_bsim
  variants:
    - name: zmk_test_mock
      qualifier: native
```

## app/boards/native/nrf_bsim/nrf52_bsim_native_zmk_test_mock_defconfig
```kconfig
# Copyright (c) 2026 The ZMK Contributors
# SPDX-License-Identifier: MIT

CONFIG_CONSOLE=y
CONFIG_NO_OPTIMIZATIONS=y

CONFIG_ZMK_BLE=y
CONFIG_LOG=y
CONFIG_LOG_BACKEND_SHOW_COLOR=n
CONFIG_ZMK_LOG_LEVEL_DBG=y
```

## app/boards/native_posix.conf
```kconfig
CONFIG_GPIO=n
CONFIG_ZMK_BLE=n
CONFIG_LOG=y
CONFIG_LOG_BACKEND_SHOW_COLOR=n
CONFIG_ZMK_LOG_LEVEL_DBG=y
CONFIG_DEBUG=y
CONFIG_SYS_CLOCK_TICKS_PER_SEC=1000
```

## app/boards/native_posix_64.conf
```kconfig
CONFIG_GPIO=n
# Enable to have the native posix build expose USBIP device(s)
# CONFIG_ZMK_USB=y
CONFIG_LOG=y
CONFIG_LOG_BACKEND_SHOW_COLOR=n
CONFIG_ZMK_LOG_LEVEL_DBG=y
CONFIG_DEBUG=y
CONFIG_SYS_CLOCK_TICKS_PER_SEC=1000
```

## app/boards/native_posix_shell_test_extra.conf
```kconfig
CONFIG_SERIAL=y
CONFIG_UART_NATIVE_POSIX=y
#CONFIG_NATIVE_UART_0_ON_OWN_PTY=y
CONFIG_NATIVE_UART_0_ON_STDINOUT=y

CONFIG_SHELL=y
CONFIG_SHELL_BACKEND_SERIAL=y
CONFIG_ZMK_SHELL_KEY_POSITIONS=y
CONFIG_SHELL_BACKEND_SERIAL_RX_RING_BUFFER_SIZE=1024

CONFIG_SHELL_PROMPT_UART="zmk> "

#CONFIG_SHELL_BACKEND_SERIAL_INTERRUPT_DRIVEN=n
#CONFIG_UART_INTERRUPT_DRIVEN=n
#CONFIG_UART_LINE_CTRL=n
#CONFIG_SHELL_BACKEND_SERIAL_CHECK_DTR=n
```

## app/boards/nicekeyboards/cornixqf/Kconfig.cornixqf
```kconfig
# Copyright (c) 2020 Pete Johanson
# SPDX-License-Identifier: Apache-2.0

config BOARD_CORNIXQF
    select SOC_NRF52840_QIAA
    imply RETAINED_MEM
    imply RETENTION
    imply RETENTION_BOOT_MODE
```

## app/boards/nicekeyboards/nice60/Kconfig
```kconfig
# Copyright (c) 2021 Nick Winans
# SPDX-License-Identifier: MIT

config BOARD_ENABLE_DCDC
    bool "Enable DCDC mode"
    select SOC_DCDC_NRF52X
    default y
    depends on BOARD_NICE60
```

## app/boards/nicekeyboards/nice60/Kconfig.defconfig
```kconfig
# Copyright (c) 2021 Nick Winans
# SPDX-License-Identifier: MIT

if BOARD_NICE60

config ZMK_KEYBOARD_NAME
    default "nice!60"

if USB_DEVICE_STACK

config USB_NRFX
    default y

endif # USB_DEVICE_STACK

config BT_CTLR
    default BT

endif # BOARD_NICE60
```

## app/boards/nicekeyboards/nice60/Kconfig.nice60
```kconfig
# Copyright (c) 2021 Nick Winans
# SPDX-License-Identifier: Apache-2.0

config BOARD_NICE60
    select SOC_NRF52840_QIAA
    select ZMK_BOARD_COMPAT if BOARD_NICE60_NRF52840_ZMK
    imply RETAINED_MEM if BOARD_NICE60_NRF52840_ZMK
    imply RETENTION if BOARD_NICE60_NRF52840_ZMK
    imply RETENTION_BOOT_MODE if BOARD_NICE60_NRF52840_ZMK
```

## app/boards/nicekeyboards/nice60/board.yml
```yaml
board:
  name: nice60
  vendor: nicekeyboards
  socs:
    - name: nrf52840
      variants:
        - name: zmk
```

## app/boards/nicekeyboards/nice_nano/Kconfig.nice_nano
```kconfig
# Copyright (c) 2020 Pete Johanson
# SPDX-License-Identifier: Apache-2.0

config BOARD_NICE_NANO
    select SOC_NRF52840_QIAA
    select ZMK_BOARD_COMPAT if BOARD_NICE_NANO_NRF52840_ZMK || BOARD_NICE_NANO_NRF52840_ZMK_DEBUG
    imply RETAINED_MEM if BOARD_NICE_NANO_NRF52840_ZMK || BOARD_NICE_NANO_NRF52840_ZMK_DEBUG
    imply RETENTION if BOARD_NICE_NANO_NRF52840_ZMK || BOARD_NICE_NANO_NRF52840_ZMK_DEBUG
    imply RETENTION_BOOT_MODE if BOARD_NICE_NANO_NRF52840_ZMK || BOARD_NICE_NANO_NRF52840_ZMK_DEBUG
```

## app/boards/nicekeyboards/nice_nano/board.yml
```yaml
board:
  extend: nice_nano
  variants:
    - name: zmk
      qualifier: nrf52840
    - name: zmk_debug
      qualifier: nrf52840
```

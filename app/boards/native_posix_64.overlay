#include <behaviors.dtsi>
#include <dt-bindings/zmk/keys.h>
#include <dt-bindings/zmk/kscan_mock.h>

/ {
    chosen {
        zephyr,console = &uart0;
        zmk,kscan = &kscan;
    };

    kscan: kscan {
        compatible = "zmk,kscan-mock";

        rows = <2>;
        columns = <2>;
        exit-after;
    };

    uart0: uart {
        status = "okay";
        compatible = "zephyr,native-posix-uart";
        /* Dummy current-speed entry to comply with serial
         * DTS binding
         */
        current-speed = <0>;
    };
};

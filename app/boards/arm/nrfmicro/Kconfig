## app/boards/arm/nrfmicro/Kconfig
```kconfig
config BOARD_ENABLE_DCDC
	bool "Enable DCDC mode"
	select SOC_DCDC_NRF52X
	default y
	depends on (BOARD_NRFMICRO_11 || BOARD_NRFMICRO_11_FLIPPED || BOARD_NRFMICRO_13)

config BOARD_NRFMICRO_CHARGER
	bool "Enable battery charger"
	default y
	depends on (BOARD_NRFMICRO_13)
```

## app/boards/arm/nrfmicro/Kconfig.board
```kconfig
# nrfmicro board configuration

# Copyright (c) 2020 The ZMK Contributors
# SPDX-License-Identifier: MIT

config BOARD_NRFMICRO_11
	bool "nrfmicro_11"
	depends on SOC_NRF52840_QIAA

config BOARD_NRFMICRO_11_FLIPPED
	bool "nrfmicro_11_flipped"
	depends on SOC_NRF52840_QIAA

config BOARD_NRFMICRO_13
	bool "nrfmicro_13"
	depends on SOC_NRF52840_QIAA
```

## app/boards/arm/nrfmicro/Kconfig.defconfig
```kconfig
# Electronut Labs Papyr board configuration

# Copyright (c) 2020 The ZMK Contributors
# SPDX-License-Identifier: MIT

if BOARD_NRFMICRO_11 || BOARD_NRFMICRO_11_FLIPPED || BOARD_NRFMICRO_13 || BOARD_NRFMICRO_13_52833

config BOARD
    default "nrfmicro"

if USB_DEVICE_STACK

config USB_NRFX
    default y

endif # USB_DEVICE_STACK

config BT_CTLR
    default BT

config PINMUX
    default y

if BOARD_NRFMICRO_13 || BOARD_NRFMICRO_13_52833

config BOARD_NRFMICRO_CHARGER
    default y

endif # BOARD_NRFMICRO_13 || BOARD_NRFMICRO_13_52833

endif # BOARD_NRFMICRO_11 || BOARD_NRFMICRO_11_FLIPPED || BOARD_NRFMICRO_13 || BOARD_NRFMICRO_13_52833
```

## app/boards/arm/nrfmicro/nrfmicro_11_flipped_defconfig
```kconfig
# SPDX-License-Identifier: MIT

CONFIG_SOC_SERIES_NRF52X=y
CONFIG_SOC_NRF52840_QIAA=y
CONFIG_BOARD_NRFMICRO_11_FLIPPED=y

# Enable MPU
CONFIG_ARM_MPU=y

# enable GPIO
CONFIG_GPIO=y

CONFIG_USE_DT_CODE_PARTITION=y

CONFIG_MPU_ALLOW_FLASH_WRITE=y
CONFIG_NVS=y
CONFIG_SETTINGS_NVS=y
CONFIG_FLASH=y
CONFIG_FLASH_PAGE_LAYOUT=y
CONFIG_FLASH_MAP=y
CONFIG_CLOCK_CONTROL_NRF=y
CONFIG_CLOCK_CONTROL_NRF_K32SRC_RC=y
```

## app/boards/arm/nrfmicro/nrfmicro_13_52833_defconfig
```kconfig
# SPDX-License-Identifier: MIT

CONFIG_SOC_SERIES_NRF52X=y
CONFIG_SOC_NRF52833_QIAA=y
CONFIG_BOARD_NRFMICRO_13_52833=y

# Enable MPU
CONFIG_ARM_MPU=y

CONFIG_PINCTRL=y

# enable GPIO
CONFIG_GPIO=y

CONFIG_USE_DT_CODE_PARTITION=y
CONFIG_BUILD_OUTPUT_UF2=y

CONFIG_MPU_ALLOW_FLASH_WRITE=y
CONFIG_NVS=y
CONFIG_SETTINGS_NVS=y
CONFIG_FLASH=y
CONFIG_FLASH_PAGE_LAYOUT=y
CONFIG_FLASH_MAP=y
CONFIG_CLOCK_CONTROL_NRF=y
CONFIG_CLOCK_CONTROL_NRF_K32SRC_RC=y

CONFIG_ZMK_USB=y
CONFIG_ZMK_BLE=y
```

## app/boards/arm/nucleo_wb55cg_dongle/Kconfig.board
```kconfig
# STM32WB55CG Nucleo USB dongle configuration

# Copyright (c) 2021 The ZMK Contributors
# SPDX-License-Identifier: MIT

config BOARD_NUCLEO_WB55CG_DONGLE
	bool "Nucleo WB55CG USB Dongle"
	depends on SOC_STM32WB55XX
```

## app/boards/arm/nucleo_wb55cg_dongle/Kconfig.defconfig
```kconfig
# STM32LWB55CG USB dongle configuration

# Copyright (c) 2021 The ZMK Contributors
# SPDX-License-Identifier: MIT

if BOARD_NUCLEO_WB55CG_DONGLE

config BOARD
	default "nucleo_wb55cg_dongle"

config CLOCK_STM32_LSE
	default y

choice STM32_LPTIM_CLOCK
	default STM32_LPTIM_CLOCK_LSE
	depends on STM32_LPTIM_TIMER
endchoice

choice BT_HCI_BUS_TYPE
	default BT_STM32_IPM
	depends on BT
endchoice

config SYSTEM_WORKQUEUE_STACK_SIZE
	default 2048

config ZMK_USB
	default y

config ZMK_KSCAN_MATRIX_POLLING
	default y

endif # BOARD_NUCLEO_WB55CG
```

## app/boards/arm/paw/Kconfig.board
```kconfig
# Paw board configuration

# Copyright (c) 2020 Taylor Glaeser
# SPDX-License-Identifier: MIT

config BOARD_PAW
	bool "Paw"
	depends on SOC_NRF52840_QIAA
```

## app/boards/arm/paw/Kconfig.defconfig
```kconfig
# Copyright (c) 2020 Taylor Glaeser
# SPDX-License-Identifier: MIT

if BOARD_PAW

config BOARD
	default "paw"

config ZMK_KEYBOARD_NAME
  default "Paw"

if USB

config USB_NRFX
	default y

config USB_DEVICE_STACK
	default y

endif # USB

config BT_CTLR
	default BT

config ZMK_BLE
	default y

config ZMK_USB
	default y

config ZMK_RGB_UNDERGLOW
  default y

config WS2812_STRIP
  default y

endif # BOARD_PAW
```

## app/boards/arm/peach/Kconfig
```kconfig
# Copyright (c) 2021 The ZMK Contributors
# SPDX-License-Identifier: MIT

config BOARD_ENABLE_DCDC
	bool "Enable DCDC mode"
	select SOC_DCDC_NRF52X
	default y
	depends on (BOARD_PEACH_V1)
```

## app/boards/arm/peach/Kconfig.board
```kconfig
# Copyright (c) 2021 The ZMK Contributors
# SPDX-License-Identifier: MIT

config BOARD_PEACH_V1
	bool "peach v1"
	depends on SOC_NRF52840_QIAA
```

## app/boards/arm/peach/Kconfig.defconfig
```kconfig
# Copyright (c) 2021 The ZMK Contributors
# SPDX-License-Identifier: MIT

if BOARD_PEACH_V1

config BOARD
	default "Peach"

if USB

config USB_NRFX
	default y

config USB_DEVICE_STACK
	default y

endif # USB

config BT_CTLR
	default BT

config ZMK_BLE
	default y

config ZMK_USB
	default y

config ZMK_BATTERY_VOLTAGE_DIVIDER
	default y

config ZMK_KEYBOARD_NAME
	default "Peach Rev1"

endif # BOARD_PEACH_V1
```

## app/boards/arm/peach/peach_v1_defconfig
```kconfig
# Copyright (c) 2021 The ZMK Contributors
# SPDX-License-Identifier: MIT

CONFIG_SOC_SERIES_NRF52X=y
CONFIG_SOC_NRF52840_QIAA=y
CONFIG_BOARD_PEACH_V1=y

# Enable MPU
CONFIG_ARM_MPU=y

# enable GPIO
CONFIG_GPIO=y

CONFIG_USE_DT_CODE_PARTITION=y

CONFIG_MPU_ALLOW_FLASH_WRITE=y
CONFIG_NVS=y
CONFIG_SETTINGS_NVS=y
CONFIG_FLASH=y
CONFIG_FLASH_PAGE_LAYOUT=y
CONFIG_FLASH_MAP=y

# RGB
CONFIG_ZMK_RGB_UNDERGLOW=y
CONFIG_WS2812_STRIP=y
CONFIG_ZMK_RGB_UNDERGLOW_EXT_POWER=y   
CONFIG_ZMK_RGB_UNDERGLOW_ON_START=y

# enable deep sleep support
#CONFIG_ZMK_SLEEP=y
#CONFIG_ZMK_IDLE_SLEEP_TIMEOUT=900000
```

## app/boards/arm/pillbug/Kconfig
```kconfig
# SPDX-License-Identifier: MIT

config BOARD_ENABLE_DCDC
	bool "Enable DCDC mode"
	select SOC_DCDC_NRF52X
	default n
	depends on (BOARD_PILLBUG)
```

## app/boards/arm/pillbug/Kconfig.board
```kconfig
# Copyright (c) 2022 The ZMK Contributors
# SPDX-License-Identifier: MIT

config BOARD_PILLBUG
    bool "PillBug"
    depends on SOC_NRF52840_QIAA
```

## app/boards/arm/pillbug/Kconfig.defconfig
```kconfig
# Copyright (c) 2022 The ZMK Contributors
# SPDX-License-Identifier: MIT

if BOARD_PILLBUG

config BOARD
    default "PillBug"

if USB_DEVICE_STACK

config USB_NRFX
    default y

endif # USB_DEVICE_STACK

config BT_CTLR
    default BT

endif # BOARD_PILLBUG
```

## app/boards/arm/planck/Kconfig.board
```kconfig
# Planck V6 board configuration

# Copyright (c) 2020 The ZMK Contributors
# SPDX-License-Identifier: MIT

config BOARD_PLANCK_REV6
	bool "Planck V6 Keyboard"
	depends on SOC_STM32F303XC
```

## app/boards/arm/planck/Kconfig.defconfig
```kconfig
# Planck keyboard configuration

# Copyright (c) 2020 Peter Johanson
# SPDX-License-Identifier: MIT

if BOARD_PLANCK_REV6

config ZMK_KEYBOARD_NAME
	default "Planck V6"

config ZMK_USB
	default y

endif # BOARD_PLANCK_REV6
```

## app/boards/arm/polilla_w/Kconfig.board
```kconfig
# Polilla wireless board configuration
#
# Copyright (c) 2020 The ZMK Contributors
# SPDX-License-Identifier: MIT

config BOARD_POLILLA_W
	bool "Polilla"
	depends on SOC_NRF52840_QIAA

config BOARD_ENABLE_DCDC
	bool "Enable DCDC mode"
	select SOC_DCDC_NRF52X
	default y
	depends on BOARD_POLILLA_W
	
config BOARD_POLILLA_CHARGER
	bool "Enable battery charger"
	default y
	depends on BOARD_POLILLA_W
	
```

## app/boards/arm/polilla_w/Kconfig.defconfig
```kconfig
#
# Copyright (c) 2020 The ZMK Contributors
# SPDX-License-Identifier: MIT
#

if BOARD_POLILLA_W

config ZMK_KEYBOARD_NAME
	default "Polilla"

if USB

config USB_NRFX
	default y

config USB_DEVICE_STACK
	default y

endif # USB

config BT_CTLR
	default BT

config ZMK_BLE
	default y

config ZMK_USB
	default y

config BOARD_POLILLA_CHARGER
	default y

config ZMK_BATTERY_VOLTAGE_DIVIDER
	default y

endif # BOARD_POLILLA_W
```

## app/boards/arm/preonic/Kconfig.board
```kconfig
# Preonic V3 board configuration

# Copyright (c) 2022 The ZMK Contributors
# SPDX-License-Identifier: MIT

config BOARD_PREONIC_REV3
	bool "Preonic V3 Keyboard"
	depends on SOC_STM32F303XC
```

## app/boards/arm/preonic/Kconfig.defconfig
```kconfig
# Preonic keyboard configuration

# Copyright (c) 2020 The ZMK Contributors
# SPDX-License-Identifier: MIT

if BOARD_PREONIC_REV3

config ZMK_KEYBOARD_NAME
	default "Preonic V3"

config ZMK_USB
	default y

endif # BOARD_PREONIC_REV3
```

## app/boards/arm/preonic/preonic_rev3_defconfig
```kconfig
# SPDX-License-Identifier: MIT

CONFIG_SOC_SERIES_STM32F3X=y
CONFIG_SOC_STM32F303XC=y
# 72MHz system clock
CONFIG_SYS_CLOCK_HW_CYCLES_PER_SEC=72000000

# enable pinctrl
CONFIG_PINCTRL=y

# enable GPIO
CONFIG_GPIO=y

# clock configuration
CONFIG_CLOCK_CONTROL=y

CONFIG_ZMK_USB=y
```

## app/boards/arm/proton_c/Kconfig.board
```kconfig
# QMK Proton-C board configuration

# Copyright (c) 2020 Pete Johanson
# SPDX-License-Identifier: MIT

config BOARD_QMK_PROTON_C
	bool "QMK Proton-C"
	depends on SOC_STM32F303XC
```

## app/boards/arm/proton_c/Kconfig.defconfig
```kconfig
# QMK Proton-C board configuration

# Copyright (c) 2020 Pete Johanson
# SPDX-License-Identifier: MIT

if BOARD_QMK_PROTON_C

config BOARD
    default "proton_c"

endif # BOARD_QMK_PROTON_C
```

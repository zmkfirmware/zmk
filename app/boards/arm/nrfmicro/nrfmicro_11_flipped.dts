/*
 * Copyright (c) 2020 The ZMK Contributors
 *
 * SPDX-License-Identifier: MIT
 */

/dts-v1/;
#include "nrfmicro.dtsi"
#include "arduino_pro_micro_pins_flipped.dtsi"

/ {
	ext-power {
		compatible = "zmk,ext-power-generic";
		label = "EXT_POWER";
		control-gpios = <&gpio1 9 GPIO_ACTIVE_HIGH>;
	};
};

&i2c0 {
	sda-pin = <30>;
	scl-pin = <31>;
};

## app/boards/arm/bt60/Kconfig
```kconfig
# SPDX-License-Identifier: MIT

config BOARD_ENABLE_DCDC
	bool "Enable DCDC mode"
	select SOC_DCDC_NRF52X
	default y
	depends on (BOARD_BT60_V1_HS || BOARD_BT60_V1)
```

## app/boards/arm/bt60/Kconfig.board
```kconfig
# BT60 board configuration

# Copyright (c) 2021 Polarity Works
# SPDX-License-Identifier: MIT

config BOARD_BT60_V1
	bool "bt60"
	depends on SOC_NRF52840_QIAA

config BOARD_BT60_V1_HS
	bool "bt60 hotswap"
	depends on SOC_NRF52840_QIAA
```

## app/boards/arm/bt60/Kconfig.defconfig
```kconfig
# Copyright (c) 2021 Polarity Works
# SPDX-License-Identifier: MIT

if BOARD_BT60_V1_HS || BOARD_BT60_V1

config BOARD
    default "bt60"

if USB

config USB_NRFX
    default y

config USB_DEVICE_STACK
    default y

endif # USB

config BT_CTLR
    default BT

config ZMK_KEYBOARD_NAME
    default "BT60"

endif # BOARD_BT60
```

## app/boards/arm/bt60/bt60_v1_hs_defconfig
```kconfig
# SPDX-License-Identifier: MIT

CONFIG_SOC_SERIES_NRF52X=y
CONFIG_SOC_NRF52840_QIAA=y
CONFIG_BOARD_BT60_V1_HS=y

# Enable MPU
CONFIG_ARM_MPU=y

# enable GPIO
CONFIG_GPIO=y

# encoder
CONFIG_EC11=y
CONFIG_EC11_TRIGGER_GLOBAL_THREAD=y

CONFIG_USE_DT_CODE_PARTITION=y
CONFIG_BUILD_OUTPUT_UF2=y

CONFIG_MPU_ALLOW_FLASH_WRITE=y
CONFIG_NVS=y
CONFIG_SETTINGS_NVS=y
CONFIG_FLASH=y
CONFIG_FLASH_PAGE_LAYOUT=y
CONFIG_FLASH_MAP=y

CONFIG_ZMK_USB=y
CONFIG_ZMK_BLE=y
```

## app/boards/arm/chameleon/Kconfig.board
```kconfig
# Chameleon board configuration

# Copyright (c) 2020 The ZMK Contributors
# SPDX-License-Identifier: MIT

config BOARD_CHAMELEON
    bool "Chameleon Keyboard"
    depends on SOC_RP2040
```

## app/boards/arm/chameleon/Kconfig.defconfig
```kconfig
# Chameleon keyboard configuration

# Copyright (c) 2020 The ZMK Contributors
# SPDX-License-Identifier: MIT

if BOARD_CHAMELEON

config ZMK_KEYBOARD_NAME
    default "Chameleon"

config ZMK_KSCAN_MATRIX_POLLING
    default y
    
config RP2_FLASH_W25Q080
    default y

endif # BOARD_CHAMELEON
```

## app/boards/arm/chameleon/chameleon_defconfig
```kconfig
# SPDX-License-Identifier: MIT

CONFIG_SOC_SERIES_RP2XXX=y
CONFIG_SOC_RP2040=y
CONFIG_BOARD_CHAMELEON=y

CONFIG_SYS_CLOCK_HW_CYCLES_PER_SEC=125000000

# Enable USB CDC ACM logging for debugging
CONFIG_ZMK_USB_LOGGING=y

# enable GPIO
CONFIG_GPIO=y

# Enable reset by default
CONFIG_RESET=y

# Output UF2 by default, native bootloader supports it.
CONFIG_BUILD_OUTPUT_UF2=y

CONFIG_ZMK_USB=y
```

## app/boards/arm/choconum/Kconfig.board
```kconfig
# keeb.io Choconum board configuration

# Copyright (c) 2020 The ZMK Contributors
# SPDX-License-Identifier: MIT

config BOARD_CHOCONUM
	bool "Choconum"
	depends on SOC_STM32F072XB
```

## app/boards/arm/choconum/Kconfig.defconfig
```kconfig
# keeb.io Choconum board configuration

# Copyright (c) 2020 Pete Johanson
# SPDX-License-Identifier: MIT

if BOARD_CHOCONUM

config BOARD
	default "choconum"

config ZMK_KEYBOARD_NAME
	default "Choconum"

config ZMK_USB
	default y

endif # BOARD_CHOCONUM
```

## app/boards/arm/ckp/Kconfig
```kconfig
# Copyright (c) 2022 The ZMK Contributors
# SPDX-License-Identifier: MIT

config BOARD_ENABLE_DCDC
    bool "Enable DCDC mode"
    select SOC_DCDC_NRF52X
    default y
    depends on BOARD_BT60_V2 || BOARD_BT65_V1 || BOARD_BT75_V1
```

## app/boards/arm/ckp/Kconfig.board
```kconfig
# CKP boards configuration

# Copyright (c) 2022 The ZMK Contributors
# SPDX-License-Identifier: MIT

config BOARD_BT60_V2
    bool "bt60_v2"
    depends on SOC_NRF52840_QIAA

config BOARD_BT65_V1
    bool "bt65_v1"
    depends on SOC_NRF52840_QIAA

config BOARD_BT75_V1
    bool "bt75_v1"
    depends on SOC_NRF52840_QIAA
```

## app/boards/arm/ckp/Kconfig.defconfig
```kconfig
# Copyright (c) 2022 The ZMK Contributors
# SPDX-License-Identifier: MIT

config BOARD
    default "bt60_v2" if BOARD_BT60_V2
    default "bt65_v1" if BOARD_BT65_V1
    default "bt75_v1" if BOARD_BT75_V1
config ZMK_KEYBOARD_NAME
    default "BT60 V2" if BOARD_BT60_V2
    default "BT65" if BOARD_BT65_V1
    default "BT75" if BOARD_BT75_V1

if BOARD_BT60_V2 || BOARD_BT65_V1 || BOARD_BT75_V1

if USB

config USB_NRFX
    default y

config USB_DEVICE_STACK
    default y

endif # USB

config BT_CTLR
    default BT

endif # BOARD_BT60_V2 || BOARD_BT65_V1 || BOARD_BT75_V1
```

## app/boards/arm/ckp/bt60_v2_defconfig
```kconfig
# SPDX-License-Identifier: MIT

CONFIG_SOC_SERIES_NRF52X=y
CONFIG_SOC_NRF52840_QIAA=y
CONFIG_BOARD_BT60_V2=y

# Enable MPU
CONFIG_ARM_MPU=y

# enable GPIO
CONFIG_GPIO=y
CONFIG_PINCTRL=y

# encoder
CONFIG_EC11=y
CONFIG_EC11_TRIGGER_GLOBAL_THREAD=y

CONFIG_USE_DT_CODE_PARTITION=y
CONFIG_PWM=y
CONFIG_LED_PWM=y
CONFIG_ZMK_BACKLIGHT=y
CONFIG_BUILD_OUTPUT_UF2=y

CONFIG_MPU_ALLOW_FLASH_WRITE=y
CONFIG_NVS=y
CONFIG_SETTINGS_NVS=y
CONFIG_FLASH=y
CONFIG_FLASH_PAGE_LAYOUT=y
CONFIG_FLASH_MAP=y

CONFIG_ZMK_RGB_UNDERGLOW=y
CONFIG_ZMK_RGB_UNDERGLOW_EXT_POWER=y
CONFIG_ZMK_RGB_UNDERGLOW_ON_START=y
CONFIG_ZMK_RGB_UNDERGLOW_HUE_START=262
CONFIG_WS2812_STRIP=y
CONFIG_SPI=y

CONFIG_BT_CTLR_TX_PWR_PLUS_8=y

CONFIG_ZMK_USB=y
CONFIG_ZMK_BLE=y
```

## app/boards/arm/corne-ish_zen/Kconfig.board
```kconfig
#
# Copyright (c) 2021 Darryl deHaan
# SPDX-License-Identifier: MIT
#

config BOARD_CORNEISH_ZEN_V2_LEFT
	bool "corne-ish zen left v2"
	depends on SOC_NRF52840_QIAA

config BOARD_CORNEISH_ZEN_V2_RIGHT
	bool "corne-ish zen right v2"
	depends on SOC_NRF52840_QIAA
```

## app/boards/arm/corne-ish_zen/Kconfig.defconfig
```kconfig
#
# Copyright (c) 2021 Darryl deHaan
# SPDX-License-Identifier: MIT
#

if BOARD_CORNEISH_ZEN_V2_LEFT

	config ZMK_KEYBOARD_NAME
	default "Corne-ish Zen"

	config ZMK_SPLIT_ROLE_CENTRAL
	default y

endif # BOARD_CORNEISH_ZEN_V2_LEFT

if BOARD_CORNEISH_ZEN_V2_RIGHT

	config ZMK_KEYBOARD_NAME
	default "Corne-ish Zen rt"

endif # BOARD_CORNEISH_ZEN_V2_RIGHT


if BOARD_CORNEISH_ZEN_V2_LEFT || BOARD_CORNEISH_ZEN_V2_RIGHT

config BOARD
	default "corne-ish_zen"

config ZMK_SPLIT
	default y

#config I2C
#	bool
#	default y

#config I2C_0
#    bool
#    default y
#    depends on I2C

#menuconfig SENSOR
#    bool "Sensor Drivers"

#config BQ274XX
#    bool "BQ274xx Fuel Gauge"
#    depends on I2C && SENSOR

#config SENSOR_CAN_FETCH_ALL
#	bool "Can the fuel gauge fetch all channels at once"
#	default y

config SPI
    bool
    default y

config BT_CTLR
	default BT

config ZMK_BLE
	default y

config ZMK_USB
	default y

if USB

config USB_NRFX
	default y

config USB_DEVICE_STACK
	default y

endif # USB

config ZMK_DISPLAY
	select LVGL_USE_CONT
	select LVGL_FONT_MONTSERRAT_26
	select LVGL_FONT_MONTSERRAT_20
	select LVGL_FONT_MONTSERRAT_16
	select LVGL_USE_LABEL
	select LVGL_USE_IMG

choice ZMK_DISPLAY_STATUS_SCREEN
	default ZMK_DISPLAY_STATUS_SCREEN_CUSTOM
endchoice

if ZMK_DISPLAY

config SPI
	default y

config IL0323
	bool
	default y

config LVGL_DISPLAY_DEV_NAME
    string
    default "DISPLAY"
    depends on LVGL

#config DISPLAY_WOB
#	bool "White on Black Display"
#	default n

endif # ZMK_DISPLAY

menuconfig CUSTOM_WIDGET_BATTERY_STATUS
	bool "custom battery status widget"

menuconfig CUSTOM_WIDGET_OUTPUT_STATUS
	bool "custom output status widget"

menuconfig CUSTOM_WIDGET_LAYER_STATUS
	bool "custom layer status widget"

menuconfig CUSTOM_WIDGET_PERIPHERAL_STATUS
	bool "custom peripheral status widget"

# config CORNE_ISH_ZEN_20
#    bool

endif # BOARD_CORNEISH_ZEN_V2_LEFT || BOARD_CORNEISH_ZEN_V2_RIGHT
```

## app/boards/arm/corneish_zen/Kconfig
```kconfig
#
# Copyright (c) 2022 The ZMK Contributors
# SPDX-License-Identifier: MIT
#

config BOARD_CORNEISH_ZEN_LEFT
    bool

config BOARD_CORNEISH_ZEN_RIGHT
    bool
```

## app/boards/arm/corneish_zen/Kconfig.board
```kconfig
#
# Copyright (c) 2022 Darryl deHaan
# SPDX-License-Identifier: MIT
#

config BOARD_CORNEISH_ZEN_V1_LEFT
    bool "corneish zen left v1"
    depends on SOC_NRF52840_QIAA
    select BOARD_CORNEISH_ZEN_LEFT

config BOARD_CORNEISH_ZEN_V1_RIGHT
    bool "corneish zen right v1"
    depends on SOC_NRF52840_QIAA
    select BOARD_CORNEISH_ZEN_RIGHT

config BOARD_CORNEISH_ZEN_V2_LEFT
    bool "corneish zen left v2"
    depends on SOC_NRF52840_QIAA
    select BOARD_CORNEISH_ZEN_LEFT

config BOARD_CORNEISH_ZEN_V2_RIGHT
    bool "corneish zen right v2"
    depends on SOC_NRF52840_QIAA
    select BOARD_CORNEISH_ZEN_RIGHT
```

## app/boards/arm/corneish_zen/Kconfig.defconfig
```kconfig
#
# Copyright (c) 2022 Darryl deHaan
# SPDX-License-Identifier: MIT
#

if BOARD_CORNEISH_ZEN_LEFT

config ZMK_KEYBOARD_NAME
    default "Corne-ish Zen"

config ZMK_SPLIT_ROLE_CENTRAL
    default y

endif # BOARD_CORNEISH_ZEN_LEFT


if BOARD_CORNEISH_ZEN_LEFT || BOARD_CORNEISH_ZEN_RIGHT

config BOARD
    default "corneish_zen"

config ZMK_SPLIT
    default y

config BT_CTLR
    default BT

if USB

config USB_NRFX
    default y

config USB_DEVICE_STACK
    default y

endif # USB

config ZMK_DISPLAY
    select LV_USE_CONT
    select LV_FONT_MONTSERRAT_26
    select LV_FONT_MONTSERRAT_16
    select LV_USE_LABEL
    select LV_USE_IMG

choice ZMK_DISPLAY_STATUS_SCREEN
    default ZMK_DISPLAY_STATUS_SCREEN_CUSTOM
endchoice

if ZMK_DISPLAY

config SPI
    default y

config IL0323
    default y

config ZMK_DISPLAY_BLANK_ON_IDLE
    default n

endif # ZMK_DISPLAY

menuconfig CUSTOM_WIDGET_BATTERY_STATUS
    bool "custom battery status widget"

menuconfig CUSTOM_WIDGET_OUTPUT_STATUS
    bool "custom output status widget"

menuconfig CUSTOM_WIDGET_LAYER_STATUS
    bool "custom layer status widget"

menuconfig CUSTOM_WIDGET_PERIPHERAL_STATUS
    bool "custom peripheral status widget"

endif # BOARD_CORNEISH_ZEN_LEFT || BOARD_CORNEISH_ZEN_RIGHT

if BOARD_CORNEISH_ZEN_V1_LEFT || BOARD_CORNEISH_ZEN_V1_RIGHT

config BQ274XX
    default y

endif # BOARD_CORNEISH_ZEN_V1_LEFT || BOARD_CORNEISH_ZEN_V1_RIGHT
```

## app/boards/arm/corneish_zen/corneish_zen_v1_right_defconfig
```kconfig
#
# Copyright (c) 2022 Darryl deHaan
# SPDX-License-Identifier: MIT
#

CONFIG_SOC_SERIES_NRF52X=y
CONFIG_SOC_NRF52840_QIAA=y
CONFIG_BOARD_CORNEISH_ZEN_V1_RIGHT=y
CONFIG_ZMK_SLEEP=y
CONFIG_ZMK_DISPLAY=y

# Enable MPU
CONFIG_ARM_MPU=y

# enable pinctrl
CONFIG_PINCTRL=y

# enable GPIO
CONFIG_GPIO=y

# Enable I2C
CONFIG_I2C=y
CONFIG_I2C_NRFX=y

# Enable SPI
CONFIG_SPI_NRFX=y

# Enable writing to flash
CONFIG_USE_DT_CODE_PARTITION=y
CONFIG_BUILD_OUTPUT_UF2=y
CONFIG_MPU_ALLOW_FLASH_WRITE=y
CONFIG_NVS=y
CONFIG_SETTINGS_NVS=y
CONFIG_FLASH=y
CONFIG_FLASH_PAGE_LAYOUT=y
CONFIG_FLASH_MAP=y

# Enable 32kHz crystal
CONFIG_CLOCK_CONTROL_NRF_K32SRC_XTAL=y
CONFIG_CLOCK_CONTROL_NRF_K32SRC_30PPM=y

CONFIG_ZMK_USB=n
CONFIG_ZMK_BLE=y

# enable display drivers
CONFIG_ZMK_DISPLAY_WORK_QUEUE_DEDICATED=y
CONFIG_ZMK_DISPLAY_DEDICATED_THREAD_STACK_SIZE=4096
CONFIG_LV_Z_BITS_PER_PIXEL=1
CONFIG_LV_COLOR_DEPTH_1=y
CONFIG_LV_DPI_DEF=145
CONFIG_LV_Z_VDB_SIZE=100
CONFIG_LV_USE_THEME_MONO=y
CONFIG_LV_COLOR_CHROMA_KEY_HEX=0x00FF00
CONFIG_ZMK_LV_FONT_DEFAULT_SMALL_MONTSERRAT_16=y
CONFIG_LV_FONT_MONTSERRAT_26=y
CONFIG_LV_FONT_DEFAULT_MONTSERRAT_26=y

# custom status screens
CONFIG_ZMK_DISPLAY_STATUS_SCREEN_CUSTOM=y
CONFIG_ZMK_DISPLAY_STATUS_SCREEN_BUILT_IN=n
CONFIG_CUSTOM_WIDGET_BATTERY_STATUS=y
CONFIG_ZMK_WIDGET_BATTERY_STATUS=n
CONFIG_CUSTOM_WIDGET_PERIPHERAL_STATUS=y
CONFIG_ZMK_WIDGET_PERIPHERAL_STATUS=n

# Turn on logging, and set ZMK logging to debug output
#CONFIG_LOG=y
#CONFIG_LOG_PROCESS_THREAD_STARTUP_DELAY_MS=8000
#CONFIG_ZMK_USB_LOGGING=y
#CONFIG_ZMK_LOG_LEVEL_DBG=y
#CONFIG_LOG_BUFFER_SIZE=20000
#CONFIG_LOG_STRDUP_BUF_COUNT=60
#CONFIG_I2C_LOG_LEVEL_DBG=y
#CONFIG_SPI_LOG_LEVEL_DBG=y
#CONFIG_DISPLAY_LOG_LEVEL_DBG=y
#CONFIG_LVGL_LOG_LEVEL_DBG=y
#CONFIG_LVGL_USE_DEBUG=y
#CONFIG_SENSOR_LOG_LEVEL_DBG=y
```

## app/boards/arm/cyber60/Kconfig.board
```kconfig
# cyber60 board configuration

# Copyright (c) 2020 Stefan Sundin (4pplet)
# SPDX-License-Identifier: MIT

config BOARD_CYBER60_A
	bool "cyber60 Rev A"
	depends on SOC_NRF52840_QIAA
```

## app/boards/arm/cyber60/Kconfig.defconfig
```kconfig
# Copyright (c) 2020 Stefan Sundin (4pplet)
# SPDX-License-Identifier: MIT

if BOARD_CYBER60_A

config BOARD
	default "cyber60 Rev A"

if USB

config USB_NRFX
	default y

config USB_DEVICE_STACK
	default y

endif # USB

config BT_CTLR
	default BT

config ZMK_BLE
	default y

config ZMK_USB
	default y

config ZMK_BATTERY_VOLTAGE_DIVIDER
	default y

endif # BOARD_CYBER60_A
```

## app/boards/arm/dao/Kconfig
```kconfig
# Copyright (c) 2023 ZMK Contributors
# SPDX-License-Identifier: MIT

config BOARD_ENABLE_DCDC
    bool "Enable DCDC mode"
    select SOC_DCDC_NRF52X
    default y
    depends on (BOARD_DAO_LEFT || BOARD_DAO_RIGHT)
```

## app/boards/arm/dao/Kconfig.board
```kconfig
# Dao board configuration

# Copyright (c) 2023 ZMK Contributors
# SPDX-License-Identifier: MIT

config BOARD_DAO_LEFT
    bool "dao_left"
    depends on SOC_NRF52840_QIAA

config BOARD_DAO_RIGHT
    bool "dao_right"
    depends on SOC_NRF52840_QIAA
```

## app/boards/arm/dao/Kconfig.defconfig
```kconfig
# Copyright (c) 2023 ZMK Contributors
# SPDX-License-Identifier: MIT

if BOARD_DAO_LEFT

config ZMK_KEYBOARD_NAME
    default "Dao"

config ZMK_SPLIT_ROLE_CENTRAL
    default y

endif # BOARD_DAO_LEFT

if BOARD_DAO_LEFT || BOARD_DAO_RIGHT

config BOARD
    default "dao"

config ZMK_SPLIT
    default y

config BT_CTLR
    default BT

config ZMK_BLE
    default y

config ZMK_USB
    default y

config ZMK_BATTERY_VOLTAGE_DIVIDER
    default y

if USB

config USB_NRFX
    default y

config USB_DEVICE_STACK
    default y

endif # USB

endif # BOARD_DAO_LEFT || BOARD_DAO_RIGHT
```

## app/boards/arm/dao/dao_right_defconfig
```kconfig
# SPDX-License-Identifier: MIT

CONFIG_SOC_SERIES_NRF52X=y
CONFIG_SOC_NRF52840_QIAA=y
CONFIG_BOARD_DAO_RIGHT=y
CONFIG_ZMK_SPLIT=y
CONFIG_ZMK_SLEEP=y

# Enable MPU
CONFIG_ARM_MPU=y

# enable GPIO
CONFIG_GPIO=y

# Enable writing to flash
CONFIG_USE_DT_CODE_PARTITION=y
CONFIG_MPU_ALLOW_FLASH_WRITE=y
CONFIG_NVS=y
CONFIG_SETTINGS_NVS=y
CONFIG_FLASH=y
CONFIG_FLASH_PAGE_LAYOUT=y
CONFIG_FLASH_MAP=y

# Enable external crystal
CONFIG_CLOCK_CONTROL_NRF_K32SRC_XTAL=y
CONFIG_CLOCK_CONTROL_NRF_K32SRC_30PPM=y

# # Turn on logging, and set ZMK logging to debug output
# CONFIG_ZMK_USB_LOGGING=y

# # Turn on logging, and set ZMK logging to debug output
# CONFIG_LOG=y
# CONFIG_ZMK_LOG_LEVEL_DBG=y

# Turn on uf2 build
CONFIG_BUILD_OUTPUT_UF2=y
```

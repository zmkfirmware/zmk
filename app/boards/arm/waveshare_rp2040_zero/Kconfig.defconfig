## app/boards/arm/waveshare_rp2040_zero/Kconfig.defconfig
```kconfig
# Copyright (c) 2024 The ZMK Contributors
# SPDX-License-Identifier: Apache-2.0

if BOARD_WAVESHARE_RP2040_ZERO

config BOARD
    default "waveshare_rp2040_zero"

config RP2_FLASH_W25Q080
    default y

config ZMK_USB
    default y

endif # BOARD_WAVESHARE_RP2040_ZERO
```

## app/boards/arm/waveshare_rp2040_zero/rp2040_zero_defconfig
```kconfig
# Copyright (c) 2024 The ZMK Contributors
# SPDX-License-Identifier: Apache-2.0

CONFIG_SOC_SERIES_RP2XXX=y
CONFIG_SOC_RP2040=y
CONFIG_BOARD_RP2040_ZERO=y

CONFIG_SYS_CLOCK_HW_CYCLES_PER_SEC=125000000
CONFIG_RESET=y

# Enable GPIO
CONFIG_GPIO=y

# Code partition needed to target the correct flash range
CONFIG_USE_DT_CODE_PARTITION=y

# Output UF2 by default, native bootloader supports it.
CONFIG_BUILD_OUTPUT_UF2=y

CONFIG_MPU_ALLOW_FLASH_WRITE=y
CONFIG_NVS=y
CONFIG_FLASH=y
CONFIG_FLASH_PAGE_LAYOUT=y
CONFIG_FLASH_MAP=y

CONFIG_ZMK_USB=y
```

## app/boards/arm/waveshare_rp2040_zero/waveshare_rp2040_zero_defconfig
```kconfig
# Copyright (c) 2024 The ZMK Contributors
# SPDX-License-Identifier: Apache-2.0

CONFIG_SOC_SERIES_RP2XXX=y
CONFIG_SOC_RP2040=y
CONFIG_BOARD_WAVESHARE_RP2040_ZERO=y

CONFIG_SYS_CLOCK_HW_CYCLES_PER_SEC=125000000
CONFIG_RESET=y

# Enable GPIO
CONFIG_GPIO=y

# enable uart driver
CONFIG_SERIAL=y
CONFIG_UART_INTERRUPT_DRIVEN=y

# enable console
CONFIG_CONSOLE=y
CONFIG_UART_CONSOLE=y

# Code partition needed to target the correct flash range
CONFIG_USE_DT_CODE_PARTITION=y

# Output UF2 by default, native bootloader supports it.
CONFIG_BUILD_OUTPUT_UF2=y
```

## app/boards/arm/y75/Kconfig.board
```kconfig
# Copyright (c) 2021 Nick Winans
# SPDX-License-Identifier: MIT

config BOARD_Y75
	bool "y75"
	depends on SOC_NRF52840_QIAA
```

## app/boards/arm/zuna80/Kconfig.board
```kconfig
# Copyright (c) 2021 Nick Winans
# SPDX-License-Identifier: MIT

config BOARD_ZUNA80
	bool "zuna80"
	depends on SOC_NRF52833_QIAA
```

## app/boards/arm/zuna80/Kconfig.defconfig
```kconfig
# Copyright (c) 2021 Nick Winans
# SPDX-License-Identifier: MIT

if BOARD_ZUNA80

    config ZMK_KEYBOARD_NAME
	default "zuna80"
	
if USB

config USB_NRFX
	default y

config USB_DEVICE_STACK
	default y

endif # USB

config BT_CTLR
	default BT

config ZMK_BLE
	default y

config ZMK_USB
	default y

config ZMK_BATTERY_VOLTAGE_DIVIDER
	default y
	
if ZMK_BACKLIGHT

config PWM
    default y

config LED_PWM
    default y

endif # ZMK_BACKLIGHT

endif # BOARD_ZUNA80
```

## app/boards/boardsource/blok/Kconfig.boardsource_blok
```kconfig
# Copyright (c) 2026 Pete Johanson
# SPDX-License-Identifier: MIT

config BOARD_BOARDSOURCE_BLOK
    select ZMK_BOARD_COMPAT if BOARD_BOARDSOURCE_BLOK_RP2040_ZMK
    imply RETAINED_MEM if BOARD_BOARDSOURCE_BLOK_RP2040_ZMK
    imply RETENTION if BOARD_BOARDSOURCE_BLOK_RP2040_ZMK
    imply RETENTION_BOOT_MODE if BOARD_BOARDSOURCE_BLOK_RP2040_ZMK
```

## app/boards/boardsource/blok/board.yml
```yaml
board:
  extend: boardsource_blok
  variants:
    - name: zmk
      qualifier: rp2040
```

## app/boards/hanks/derivative-rev-a/Kconfig.defconfig
```kconfig
# Copyright (c) 2021 Nick Winans
# SPDX-License-Identifier: MIT

if BOARD_DERIVATIVE_REV_A

config ZMK_KEYBOARD_NAME
    default "derivative"

config ZMK
    bool
    default y

if USB_DEVICE_STACK
config USB_NRFX
    default y
endif

if ZMK_STUDIO
config ZMK_STUDIO_LOCKING
    default y
endif # ZMK_STUDIO

endif # BOARD_DERIVATIVE_REV_A
```

## app/boards/hanks/derivative-rev-a/Kconfig.derivative-rev-a
```kconfig
# Copyright (c) 2021 Nick Winans
# SPDX-License-Identifier: Apache-2.0

if BOARD_DERIVATIVE_REV_A

config BOARD
    default "derivative-rev-a"

config SOC_NRF52840_QIAA
    default y

config RETAINED_MEM
    default y

config RETENTION
    default y

config RETENTION_BOOT_MODE
    default y

endif # BOARD_DERIVATIVE_REV_A
```

## app/boards/hanks/derivative-rev-a/board.yml
```yaml
board:
  name: derivative-rev-a
  vendor: hanks
  socs:
    - name: nrf52840
      variants:
        - name: zmk
```

## app/boards/hanks/derivative-rev-a/derivative-rev-a_defconfig
```kconfig
CONFIG_BT=y
CONFIG_GPIO=y
CONFIG_SPI=y

# Connectivity and Power
CONFIG_USB_DEVICE_STACK=y
CONFIG_ZMK_SLEEP=y
```

## app/boards/hanks/derivative-rev-a/derivative-rev-a_nrf52840_zmk_defconfig
```kconfig
# Copyright (c) 2021 Nick Winans
# SPDX-License-Identifier: MIT

# Note: CONFIG_BOARD_DERIVATIVE_REV_A and SOC configs are auto-set by the build system

CONFIG_ARM_MPU=y
CONFIG_PINCTRL=y
CONFIG_GPIO=y

CONFIG_SPI=y
CONFIG_NRFX_SPIM3=y
CONFIG_SPI_NRFX=y
CONFIG_SPI_NRFX_RAM_BUFFER_SIZE=8

CONFIG_USE_DT_CODE_PARTITION=y
CONFIG_BUILD_OUTPUT_UF2=y

CONFIG_MPU_ALLOW_FLASH_WRITE=y
CONFIG_NVS=y
CONFIG_SETTINGS_NVS=y
CONFIG_FLASH=y
CONFIG_FLASH_PAGE_LAYOUT=y
CONFIG_FLASH_MAP=y

# Required by ZMK_LED_MAP; underglow LEDs are not populated on this board
CONFIG_ZMK_RGB_UNDERGLOW=y

# Per-key RGB + indicators
CONFIG_ZMK_LED_MAP=y
CONFIG_ZMK_LED_MAP_PER_KEY_BRT_MAX=10
CONFIG_ZMK_LED_MAP_INDICATOR_BRT_MAX=5
CONFIG_ZMK_LED_MAP_EFF_START=6
CONFIG_ZMK_HID_INDICATORS=y

# 1000 Hz USB polling rate
CONFIG_USB_HID_POLL_INTERVAL_MS=1

CONFIG_ZMK_USB=y
CONFIG_ZMK_BLE=y
CONFIG_ZMK_STUDIO=y
CONFIG_ZMK_SLEEP=y
```

## app/boards/hanks/hnkb40/Kconfig.board
```kconfig
# Copyright (c) 2021 Nick Winans
# SPDX-License-Identifier: MIT

config BOARD_HNKB40
    bool "hnkb40-lp"
    depends on SOC_NRF52840_QIAA
```

## app/boards/hanks/hnkb40/Kconfig.defconfig
```kconfig
# Copyright (c) 2021 Nick Winans
# SPDX-License-Identifier: MIT

if BOARD_HNKB40

config ZMK_KEYBOARD_NAME
    default "hnkb40"

# This enables the core ZMK logic for the board
config ZMK
    bool
    default y

if USB_DEVICE_STACK
config USB_NRFX
    default y
endif

if ZMK_STUDIO

config ZMK_STUDIO_LOCKING
    default y

endif # ZMK_STUDIO

endif # BOARD_HNKB40
```

## app/boards/hanks/hnkb40/Kconfig.hnkb40
```kconfig
# Copyright (c) 2021 Nick Winans
# SPDX-License-Identifier: Apache-2.0

# Board-specific Kconfig selections
# BOARD_HNKB40 is auto-defined by Zephyr board v2 format

if BOARD_HNKB40

config BOARD
    default "hnkb40"

config SOC_NRF52840_QIAA
    default y

config RETAINED_MEM
    default y

config RETENTION
    default y

config RETENTION_BOOT_MODE
    default y

endif # BOARD_HNKB40
```

## app/boards/hanks/hnkb40/board.yml
```yaml
board:
  name: hnkb40
  vendor: hanks
  socs:
    - name: nrf52840
      variants:
        - name: zmk
```

## app/boards/hanks/hnkb40/hnkb40_nrf52840_zmk_defconfig
```kconfig
# Copyright (c) 2021 Nick Winans
# SPDX-License-Identifier: MIT

# Note: CONFIG_BOARD_HNKB40 and SOC configs are auto-set by the build system

# Enable MPU
CONFIG_ARM_MPU=y

CONFIG_PINCTRL=y

# enable GPIO
CONFIG_GPIO=y

# enable SPI for WS2812 LED strip (SPI3)
CONFIG_SPI=y
CONFIG_NRFX_SPIM3=y
CONFIG_SPI_NRFX=y
CONFIG_SPI_NRFX_RAM_BUFFER_SIZE=8

CONFIG_USE_DT_CODE_PARTITION=y
CONFIG_BUILD_OUTPUT_UF2=y

CONFIG_MPU_ALLOW_FLASH_WRITE=y
CONFIG_NVS=y
CONFIG_SETTINGS_NVS=y
CONFIG_FLASH=y
CONFIG_FLASH_PAGE_LAYOUT=y
CONFIG_FLASH_MAP=y

CONFIG_ZMK_RGB_UNDERGLOW=y

CONFIG_ZMK_RGB_UNDERGLOW_HUE_START=160
CONFIG_ZMK_RGB_UNDERGLOW_EFF_START=3

# USB logging: build with -S zmk-usb-logging to enable
# CONFIG_ZMK_USB_LOGGING=y


CONFIG_ZMK_USB=y
CONFIG_ZMK_BLE=y

# Note: Using zmk,kscan-595a driver with GPIO bit-banging (luo_nice60 compatible)
```

## app/boards/joric/nrfmicro/Kconfig.defconfig
```kconfig
# Electronut Labs Papyr board configuration

# Copyright (c) 2020 The ZMK Contributors
# SPDX-License-Identifier: MIT

if BOARD_NRFMICRO_NRF52840 || BOARD_NRFMICRO_NRF52840_FLIPPED || BOARD_NRFMICRO_NRF52833

config BOARD
    default "nrfmicro"

if USB_DEVICE_STACK

config USB_NRFX
    default y

endif # USB_DEVICE_STACK

config BT_CTLR
    default BT

if BOARD_REVISION = "1.3.0"

config BOARD_NRFMICRO_CHARGER
    default y

endif # BOARD_REVISION = "1.3.0"


endif # BOARD_NRFMICRO_NRF52840 || BOARD_NRFMICRO_NRF52840_FLIPPED || BOARD_NRFMICRO_NRF52833
```

## app/boards/joric/nrfmicro/Kconfig.nrfmicro
```kconfig
# nrfmicro board configuration

# Copyright (c) 2020 The ZMK Contributors
# SPDX-License-Identifier: MIT

config BOARD_NRFMICRO
    select SOC_NRF52840_QIAA if BOARD_NRFMICRO_NRF52840_ZMK
    select SOC_NRF52840_QIAA if BOARD_NRFMICRO_NRF52840_FLIPPED_ZMK
    select SOC_NRF52833_QIAA if BOARD_NRFMICRO_NRF52833_ZMK
    imply RETAINED_MEM if BOARD_NRFMICRO_NRF52840_ZMK || BOARD_NRFMICRO_NRF52840_FLIPPED_ZMK || BOARD_NRFMICRO_NRF52833_ZMK
    imply RETENTION if BOARD_NRFMICRO_NRF52840_ZMK || BOARD_NRFMICRO_NRF52840_FLIPPED_ZMK || BOARD_NRFMICRO_NRF52833_ZMK
    imply RETENTION_BOOT_MODE if BOARD_NRFMICRO_NRF52840_ZMK || BOARD_NRFMICRO_NRF52840_FLIPPED_ZMK || BOARD_NRFMICRO_NRF52833_ZMK
```

## app/boards/joric/nrfmicro/board.yml
```yaml
board:
  extend: nrfmicro
  variants:
    - name: zmk
      qualifier: nrf52840
    - name: flipped_zmk
      qualifier: nrf52840
    - name: zmk
      qualifier: nrf52833
```

## app/boards/jpconstantineau/bluemicro840/Kconfig.bluemicro840
```kconfig
# Copyright (c) 2026 Pete Johanson, Derek Schmell
# SPDX-License-Identifier: Apache-2.0

config BOARD_BLUEMICRO840
    select SOC_NRF52840_QIAA
    imply RETAINED_MEM if BOARD_BLUEMICRO840_NRF52840_ZMK
    imply RETENTION if BOARD_BLUEMICRO840_NRF52840_ZMK
    imply RETENTION_BOOT_MODE if BOARD_BLUEMICRO840_NRF52840_ZMK
```

## app/boards/jpconstantineau/bluemicro840/board.yml
```yaml
board:
  extend: bluemicro840
  variants:
    - name: zmk
      qualifier: nrf52840
```

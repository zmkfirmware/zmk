## app/boards/arm/puchi_ble/Kconfig
```kconfig
config BOARD_ENABLE_DCDC
	bool "Enable DCDC mode"
	select SOC_DCDC_NRF52X
	default y
	depends on (BOARD_PUCHI_BLE_v1)

config BOARD_PUCHI_BLE_CHARGER
	bool "Enable battery charger"
	default y
	depends on (BOARD_PUCHI_BLE_v1)
```

## app/boards/arm/puchi_ble/Kconfig.board
```kconfig
# Puchi-BLE board configuration

# Copyright (c) 2022 The ZMK Contributors
# SPDX-License-Identifier: MIT

config BOARD_PUCHI_BLE_v1
    bool "puchi_ble_v1"
    imply ZMK_POWER_DOMAINS
    imply ZMK_POWER_DOMAINS_DYNAMIC_DEFAULT
    depends on SOC_NRF52840_QIAA
```

## app/boards/arm/puchi_ble/Kconfig.defconfig
```kconfig
# Copyright (c) 2022 The ZMK Contributors
# SPDX-License-Identifier: MIT

if BOARD_PUCHI_BLE_v1

config BOARD
	default "puchi_ble"

if USB_DEVICE_STACK

config USB_NRFX
	default y

endif # USB_DEVICE_STACK

config BT_CTLR
	default BT

config ZMK_BLE
	default y

config ZMK_USB
	default y

config PINMUX
	default y

endif # BOARD_PUCHI_BLE_v1
```

## app/boards/arm/radiata/Kconfig
```kconfig
# SPDX-License-Identifier: MIT


config BOARD_ENABLE_DCDC
    bool "Enable DCDC mode"
    select SOC_DCDC_NRF52X
    default y
    depends on BOARD_RADIATA_LEFT || BOARD_RADIATA_RIGHT
```

## app/boards/arm/radiata/Kconfig.board
```kconfig
#
# Copyright (c) 2023 The ZMK Contributors
# SPDX-License-Identifier: MIT
#

config BOARD_RADIATA_LEFT
    bool "radiata_left"
    depends on SOC_NRF52840_QIAA

config BOARD_RADIATA_RIGHT
    bool "radiata_right"
    depends on SOC_NRF52840_QIAA
```

## app/boards/arm/radiata/Kconfig.defconfig
```kconfig
#
# Copyright (c) 2025 Homerow
# SPDX-License-Identifier: MIT
#

if BOARD_RADIATA_LEFT

config ZMK_KEYBOARD_NAME
    default "Radiata"

config ZMK_SPLIT_ROLE_CENTRAL
    default y

endif # BOARD_RADIATA_LEFT

if BOARD_RADIATA_LEFT || BOARD_RADIATA_RIGHT

config BOARD
    default "radiata"

config ZMK_SPLIT
    default y

config BT_CTLR
    default BT

if USB

config USB_NRFX
    default y

config USB_DEVICE_STACK
    default y

endif # USB

config SPI
    default n

endif # BOARD_RADIATA_LEFT || BOARD_RADIATA_RIGHT
```

## app/boards/arm/radiata/radiata_left_defconfig
```kconfig
#
# Copyright (c) 2025 Homerow
# SPDX-License-Identifier: MIT
#

CONFIG_SOC_SERIES_NRF52X=y
CONFIG_SOC_NRF52840_QIAA=y
CONFIG_BOARD_RADIATA_LEFT=y

# Enable MPU
CONFIG_ARM_MPU=y

# enable GPIO
CONFIG_GPIO=y

# Enable writing to flash
CONFIG_USE_DT_CODE_PARTITION=y
CONFIG_MPU_ALLOW_FLASH_WRITE=y
CONFIG_NVS=y
CONFIG_SETTINGS_NVS=y
CONFIG_FLASH=y
CONFIG_FLASH_PAGE_LAYOUT=y
CONFIG_FLASH_MAP=y

# Disable 32kHz crystal
CONFIG_CLOCK_CONTROL_NRF_K32SRC_XTAL=n
CONFIG_CLOCK_CONTROL_NRF_K32SRC_150PPM=n

#Misc configuration
CONFIG_BT_CTLR_TX_PWR_PLUS_8=y
CONFIG_ZMK_HID_REPORT_TYPE_NKRO=y
CONFIG_ZMK_HID_CONSUMER_REPORT_USAGES_BASIC=y
CONFIG_BUILD_OUTPUT_UF2=y
CONFIG_ZMK_USB=y
CONFIG_ZMK_BLE=y
```

## app/boards/arm/retic1337_tkl/Kconfig.board
```kconfig
# nRF52840-KEYBOARD board configuration

config BOARD_RETIC1337_TKL
	bool "retic1337_tkl"
	depends on SOC_NRF52840_QIAA
```

## app/boards/arm/retic1337_tkl/Kconfig.defconfig
```kconfig
# retic1337_tkl board configuration

if BOARD_RETIC1337_TKL

config ZMK_KEYBOARD_NAME
    default "Test_Keyboard"

config I2C
	default y

config USB_NRFX
	default y

config USB_DEVICE_STACK
	default y

config BT_CTLR
	default BT

config ZMK_BLE
	default y

config ZMK_USB
	default y

config IS31FL3733
	default y

endif # BOARD_RETIC1337_TKL
```

## app/boards/arm/retic1337_tkl/retic1337_tkl_defconfig
```kconfig
CONFIG_SOC_SERIES_NRF52X=y
CONFIG_SOC_NRF52840_QIAA=y

# Enable MPU
CONFIG_ARM_MPU=y

# enable GPIO
CONFIG_GPIO=y

# Turn on logging, and set ZMK logging to debug output
CONFIG_LOG=y
CONFIG_ZMK_LOG_LEVEL_DBG=y

# Enable serial console
CONFIG_SERIAL=y
CONFIG_CONSOLE=y
CONFIG_UART_INTERRUPT_DRIVEN=y
CONFIG_UART_LINE_CTRL=y

# Enable USB UART, and set the console device
CONFIG_UART_CONSOLE=y

# additional board options
CONFIG_GPIO_AS_PINRESET=y

#I2C
CONFIG_I2C=y
CONFIG_I2C_NRFX=y
CONFIG_I2C_0=y
CONFIG_I2C_INIT_PRIORITY=60
CONFIG_IS31FL3733=y
CONFIG_SENSOR=y
CONFIG_BQ274XX=y
CONFIG_EC11=y
CONFIG_EC11_TRIGGER_GLOBAL_THREAD=y
CONFIG_ZMK_EXT_POWER=y
CONFIG_ZMK_IDLE_SLEEP_TIMEOUT=60000
CONFIG_DEVICE_POWER_MANAGEMENT=y
CONFIG_ZMK_SLEEP=y
```

## app/boards/arm/s40nc/Kconfig.board
```kconfig
# Copyright (c) 2021 The ZMK Contributors
# SPDX-License-Identifier: MIT

config BOARD_S40NC
	bool "S40NC"
	depends on SOC_NRF52840_QIAA
```

## app/boards/arm/s40nc/s40nc_defconfig
```kconfig
# Copyright (c) 2021 The ZMK Contributors
# SPDX-License-Identifier: MIT

CONFIG_SOC_SERIES_NRF52X=y
CONFIG_SOC_NRF52840_QIAA=y
CONFIG_BOARD_S40NC=y

# Enable MPU
CONFIG_ARM_MPU=y

# enable GPIO
CONFIG_GPIO=y

CONFIG_USE_DT_CODE_PARTITION=y

CONFIG_MPU_ALLOW_FLASH_WRITE=y
CONFIG_NVS=y
CONFIG_SETTINGS_NVS=y
CONFIG_FLASH=y
CONFIG_FLASH_PAGE_LAYOUT=y
CONFIG_FLASH_MAP=y
```

## app/boards/arm/sparkfun_micromod_nrf52840/Kconfig
```kconfig
# Copyright (c) 2021 The ZMK Contributors
# SPDX-License-Identifier: MIT

config BOARD_ENABLE_DCDC
	bool "Enable DCDC mode"
	select SOC_DCDC_NRF52X
	default y
	depends on (BOARD_SPARKFUN_MICROMOD_NRF52840)
```

## app/boards/arm/sparkfun_micromod_nrf52840/Kconfig.board
```kconfig
#Copyright(c) 2021 The ZMK Contributors
#SPDX - License - Identifier : MIT

config BOARD_SPARKFUN_MICROMOD_NRF52840
	bool "sparkfun_micromod_nrf52840"
	depends on SOC_NRF52840_QIAA
```

## app/boards/arm/sparkfun_micromod_nrf52840/Kconfig.defconfig
```kconfig
#Copyright(c) 2021 The ZMK Contributors
#SPDX - License - Identifier : MIT

if BOARD_SPARKFUN_MICROMOD_NRF52840

	config BOARD default "sparkfun_micromod_nrf52480"

    if USB

        config USB_NRFX default y

		config USB_DEVICE_STACK default y

	endif #USB

    config BT_CTLR default BT

	config ZMK_BLE default y

	config ZMK_USB default y

endif #BOARD_SPARKFUN_MICROMOD_NRF52840
```

## app/boards/arm/sparkfun_micromod_nrf52840/sparkfun_micromod_nrf52840_defconfig
```kconfig
# Copyright (c) 2021 The ZMK Contributors
# SPDX-License-Identifier: MIT


CONFIG_SOC_SERIES_NRF52X=y
CONFIG_SOC_NRF52840_QIAA=y
CONFIG_BOARD_SPARKFUN_MICROMOD_NRF52840=y

# Enable MPU
CONFIG_ARM_MPU=y

# enable GPIO
CONFIG_GPIO=y


CONFIG_ZMK_DISPLAY=y
CONFIG_LVGL_USE_THEME_MONO=y
CONFIG_LVGL_COLOR_TRANSP_CUSTOM=y
CONFIG_LVGL_CUSTOM_COLOR_TRANSP_RED=0x00
CONFIG_LVGL_CUSTOM_COLOR_TRANSP_GREEN=0x00
CONFIG_LVGL_CUSTOM_COLOR_TRANSP_BLUE=0x00



CONFIG_USE_DT_CODE_PARTITION=y

CONFIG_MPU_ALLOW_FLASH_WRITE=y
CONFIG_NVS=y
CONFIG_SETTINGS_NVS=y
CONFIG_FLASH=y
CONFIG_FLASH_PAGE_LAYOUT=y
CONFIG_FLASH_MAP=y                      
```

## app/boards/arm/tofu/Kconfig.board
```kconfig
# Copyright (c) 2022 Pete Johanson
# SPDX-License-Identifier: Apache-2.0

config BOARD_TOFU65_V2
    bool "Kbdfans Tofu65 2.0"
    depends on SOC_RP2040
```

## app/boards/arm/tofu/Kconfig.defconfig
```kconfig
# Copyright (c) 2022 Peter Johanson
# SPDX-License-Identifier: Apache-2.0

if BOARD_TOFU65_V2

config ZMK_KEYBOARD_NAME
    default "kbdfans_tofu65"

config RP2_FLASH_W25Q080
    default y

config ZMK_USB
    default y

endif # BOARD_TOFU65_V2
```

## app/boards/arm/tornblue/Kconfig.board
```kconfig
# tornblue board configuration

# Copyright (c) 2021 Richard Titmuss
# SPDX-License-Identifier: MIT

config BOARD_TORNBLUE_LEFT
	bool "tornblue_left"
	depends on SOC_NRF52840_QIAA

config BOARD_TORNBLUE_RIGHT
	bool "tornblue_right"
	depends on SOC_NRF52840_QIAA
```

## app/boards/arm/tornblue/Kconfig.defconfig
```kconfig
if BOARD_TORNBLUE_LEFT

config ZMK_KEYBOARD_NAME
    default "Tornblue Left"

config ZMK_SPLIT_BLE_ROLE_CENTRAL
    default y

endif

if BOARD_TORNBLUE_RIGHT

config ZMK_KEYBOARD_NAME
    default "Tornblue Right"

endif

if BOARD_TORNBLUE_LEFT || BOARD_TORNBLUE_RIGHT

config ZMK_SPLIT
    default y

if USB

config USB_NRFX
	default y

config USB_DEVICE_STACK
	default y

endif # USB

config BT_CTLR
	default BT

config ZMK_BLE
	default y

config ZMK_USB
	default y

config ZMK_BATTERY_VOLTAGE_DIVIDER
	default y

endif
```

## app/boards/arm/tornblue/tornblue_left_defconfig
```kconfig
CONFIG_SOC_SERIES_NRF52X=y
CONFIG_SOC_NRF52840_QIAA=y
CONFIG_BOARD_TORNBLUE_LEFT=y

# Enable MPU
CONFIG_ARM_MPU=y

# enable GPIO
CONFIG_GPIO=y

CONFIG_USE_DT_CODE_PARTITION=y
CONFIG_BUILD_OUTPUT_UF2=y

CONFIG_MPU_ALLOW_FLASH_WRITE=y
CONFIG_NVS=y
CONFIG_SETTINGS_NVS=y
CONFIG_FLASH=y
CONFIG_FLASH_PAGE_LAYOUT=y
CONFIG_FLASH_MAP=y

CONFIG_ZMK_RGB_UNDERGLOW=y
CONFIG_WS2812_STRIP=y

CONFIG_EC11=y
CONFIG_EC11_TRIGGER_GLOBAL_THREAD=y

# Turn on logging, and set ZMK logging to debug output
#CONFIG_ZMK_USB_LOGGING=y

#CONFIG_ZMK_BLE_CLEAR_BONDS_ON_START=y
```

## app/boards/arm/tr60/Kconfig.board
```kconfig
# Copyright (c) 2023 Srishtik Bhandarkar
# SPDX-License-Identifier: MIT

config BOARD_TR60
    bool "TR60"
    depends on SOC_NRF52840_QIAA
```

## app/boards/arm/tr60/Kconfig.defconfig
```kconfig
# Copyright (c) 2023 Srishtik Bhandarkar
# SPDX-License-Identifier: MIT

if BOARD_TR60
config ZMK_KEYBOARD_NAME
    default "tr60"

if USB_DEVICE_STACK

config USB_NRFX
    default y

endif # USB_DEVICE_STACK

config BT_CTLR
    default BT

config ZMK_BLE
    default y

config ZMK_USB
    default y

endif # BOARD_TR60
```

## app/boards/arm/tr60/tr60_defconfig
```kconfig
# Copyright (c) 2023 Srishtik Bhandarkar
# SPDX-License-Identifier: MIT

CONFIG_SOC_SERIES_NRF52X=y
CONFIG_SOC_NRF52840_QIAA=y
CONFIG_BOARD_TR60=y

# Enable MPU
CONFIG_ARM_MPU=y

CONFIG_PINCTRL=y

# enable GPIO
CONFIG_GPIO=y

# Use code partition for uf2 bootloader and enable conversion of hex to uf2
CONFIG_USE_DT_CODE_PARTITION=y
CONFIG_BUILD_OUTPUT_UF2=y

CONFIG_MPU_ALLOW_FLASH_WRITE=y
CONFIG_NVS=y
CONFIG_SETTINGS_NVS=y
CONFIG_FLASH=y
CONFIG_FLASH_PAGE_LAYOUT=y
CONFIG_FLASH_MAP=y

# Uncomment for usb logging
# CONFIG_ZMK_USB_LOGGING=y
```

## app/boards/arm/waveshare_rp2040_zero/Kconfig.board
```kconfig
# Copyright (c) 2024 The ZMK Contributors
# SPDX-License-Identifier: Apache-2.0

config BOARD_WAVESHARE_RP2040_ZERO
    bool "Waveshare RP2040 Zero Board"
    depends on SOC_RP2040
```

/*
 * Copyright (c) 2021 Rafael Yumagulov
 *
 * SPDX-License-Identifier: MIT
 */

#include "dao.dtsi"

&kscan0 {
	col-gpios
		= <&gpio0 12 GPIO_ACTIVE_HIGH>
		, <&gpio1  9 GPIO_ACTIVE_HIGH>
		, <&gpio0  8 GPIO_ACTIVE_HIGH>
		, <&gpio0 13 GPIO_ACTIVE_HIGH>
		, <&gpio0 15 GPIO_ACTIVE_HIGH>
		, <&gpio0 20 GPIO_ACTIVE_HIGH>
		;
};

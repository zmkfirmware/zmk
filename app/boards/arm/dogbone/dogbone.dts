/*
 * Copyright (c) 2021 The ZMK Contributors
 *
 * SPDX-License-Identifier: MIT
 */

/dts-v1/;
#include "dogbone.dtsi"

/ {
	ext-power {
		compatible = "zmk,ext-power-generic";
		label = "EXT_POWER";
		control-gpios = <&gpio1 9 GPIO_ACTIVE_LOW>;
	};

	vbatt {
		compatible = "zmk,battery-voltage-divider";
		label = "BATTERY";
		io-channels = <&adc 2>;
		output-ohms = <2000000>;
		full-ohms = <(2000000 + 820000)>;
	};
};

## app/boards/arm/dogbone/Kconfig.board
```kconfig
# dogbone board configuration

# Copyright (c) 2021 The ZMK Contributors
# SPDX-License-Identifier: MIT

config BOARD_DOGBONE
	bool "dogbone"
	depends on SOC_NRF52840_QIAA
```

## app/boards/arm/dogbone/Kconfig.defconfig
```kconfig
# Copyright (c) 2021 The ZMK Contributors
# SPDX-License-Identifier: MIT

if BOARD_DOGBONE

config BOARD
	default "dogbone"

if USB

config USB_NRFX
	default y

config USB_DEVICE_STACK
	default y

endif # USB

config BT_CTLR
	default BT

config ZMK_BLE
	default y

config ZMK_USB
	default y

config ZMK_BATTERY_VOLTAGE_DIVIDER
	default y

endif # BOARD_DOGBONE
```

## app/boards/arm/dz60rgb/Kconfig.board
```kconfig
# Copyright (c) 2020 The ZMK Contributors
# SPDX-License-Identifier: MIT

config BOARD_DZ60RGB_REV1
	bool "DZ60RGB Keyboard"
	depends on SOC_STM32F303XC
```

## app/boards/arm/dz60rgb/Kconfig.defconfig
```kconfig
# DZ60RGB keyboard configuration

# Copyright (c) 2020 The ZMK Contributors
# SPDX-License-Identifier: MIT

if BOARD_DZ60RGB_REV1

config ZMK_KEYBOARD_NAME
    default "DZ60RGB Rev 1"

endif # BOARD_DZ60RGB_REV1
```

## app/boards/arm/ferris/Kconfig.board
```kconfig
# Ferris board configuration

# Copyright (c) 2020 The ZMK Contributors
# SPDX-License-Identifier: MIT

config BOARD_FERRIS
	bool "Ferris rev 0.2"
	depends on SOC_STM32F072XB
```

## app/boards/arm/ferris/Kconfig.defconfig
```kconfig
# Ferris board configuration

# Copyright (c) 2020 The ZMK Contributors
# SPDX-License-Identifier: MIT

if BOARD_FERRIS

config BOARD
    default "ferris_rev02"

config ZMK_KEYBOARD_NAME
    default "Ferris rev 0.2"

config ZMK_KSCAN_MATRIX_POLLING
    default y

endif # BOARD_FERRIS
```

## app/boards/arm/ferris/ferris_rev02_defconfig
```kconfig
# SPDX-License-Identifier: MIT

CONFIG_BOARD_FERRIS=y
CONFIG_SOC_SERIES_STM32F0X=y
CONFIG_SOC_STM32F072XB=y
# 48MHz system clock
CONFIG_SYS_CLOCK_HW_CYCLES_PER_SEC=48000000

# enable PINMUX
CONFIG_PINCTRL=y

# enable GPIO
CONFIG_GPIO=y

# Enable i2c
CONFIG_I2C=y

# ZMK Settings
CONFIG_ZMK_USB=y
CONFIG_ZMK_KSCAN_MATRIX_POLLING=y
CONFIG_USB_SELF_POWERED=n

# Enable IO multiplexer
CONFIG_GPIO_MCP23017=y

# Needed to reduce this to size that will fit on F072
CONFIG_HEAP_MEM_POOL_SIZE=1024

# clock configuration
CONFIG_CLOCK_CONTROL=y
```

## app/boards/arm/gl75/Kconfig.board
```kconfig
# BT60 board configuration

# Copyright (c) 2021 Polarity Works
# SPDX-License-Identifier: MIT

config BOARD_GL75_V1
    bool "gl75"
    depends on SOC_NRF52840_QIAA

config BOARD_GL75_V1_HS
    bool "gl75 hotswap"
    depends on SOC_NRF52840_QIAA
```

## app/boards/arm/gl75/Kconfig.defconfig
```kconfig
# Copyright (c) 2021 Polarity Works
# SPDX-License-Identifier: MIT

if BOARD_GL75_V1_HS || BOARD_GL75_V1

config BOARD
    default "gl75"

if USB

config USB_NRFX
    default y

config USB_DEVICE_STACK
    default y

endif # USB

config BT_CTLR
    default BT

config ZMK_KEYBOARD_NAME
    default "GL75"

endif # BOARD_GL75
```

## app/boards/arm/glove80/Kconfig
```kconfig
# Copyright (c) 2021 The ZMK Contributors
# SPDX-License-Identifier: MIT

config BOARD_ENABLE_DCDC
    bool "Enable DCDC mode"
    select SOC_DCDC_NRF52X
    default y
    depends on (BOARD_GLOVE80_LH || BOARD_GLOVE80_RH)
```

## app/boards/arm/glove80/Kconfig.board
```kconfig
# Copyright (c) 2021 The ZMK Contributors
# SPDX-License-Identifier: MIT

config BOARD_GLOVE80_LH
    bool "Glove80 LH"
    depends on SOC_NRF52840_QIAA

config BOARD_GLOVE80_RH
    bool "Glove80 RH"
    depends on SOC_NRF52840_QIAA
```

## app/boards/arm/glove80/Kconfig.defconfig
```kconfig
# Copyright (c) 2021 The ZMK Contributors
# SPDX-License-Identifier: MIT

if BOARD_GLOVE80_LH

config BOARD
    default "glove80 lh"

config ZMK_SPLIT_BLE_ROLE_CENTRAL
    default y

endif # BOARD_GLOVE80_LH

if BOARD_GLOVE80_RH

config BOARD
    default "glove80 rh"

endif # BOARD_GLOVE80_RH

if BOARD_GLOVE80_LH || BOARD_GLOVE80_RH

config ZMK_SPLIT
    default y

config BT_CTLR
    default BT

config ZMK_KSCAN_MATRIX_WAIT_BETWEEN_OUTPUTS
    default 5

config PINCTRL
    default y

if USB

config USB_NRFX
    default y

config USB_DEVICE_STACK
    default y

endif # USB

if ZMK_BACKLIGHT

config PWM
    default y

config LED_PWM
    default y

endif # ZMK_BACKLIGHT

if ZMK_RGB_UNDERGLOW

config SPI
    default y

config WS2812_STRIP
    default y

endif # ZMK_RGB_UNDERGLOW

endif # BOARD_GLOVE80_LH || BOARD_GLOVE80_RH
```

## app/boards/arm/glove80/glove80_lh_defconfig
```kconfig
# SPDX-License-Identifier: MIT

CONFIG_SOC_SERIES_NRF52X=y
CONFIG_SOC_NRF52840_QIAA=y
CONFIG_BOARD_GLOVE80_LH=y

# Keyboard IDs
CONFIG_ZMK_KEYBOARD_NAME="Glove80 Left"
CONFIG_USB_DEVICE_PID=0x27db
CONFIG_USB_DEVICE_VID=0x16c0
CONFIG_USB_DEVICE_MANUFACTURER="MoErgo"
CONFIG_USB_DEVICE_SN="moergo.com:GLV80-0123456789ABCDEF"

CONFIG_BT_DIS_PNP_PID=0x27db
CONFIG_BT_DIS_PNP_VID=0x16c0
CONFIG_BT_DIS_MANUF="MoErgo"
CONFIG_BT_DIS_MODEL="Glove80"

# Enable MPU
CONFIG_ARM_MPU=y

# Enable GPIO
CONFIG_GPIO=y

# Build configurations
CONFIG_BUILD_OUTPUT_UF2=y
CONFIG_BUILD_OUTPUT_UF2_FAMILY_ID="0x9807B007"
CONFIG_USE_DT_CODE_PARTITION=y

# Flash configuration
CONFIG_MPU_ALLOW_FLASH_WRITE=y
CONFIG_NVS=y
CONFIG_SETTINGS_NVS=y
CONFIG_FLASH=y
CONFIG_FLASH_PAGE_LAYOUT=y
CONFIG_FLASH_MAP=y

# Enable 32kHz crystal
CONFIG_CLOCK_CONTROL_NRF_K32SRC_XTAL=y

# Enable RGB underglow
CONFIG_ZMK_RGB_UNDERGLOW=y
CONFIG_WS2812_STRIP=y
CONFIG_SPI=y

# disable EXT_POWER until underglow gets turned on
CONFIG_ZMK_EXT_POWER_START=n

CONFIG_ZMK_RGB_UNDERGLOW_EXT_POWER=y
CONFIG_ZMK_RGB_UNDERGLOW_ON_START=n
CONFIG_ZMK_RGB_UNDERGLOW_BRT_STEP=4
CONFIG_ZMK_RGB_UNDERGLOW_BRT_MIN=4

# DO NOT CHANGE CONFIG_ZMK_RGB_UNDERGLOW_BRT_MAX TO ABOVE 80. Configuring
# BRT_MAX above 80% will draw additional current and can potentially damage your
# computer. WARRANTY IS VOID IF BRT_MAX SET ABOVE 80.
CONFIG_ZMK_RGB_UNDERGLOW_BRT_MAX=80

CONFIG_ZMK_RGB_UNDERGLOW_EFF_START=3
CONFIG_ZMK_RGB_UNDERGLOW_HUE_START=285
CONFIG_ZMK_RGB_UNDERGLOW_SAT_START=75
CONFIG_ZMK_RGB_UNDERGLOW_BRT_START=16

# The power LED is implemented as a backlight
# For now, the power LED is acting as a "USB connected" indicator
CONFIG_ZMK_BACKLIGHT=y
CONFIG_ZMK_BACKLIGHT_ON_START=y
CONFIG_ZMK_BACKLIGHT_BRT_START=5
CONFIG_ZMK_BACKLIGHT_AUTO_OFF_IDLE=y
CONFIG_ZMK_BACKLIGHT_AUTO_OFF_USB=y

# The full two-byte consumer report space has compatibility issues with some
# operating systems, most notably macOS. Use the more basic single-byte usage
# space.
CONFIG_ZMK_HID_CONSUMER_REPORT_USAGES_BASIC=y

# Default to no logging
CONFIG_ZMK_USB_LOGGING=n

CONFIG_ZMK_USB_BOOT=y

# Turn on debugging to disable optimization
CONFIG_DEBUG=n
```

## app/boards/arm/glove80/glove80_rh_defconfig
```kconfig
# Copyright (c) 2021 The ZMK Contributors
# SPDX-License-Identifier: MIT

CONFIG_SOC_SERIES_NRF52X=y
CONFIG_SOC_NRF52840_QIAA=y
CONFIG_BOARD_GLOVE80_RH=y

# Enable both USB and BLE
CONFIG_ZMK_USB=y
CONFIG_ZMK_BLE=y

# Keyboard IDs
CONFIG_ZMK_KEYBOARD_NAME="Glove80 Right"
CONFIG_USB_DEVICE_PID=0x27d9
CONFIG_USB_DEVICE_VID=0x16c0
CONFIG_USB_DEVICE_MANUFACTURER="MoErgo"
CONFIG_USB_DEVICE_SN="moergo.com:GLV80-0123456789ABCDEF"

CONFIG_BT_DIS_PNP_PID=0x27d9
CONFIG_BT_DIS_PNP_VID=0x16c0
CONFIG_BT_DIS_MANUF="MoErgo"
CONFIG_BT_DIS_MODEL="Glove80 Right"

CONFIG_BT_CTLR_TX_PWR_PLUS_8=y

# Enable MPU
CONFIG_ARM_MPU=y

# Enable GPIO
CONFIG_GPIO=y

# Build configurations
CONFIG_BUILD_OUTPUT_UF2=y
CONFIG_BUILD_OUTPUT_UF2_FAMILY_ID="0x9808B007"
CONFIG_USE_DT_CODE_PARTITION=y

# Flash configuration
CONFIG_MPU_ALLOW_FLASH_WRITE=y
CONFIG_NVS=y
CONFIG_SETTINGS_NVS=y
CONFIG_FLASH=y
CONFIG_FLASH_PAGE_LAYOUT=y
CONFIG_FLASH_MAP=y

# Enable 32kHz crystal
CONFIG_CLOCK_CONTROL_NRF_K32SRC_XTAL=y

# Enable RGB underglow
CONFIG_ZMK_RGB_UNDERGLOW=y

CONFIG_ZMK_RGB_UNDERGLOW_EXT_POWER=y
CONFIG_ZMK_RGB_UNDERGLOW_ON_START=n
CONFIG_ZMK_RGB_UNDERGLOW_BRT_STEP=4
CONFIG_ZMK_RGB_UNDERGLOW_BRT_MIN=4

# DO NOT CHANGE CONFIG_ZMK_RGB_UNDERGLOW_BRT_MAX TO ABOVE 80. Configuring
# BRT_MAX above 80% will draw additional current and can potentially damage your
# computer. WARRANTY IS VOID IF BRT_MAX SET ABOVE 80.
CONFIG_ZMK_RGB_UNDERGLOW_BRT_MAX=80

CONFIG_ZMK_RGB_UNDERGLOW_EFF_START=3
CONFIG_ZMK_RGB_UNDERGLOW_HUE_START=285
CONFIG_ZMK_RGB_UNDERGLOW_SAT_START=75
CONFIG_ZMK_RGB_UNDERGLOW_BRT_START=16

# The power LED is implemented as a backlight
# For now, the power LED is acting as a "USB connected" indicator
CONFIG_ZMK_BACKLIGHT=y
CONFIG_ZMK_BACKLIGHT_ON_START=y
CONFIG_ZMK_BACKLIGHT_BRT_START=5
CONFIG_ZMK_BACKLIGHT_AUTO_OFF_IDLE=y
CONFIG_ZMK_BACKLIGHT_AUTO_OFF_USB=y

# The full two-byte consumer report space has compatibility issues with some
# operating systems, most notably macOS. Use the more basic single-byte usage
# space.
CONFIG_ZMK_HID_CONSUMER_REPORT_USAGES_BASIC=y

# Turn on debugging to disable optimization. Debug messages can result in larger
# stacks, so enable stack protection and particularly a larger BLE peripheral stack.
# CONFIG_DEBUG=y
# CONFIG_DEBUG_THREAD_INFO=y
# CONFIG_EXCEPTION_STACK_TRACE=y
# CONFIG_HW_STACK_PROTECTION=y
# CONFIG_ZMK_SPLIT_BLE_PERIPHERAL_STACK_SIZE=1300

# Log via USB or Segger RTT
CONFIG_ZMK_USB_LOGGING=n
CONFIG_ZMK_RTT_LOGGING=n
```

## app/boards/arm/glove80_v0/Kconfig.board
```kconfig
# nice!nano board configuration

# Copyright (c) 2020 Pete Johanson
# SPDX-License-Identifier: MIT

config BOARD_GLOVE80_V0_LH
	bool "Glove80 v0 LH"
	depends on SOC_NRF52840_QIAA

config BOARD_GLOVE80_V0_RH
	bool "Glove80 v0 RH"
	depends on SOC_NRF52840_QIAA
```

## app/boards/arm/glove80_v0/Kconfig.defconfig
```kconfig
# Copyright (c) 2021 The ZMK Contributors
# SPDX-License-Identifier: MIT

if BOARD_GLOVE80_V0_LH
config BOARD
	default "glove80 v0 lh"

config ZMK_SPLIT_BLE_ROLE_CENTRAL
	default y

config ZMK_KEYBOARD_NAME
	default "Glove80 V0 Left"
endif # BOARD_GLOVE80_V0_LH

if BOARD_GLOVE80_V0_RH
config BOARD
	default "glove80 v0 rh"

config ZMK_KEYBOARD_NAME
	default "Glove80 V0 Right"
endif # BOARD_GLOVE80_V0_RH

if BOARD_GLOVE80_V0_LH || BOARD_GLOVE80_V0_RH

config ZMK_SPLIT
	default y

config BT_CTLR
	default BT

config ZMK_BLE
	default y

config ZMK_USB
	default y

config ZMK_BATTERY_VOLTAGE_DIVIDER
	default y
	
config ZMK_BATTERY_NRF_VDDH
	default y

if USB

config USB_NRFX
	default y

config USB_DEVICE_STACK
	default y

endif # USB

if ZMK_BACKLIGHT

config PWM
    default y

config LED_PWM
    default y

endif # ZMK_BACKLIGHT

endif # BOARD_GLOVE80_V0_LH || BOARD_GLOVE80_V0_RH
```

## app/boards/arm/glove80_v0/glove80_v0_lh_defconfig
```kconfig
# SPDX-License-Identifier: MIT

CONFIG_SOC_SERIES_NRF52X=y
CONFIG_SOC_NRF52840_QIAA=y
CONFIG_BOARD_GLOVE80_V0_LH=y

# Enable MPU
CONFIG_ARM_MPU=y

# enable GPIO
CONFIG_GPIO=y

CONFIG_BUILD_OUTPUT_UF2=y

CONFIG_USE_DT_CODE_PARTITION=y

CONFIG_MPU_ALLOW_FLASH_WRITE=y
CONFIG_NVS=y
CONFIG_SETTINGS_NVS=y
CONFIG_FLASH=y
CONFIG_FLASH_PAGE_LAYOUT=y
CONFIG_FLASH_MAP=y

# Enable RGB underglow
CONFIG_ZMK_RGB_UNDERGLOW=y
CONFIG_WS2812_STRIP=y
CONFIG_SPI=y

CONFIG_ZMK_RGB_UNDERGLOW_ON_START=n
CONFIG_ZMK_RGB_UNDERGLOW_EXT_POWER=y
CONFIG_ZMK_RGB_UNDERGLOW_BRT_STEP=4

CONFIG_ZMK_RGB_UNDERGLOW_EFF_START=3
CONFIG_ZMK_RGB_UNDERGLOW_HUE_START=285
CONFIG_ZMK_RGB_UNDERGLOW_SAT_START=75
CONFIG_ZMK_RGB_UNDERGLOW_BRT_START=20

# The power LED is implemented as a backlight
CONFIG_ZMK_BACKLIGHT=y
CONFIG_ZMK_BACKLIGHT_ON_START=y
CONFIG_ZMK_BACKLIGHT_BRT_START=5
CONFIG_ZMK_BACKLIGHT_AUTO_OFF_IDLE=y
CONFIG_ZMK_BACKLIGHT_AUTO_OFF_USB=y

# Turn on logging, and set ZMK logging to debug output
# Only for debugging
CONFIG_ZMK_USB_LOGGING=n

# Turn on debugging to disable optimization
CONFIG_DEBUG=n
```

## app/boards/arm/hallie/Kconfig.board
```kconfig
config BOARD_HALLIE_LEFT
	bool "hallie_left"
	depends on SOC_NRF52840_QIAA

config BOARD_HALLIE_RIGHT
	bool "hallie_right"
	depends on SOC_NRF52840_QIAA

config TEST_MODE
	bool "test_mode"
```

## app/boards/arm/hallie/Kconfig.defconfig
```kconfig
config BOARD
	default "hallie"

config ZMK_SPLIT
	default y

menuconfig SENSOR
	bool "Sensor Drivers"

config ZMK_BLE
	default y

config BT_CTLR
	default BT

config ZMK_BATTERY_VOLTAGE_DIVIDER
	default y

if USB
	config USB_NRFX
		default y

	config USB_DEVICE_STACK
		default y
endif # USB


if BOARD_HALLIE_LEFT
	config ZMK_KEYBOARD_NAME
		default "Hallie"

	config ZMK_USB
		default y
endif # BOARD_HALLIE_LEFT
```

## app/boards/arm/hallie/hallie_test_defconfig
```kconfig
CONFIG_ZMK_SPLIT=y
CONFIG_BOARD_HALLIE_LEFT=y
CONFIG_ZMK_SPLIT_ROLE_CENTRAL=y

CONFIG_TEST_MODE=y

CONFIG_SOC_SERIES_NRF52X=y
CONFIG_SOC_NRF52840_QIAA=y
CONFIG_BUILD_OUTPUT_UF2=y

CONFIG_ARM_MPU=y
CONFIG_PINCTRL=y
CONFIG_GPIO=y
CONFIG_LED=y

CONFIG_USE_DT_CODE_PARTITION=y

CONFIG_MPU_ALLOW_FLASH_WRITE=y
CONFIG_NVS=y
CONFIG_SETTINGS_NVS=y
CONFIG_FLASH=y
CONFIG_FLASH_PAGE_LAYOUT=y
CONFIG_FLASH_MAP=y
CONFIG_CLOCK_CONTROL_NRF=y
CONFIG_CLOCK_CONTROL_NRF_K32SRC_RC=y

CONFIG_EC11=y
CONFIG_EC11_TRIGGER_GLOBAL_THREAD=y

CONFIG_ZMK_SETTINGS_RESET_ON_START=y

CONFIG_ZMK_USB_LOGGING=y

CONFIG_ZMK_IDLE_TIMEOUT=30000
CONFIG_ZMK_SLEEP=y
CONFIG_ZMK_IDLE_SLEEP_TIMEOUT=300000

CONFIG_ZMK_SPLIT_BLE_CENTRAL_BATTERY_LEVEL_FETCHING=y
CONFIG_ZMK_SPLIT_BLE_CENTRAL_BATTERY_LEVEL_PROXY=y

CONFIG_ZMK_LED_WIDGETS=y

CONFIG_ZMK_SPLIT_PERIPHERAL_HID_INDICATORS=y
```

## app/boards/arm/hannah60_b/Kconfig
```kconfig
# Copyright (c) 2022 The ZMK Contributors
# SPDX-License-Identifier: MIT

config BOARD_ENABLE_DCDC
	bool "Enable DCDC mode"
	select SOC_DCDC_NRF52X
	default y
	depends on BOARD_HANNAH60_B
```

## app/boards/arm/hannah60_b/Kconfig.board
```kconfig
# Copyright (c) 2022 The ZMK Contributors
# SPDX-License-Identifier: MIT

config BOARD_HANNAH60_B
	bool "Hannah60_B"
	depends on SOC_NRF52840_QIAA
```

## app/boards/arm/hannah60_b/Kconfig.defconfig
```kconfig
# Copyright (c) 2022 The ZMK Contributors
# SPDX-License-Identifier: MIT

if BOARD_HANNAH60_B

config ZMK_KEYBOARD_NAME
	default "Hannah60_B"

if USB_DEVICE_STACK

config USB_NRFX
	default y

endif # USB_DEVICE_STACK

config BT_CTLR
	default BT

config ZMK_BLE
	default y

config ZMK_USB
	default y

endif # BOARD_HANNAH60_B
```

## app/boards/arm/harper/Kconfig.board
```kconfig
config BOARD_HARPER_LEFT
	bool "harper_left"
	depends on SOC_NRF52840_QIAA

config BOARD_HARPER_RIGHT
	bool "harper_right"
	depends on SOC_NRF52840_QIAA

config TEST_MODE
	bool "test_mode"
```

## app/boards/arm/harper/Kconfig.defconfig
```kconfig
config BOARD
	default "harper"

config ZMK_SPLIT
	default y

menuconfig SENSOR
	bool "Sensor Drivers"

config ZMK_BLE
	default y

config BT_CTLR
	default BT

config ZMK_BATTERY_VOLTAGE_DIVIDER
	default y

if USB
	config USB_NRFX
		default y

	config USB_DEVICE_STACK
		default y
endif # USB



if BOARD_HARPER_LEFT
	config ZMK_KEYBOARD_NAME
		default "Harper"

	config ZMK_USB
		default y
endif # BOARD_HARPER_LEFT
```

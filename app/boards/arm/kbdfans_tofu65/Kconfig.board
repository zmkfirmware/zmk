## app/boards/arm/kbdfans_tofu65/Kconfig.board
```kconfig
# Copyright (c) 2023 The ZMK Contributors
# SPDX-License-Identifier: Apache-2.0

config BOARD_KBDFANS_TOFU65_V2
    bool "KBDfans Tofu65 2.0"
    depends on SOC_RP2040
```

## app/boards/arm/kbdfans_tofu65/Kconfig.defconfig
```kconfig
# Copyright (c) 2023 The ZMK Contributors
# SPDX-License-Identifier: MIT

if BOARD_KBDFANS_TOFU65_V2

config ZMK_KEYBOARD_NAME
    default "kbdfans tofu65"

config RP2_FLASH_W25Q080
    default y

endif # BOARD_KBDFANS_TOFU65_V2
```

## app/boards/arm/kbdfans_tofu65/kbdfans_tofu65_v2_defconfig
```kconfig
# Copyright (c) 2023 The ZMK Contributors
# SPDX-License-Identifier: MIT

CONFIG_SOC_SERIES_RP2XXX=y
CONFIG_SOC_RP2040=y
CONFIG_BOARD_KBDFANS_TOFU65_V2=y

CONFIG_SYS_CLOCK_HW_CYCLES_PER_SEC=125000000

# Enable USB CDC ACM logging for debugging
# CONFIG_ZMK_USB_LOGGING=y

# Enable reset by default
CONFIG_RESET=y

# Code partition needed to target the correct flash range
CONFIG_USE_DT_CODE_PARTITION=y

# Output UF2 by default, native bootloader supports it.
CONFIG_BUILD_OUTPUT_UF2=y

CONFIG_ZMK_USB=y
```

## app/boards/arm/lake65/Kconfig.board
```kconfig
# Copyright (c) 2021 Nick Winans
# SPDX-License-Identifier: MIT

config BOARD_LAKE65
	bool "lake65"
	depends on SOC_NRF52840_QIAA
```

## app/boards/arm/lake65/Kconfig.defconfig
```kconfig
# Copyright (c) 2021 Nick Winans
# SPDX-License-Identifier: MIT

if BOARD_LAKE65

config ZMK_KEYBOARD_NAME
	default "lake65"

if USB

config USB_NRFX
	default y

config USB_DEVICE_STACK
	default y

endif # USB

config BT_CTLR
	default BT

config ZMK_BLE
	default y

config ZMK_USB
	default y

config ZMK_BATTERY_VOLTAGE_DIVIDER
	default y
	
if ZMK_BACKLIGHT

config PWM
    default y

config LED_PWM
    default y

endif # ZMK_BACKLIGHT
CONFIG_ZMK_HID_REPORT_TYPE_NKRO=y

endif # BOARD_LAKE65
```

## app/boards/arm/mdbt50q/Kconfig.board
```kconfig
# Maker Diary nrf52840 M.2 board configuration

# Copyright (c) 2020 The ZMK Contributors
# SPDX-License-Identifier: MIT

config BOARD_MDBT50Q
  bool "mdbt50q"
  depends on SOC_NRF52840_QIAA
```

## app/boards/arm/mdbt50q/Kconfig.defconfig
```kconfig
# Copyright (c) 2020 The ZMK Contributors
# SPDX-License-Identifier: MIT

if BOARD_MDBT50Q

config BOARD
  default "mdbt50q"

if USB

config USB_NRFX
  default y

config USB_DEVICE_STACK
  default y

endif # USB

config BT_CTLR
  default BT

config ZMK_BLE
  default y

config ZMK_USB
  default n

config ZMK_SLEEP
  default y

endif # BOARD_MDBT50Q
```

## app/boards/arm/mdbt50q/mdbt50q_defconfig
```kconfig
# Copyright (c) 2020 The ZMK Contributors
# SPDX-License-Identifier: MIT

CONFIG_SOC_SERIES_NRF52X=y
CONFIG_SOC_NRF52840_QIAA=y
CONFIG_BOARD_MDBT50Q=y

# Enable MPU
CONFIG_ARM_MPU=y

# enable GPIO
CONFIG_GPIO=y

CONFIG_USE_DT_CODE_PARTITION=y

CONFIG_MPU_ALLOW_FLASH_WRITE=y
CONFIG_NVS=y
CONFIG_SETTINGS_NVS=y
CONFIG_FLASH=y
CONFIG_FLASH_PAGE_LAYOUT=y
CONFIG_FLASH_MAP=y

CONFIG_CLOCK_CONTROL_NRF=y
CONFIG_CLOCK_CONTROL_NRF_K32SRC_RC=y

#CONFIG_SERIAL=y

#CONFIG_CONSOLE=y
#CONFIG_UART_CONSOLE=y

CONFIG_GPIO_AS_PINRESET=y

#CONFIG_BT_DEBUG_LOG=y
#CONFIG_LOG=y
#CONFIG_ZMK_LOG_LEVEL_DBG=y
#CONFIG_NVS_LOG_LEVEL_DBG=y
#CONFIG_USB=n
#CONFIG_HWINFO=y
```

## app/boards/arm/mikoto/Kconfig
```kconfig
config BOARD_ENABLE_DCDC
	bool "Enable DCDC mode"
	select SOC_DCDC_NRF52X
	default y
	depends on (BOARD_MIKOTO_520)

choice BOARD_MIKOTO_CHARGER_CURRENT
    prompt "Charge current to supply to attached batteries"
	depends on (BOARD_MIKOTO_520)

config BOARD_MIKOTO_CHARGER_CURRENT_40MA
    bool "40mA charge current, for battery capacity 40mAh or higher"

config BOARD_MIKOTO_CHARGER_CURRENT_100MA
    bool "100mA charge current, for battery capacity 100mAh or higher"

config BOARD_MIKOTO_CHARGER_CURRENT_150MA
    bool "150mA charge current, for battery capacity 150mAh or higher"

config BOARD_MIKOTO_CHARGER_CURRENT_250MA
    bool "250mA charge current, for battery capacity 250mAh or higher"

config BOARD_MIKOTO_CHARGER_CURRENT_350MA
    bool "350mA charge current, for battery capacity 350mAh or higher"

config BOARD_MIKOTO_CHARGER_CURRENT_NONE
    bool "Disable charge current"

endchoice
```

## app/boards/arm/mikoto/Kconfig.board
```kconfig
# mikoto board configuration

# Copyright (c) 2020 The ZMK Contributors
# SPDX-License-Identifier: MIT

config BOARD_MIKOTO
    bool "mikoto"
    depends on SOC_NRF52840_QIAA
```

## app/boards/arm/mikoto/Kconfig.defconfig
```kconfig
# Electronut Labs Papyr board configuration

# Copyright (c) 2020 The ZMK Contributors
# SPDX-License-Identifier: MIT

if BOARD_MIKOTO_520

config BOARD
    default "mikoto"

if USB

config USB_NRFX
    default y

config USB_DEVICE_STACK
    default y

endif # USB

config BT_CTLR
    default BT

choice BOARD_MIKOTO_CHARGER_CURRENT
    default BOARD_MIKOTO_CHARGER_CURRENT_100MA
endchoice

endif # BOARD_MIKOTO_520
```

## app/boards/arm/nice60/Kconfig.board
```kconfig
# Copyright (c) 2021 Nick Winans
# SPDX-License-Identifier: MIT

config BOARD_NICE60
    bool "nice!60"
    depends on SOC_NRF52840_QIAA
```

## app/boards/arm/nice60/Kconfig.defconfig
```kconfig
# Copyright (c) 2021 Nick Winans
# SPDX-License-Identifier: MIT

if BOARD_NICE60

config ZMK_KEYBOARD_NAME
	default "nice!60"

if USB_DEVICE_STACK

config USB_NRFX
	default y

endif # USB_DEVICE_STACK

config BT_CTLR
	default BT

config ZMK_BLE
	default y

config ZMK_USB
	default y

endif # BOARD_NICE60
```

## app/boards/arm/nice60/nice60_defconfig
```kconfig
# Copyright (c) 2021 Nick Winans
# SPDX-License-Identifier: MIT

CONFIG_SOC_SERIES_NRF52X=y
CONFIG_SOC_NRF52840_QIAA=y
CONFIG_BOARD_NICE60=y

# Enable MPU
CONFIG_ARM_MPU=y

CONFIG_PINCTRL=y

# enable GPIO
CONFIG_GPIO=y

CONFIG_USE_DT_CODE_PARTITION=y
CONFIG_BUILD_OUTPUT_UF2=y

CONFIG_MPU_ALLOW_FLASH_WRITE=y
CONFIG_NVS=y
CONFIG_SETTINGS_NVS=y
CONFIG_FLASH=y
CONFIG_FLASH_PAGE_LAYOUT=y
CONFIG_FLASH_MAP=y

CONFIG_ZMK_RGB_UNDERGLOW=y
CONFIG_WS2812_STRIP=y

CONFIG_ZMK_RGB_UNDERGLOW_HUE_START=160
CONFIG_ZMK_RGB_UNDERGLOW_EFF_START=3


CONFIG_ZMK_USB=y
CONFIG_ZMK_BLE=y
```

## app/boards/arm/nice_nano/Kconfig
```kconfig
# SPDX-License-Identifier: MIT

config BOARD_ENABLE_DCDC
    bool "Enable DCDC mode"
    select SOC_DCDC_NRF52X
    default y
    depends on (BOARD_NICE_NANO || BOARD_NICE_NANO_V2)

config BOARD_ENABLE_DCDC_HV
    bool "High voltage DCDC converter"
    select SOC_DCDC_NRF52X_HV
    default y
    depends on (BOARD_NICE_NANO_V2)
```

## app/boards/arm/nice_nano/Kconfig.board
```kconfig
# nice!nano board configuration

# Copyright (c) 2020 Pete Johanson
# SPDX-License-Identifier: MIT

config BOARD_NICE_NANO
    bool "nice!nano"
    imply ZMK_POWER_DOMAINS
    imply ZMK_POWER_DOMAINS_DYNAMIC_DEFAULT
    depends on SOC_NRF52840_QIAA

config BOARD_NICE_NANO_V2
    bool "nice!nano v2"
    imply ZMK_POWER_DOMAINS
    imply ZMK_POWER_DOMAINS_DYNAMIC_DEFAULT
    depends on SOC_NRF52840_QIAA
```

## app/boards/arm/nice_nano/Kconfig.defconfig
```kconfig
# Copyright (c) 2021 The ZMK Contributors
# SPDX-License-Identifier: MIT

if BOARD_NICE_NANO || BOARD_NICE_NANO_V2

config BOARD
    default "nice_nano"

if USB_DEVICE_STACK

config USB_NRFX
    default y

endif # USB_DEVICE_STACK

config BT_CTLR
    default BT

endif # BOARD_NICE_NANO || BOARD_NICE_NANO_V2
```

## app/boards/arm/nice_nano/nice_nano_defconfig
```kconfig
# SPDX-License-Identifier: MIT

CONFIG_SOC_SERIES_NRF52X=y
CONFIG_SOC_NRF52840_QIAA=y
CONFIG_BOARD_NICE_NANO=y

# Enable MPU
CONFIG_ARM_MPU=y

# enable GPIO
CONFIG_GPIO=y

# Use pinctrl
CONFIG_PINCTRL=y

CONFIG_USE_DT_CODE_PARTITION=y
CONFIG_BUILD_OUTPUT_UF2=y

CONFIG_MPU_ALLOW_FLASH_WRITE=y
CONFIG_NVS=y
CONFIG_SETTINGS_NVS=y
CONFIG_FLASH=y
CONFIG_FLASH_PAGE_LAYOUT=y
CONFIG_FLASH_MAP=y

CONFIG_ZMK_USB=y
CONFIG_ZMK_BLE=y
```

## app/boards/arm/nrf52840_m2/Kconfig
```kconfig
# Copyright (c) 2020 The ZMK Contributors
# SPDX-License-Identifier: MIT

config BOARD_ENABLE_DCDC
	bool "Enable DCDC mode"
	select SOC_DCDC_NRF52X
	default y
	depends on BOARD_NRF52840_M2
```

## app/boards/arm/nrf52840_m2/Kconfig.board
```kconfig
# Maker Diary nrf52840 M.2 board configuration

# Copyright (c) 2020 The ZMK Contributors
# SPDX-License-Identifier: MIT

config BOARD_NRF52840_M2
	bool "nrf52480_m2"
	depends on SOC_NRF52840_QIAA
```

## app/boards/arm/nrf52840_m2/Kconfig.defconfig
```kconfig
# Copyright (c) 2020 The ZMK Contributors
# SPDX-License-Identifier: MIT

if BOARD_NRF52840_M2

config BOARD
    default "nrf52480_m2"

if USB_DEVICE_STACK

config USB_NRFX
    default y

endif # USB_DEVICE_STACK

config BT_CTLR
    default BT

endif # BOARD_NRF52840_M2
```

## app/boards/arm/nrf52840_m2/nrf52840_m2_defconfig
```kconfig
# Copyright (c) 2020 The ZMK Contributors
# SPDX-License-Identifier: MIT

CONFIG_SOC_SERIES_NRF52X=y
CONFIG_SOC_NRF52840_QIAA=y
CONFIG_BOARD_NRF52840_M2=y

# Enable MPU
CONFIG_ARM_MPU=y

# enable GPIO
CONFIG_GPIO=y

CONFIG_USE_DT_CODE_PARTITION=y

CONFIG_MPU_ALLOW_FLASH_WRITE=y
CONFIG_NVS=y
CONFIG_SETTINGS_NVS=y
CONFIG_FLASH=y
CONFIG_FLASH_PAGE_LAYOUT=y
CONFIG_FLASH_MAP=y
CONFIG_SENSOR=y
CONFIG_IS31FL3733=y
# Turn on logging.
CONFIG_LOG=y
CONFIG_ZMK_LOG_LEVEL_DBG=y
CONFIG_LOG_STRDUP_BUF_COUNT=16
CONFIG_SERIAL=y
CONFIG_LOG_BACKEND_SHOW_COLOR=y

# Log via USB.
CONFIG_USB_DEVICE_STACK=y
CONFIG_USB_CDC_ACM=y
CONFIG_USB_CDC_ACM_RINGBUF_SIZE=8192
CONFIG_USB_CDC_ACM_DEVICE_NAME="CDC_ACM"
CONFIG_USB_CDC_ACM_DEVICE_COUNT=1
CONFIG_CONSOLE=y
CONFIG_UART_INTERRUPT_DRIVEN=y
CONFIG_UART_LINE_CTRL=y
CONFIG_UART_CONSOLE=y
CONFIG_USB_UART_CONSOLE=y
CONFIG_UART_CONSOLE_ON_DEV_NAME="CDC_ACM_0"
CONFIG_ZMK_EXT_POWER=y
CONFIG_ZMK_IDLE_SLEEP_TIMEOUT=60000
CONFIG_DEVICE_POWER_MANAGEMENT=y
CONFIG_ZMK_SLEEP=y
```

## app/boards/arm/nrf52dk_nrf52832/Kconfig.board
```kconfig
# nRF52 DK NRF52832 board configuration

/*
 * Copyright (c) 2022 The ZMK Contributors
 *
 * SPDX-License-Identifier: MIT
 */

config BOARD_NRF52DK_NRF52832
	bool "nRF52 DK NRF52832"
	depends on SOC_NRF52832_QFAA
```

## app/boards/arm/nrf52dk_nrf52832/Kconfig.defconfig
```kconfig
# nRF52 DK NRF52832 board configuration

/*
 * Copyright (c) 2022 The ZMK Contributors
 *
 * SPDX-License-Identifier: MIT
 */

config BOARD
	default "nrf52dk_nrf52832"

config ZMK_KEYBOARD_NAME
	default "nrf52dk_nrf52832"
	
config BT_CTLR
default BT

config ZMK_BLE
	default y
```

## app/boards/arm/nrf52dk_nrf52832/nrf52dk_nrf52832_defconfig
```kconfig
# SPDX-License-Identifier: Apache-2.0

CONFIG_SOC_SERIES_NRF52X=y
CONFIG_SOC_NRF52832_QFAA=y
CONFIG_BOARD_NRF52DK_NRF52832=y
# CONFIG_BUILD_OUTPUT_UF2=y

CONFIG_ZMK_KSCAN_DIRECT_POLLING=y	
CONFIG_ZMK_BLE=y
# CONFIG_LOG=y #causes crashes
# CONFIG_LOG_BACKEND_SHOW_COLOR=n
# CONFIG_ZMK_LOG_LEVEL_DBG=y
# CONFIG_DEBUG=y
CONFIG_MAIN_STACK_SIZE=2048
CONFIG_ISR_STACK_SIZE=2048

# Enable MPU
CONFIG_ARM_MPU=y

# Enable hardware stack protection
CONFIG_HW_STACK_PROTECTION=y

# Enable RTT
CONFIG_USE_SEGGER_RTT=y

# enable GPIO
CONFIG_GPIO=y

# enable uart driver
CONFIG_SERIAL=y

# enable console
CONFIG_CONSOLE=y
CONFIG_UART_CONSOLE=y

# additional board options
CONFIG_GPIO_AS_PINRESET=y

CONFIG_MPU_ALLOW_FLASH_WRITE=y
CONFIG_NVS=y
CONFIG_SETTINGS_NVS=y
CONFIG_FLASH=y
CONFIG_FLASH_PAGE_LAYOUT=y
CONFIG_FLASH_MAP=y
```

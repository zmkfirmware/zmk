/*
 * Copyright (c) 2021 The ZMK Contributors
 *
 * SPDX-License-Identifier: MIT
 */

/dts-v1/;
#include "nice_nano.dtsi"

/ {
    chosen {
        zmk,battery = &vbatt;
        zmk,default-power-domain = &core_power_domain;
    };

    core_power_domain: core_power_domain {
        compatible = "power-domain-gpio", "power-domain";
        startup-delay-us = <50000>;
        off-on-delay-us = <50000>;
        enable-gpios = <&gpio0 13 GPIO_ACTIVE_HIGH>;
        zephyr,pm-device-runtime-auto;
    };

    vbatt: vbatt {
        compatible = "zmk,battery-nrf-vddh";
    };
};

#include "arduino_pro_micro_pins.dtsi"

#include "harper.dtsi"

&kscan0 {
    col-gpios
        = <&gpio0 15 GPIO_ACTIVE_HIGH>
        , <&gpio0  7 GPIO_ACTIVE_HIGH>
        , <&gpio0 12 GPIO_ACTIVE_HIGH>
        , <&gpio0  8 GPIO_ACTIVE_HIGH>
        , <&gpio1  9 GPIO_ACTIVE_HIGH>
        , <&gpio0  5 GPIO_ACTIVE_HIGH>
        , <&gpio1  6 GPIO_ACTIVE_HIGH>
        , <&gpio0  9 GPIO_ACTIVE_HIGH> //encoder
        ;
};

&left_encoder {
	status = "okay";
};
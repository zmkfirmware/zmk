/*
 * Copyright (c) 2021 Richard Titmuss
 *
 * SPDX-License-Identifier: MIT
 */

#include "tornblue.dtsi"

&kscan0 {
	col-gpios
        = <&gpio0 31 GPIO_ACTIVE_HIGH>
        , <&gpio0 4  GPIO_ACTIVE_HIGH>
        , <&gpio0 5  GPIO_ACTIVE_HIGH>
        , <&gpio0 7  GPIO_ACTIVE_HIGH>
        , <&gpio1 9  GPIO_ACTIVE_HIGH>
        , <&gpio0 12 GPIO_ACTIVE_HIGH>
		;
};

/ {
    left_encoder: encoder_left {
            compatible = "alps,ec11";
            label = "LEFT_ENCODER";
            a-gpios = <&gpio0 9 (GPIO_ACTIVE_HIGH | GPIO_PULL_UP)>;
            b-gpios = <&gpio0 10 (GPIO_ACTIVE_HIGH | GPIO_PULL_UP)>;
            resolution = <4>;
    };

    sensors {
            compatible = "zmk,keymap-sensors";
            sensors = <&left_encoder>;
    };
};

&left_encoder {
    status = "okay";
};

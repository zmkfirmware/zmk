/*
 * Copyright (c) 2021 Richard Titmuss
 *
 * SPDX-License-Identifier: MIT
 */

#include "tornblue.dtsi"

&default_transform {
	col-offset = <6>;
};

&kscan0 {
	col-gpios
        = <&gpio0 12 GPIO_ACTIVE_HIGH>
        , <&gpio1 9  GPIO_ACTIVE_HIGH>
        , <&gpio0 7  GPIO_ACTIVE_HIGH>
        , <&gpio0 5  GPIO_ACTIVE_HIGH>
        , <&gpio0 4  GPIO_ACTIVE_HIGH>
        , <&gpio0 31 GPIO_ACTIVE_HIGH>
		;
};

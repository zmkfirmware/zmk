/*
 * Copyright (c) 2020 The ZMK Contributors
 *
 * SPDX-License-Identifier: MIT
 */

#include "jian.dtsi"

&kscan0 {
	col-gpios
		= <&pro_micro  1 GPIO_ACTIVE_HIGH>
		, <&pro_micro  0 GPIO_ACTIVE_HIGH>
		, <&pro_micro  8 GPIO_ACTIVE_HIGH>
		, <&pro_micro 19 GPIO_ACTIVE_HIGH>
		, <&pro_micro 18 GPIO_ACTIVE_HIGH>
		, <&pro_micro 16 GPIO_ACTIVE_HIGH>
		;
};

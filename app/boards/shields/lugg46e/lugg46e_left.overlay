/*
 * Copyright (c) 2020 Pete Johanson, Kurtis Lew
 *
 * SPDX-License-Identifier: MIT
 */

#include "lugg46e.dtsi"

&kscan0 {
	col-gpios
		= <&xiao_d 5 GPIO_ACTIVE_HIGH>
		, <&xiao_d 4 GPIO_ACTIVE_HIGH>
		, <&xiao_d 3 GPIO_ACTIVE_HIGH>
		, <&xiao_d 2 GPIO_ACTIVE_HIGH>
		, <&xiao_d 1 GPIO_ACTIVE_HIGH>
		, <&xiao_d 0 GPIO_ACTIVE_HIGH>
		;
};

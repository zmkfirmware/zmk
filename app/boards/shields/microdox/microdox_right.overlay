/*
 * Copyright (c) 2020 The ZMK Contributors
 *
 * SPDX-License-Identifier: MIT
 */

#include "microdox.dtsi"

&default_transform {
	col-offset = <5>;
};

&oled {
	segment-remap;
	com-invdir;
};

&kscan0 {
	col-gpios
		= <&pro_micro 15 GPIO_ACTIVE_HIGH>
		, <&pro_micro 18 GPIO_ACTIVE_HIGH>
		, <&pro_micro 19 GPIO_ACTIVE_HIGH>
		, <&pro_micro 20 GPIO_ACTIVE_HIGH>
		, <&pro_micro 21 GPIO_ACTIVE_HIGH>
		;
};

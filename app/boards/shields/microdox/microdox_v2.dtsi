/*
 * Copyright (c) 2023 The ZMK Contributors
 *
 * SPDX-License-Identifier: MIT
 */

#include "microdox_common.dtsi"

/ {
    matrix: matrix {
        compatible = "zmk,input-gpio-matrix";
        wakeup-source;
        diode-direction = "col2row";
    };
};

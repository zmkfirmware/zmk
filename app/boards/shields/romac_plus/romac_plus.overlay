/*
 * Copyright (c) 2020 The ZMK Contributors
 *
 * SPDX-License-Identifier: MIT
 */

#include "romac_plus.dtsi"

/ {
    chosen {
        zmk,matrix-input = &matrix;
    };

    matrix: matrix {
        compatible = "zmk,input-gpio-matrix";
        wakeup-source;

        diode-direction = "col2row";

        col-gpios
            = <&pro_micro 19 GPIO_ACTIVE_HIGH>
            , <&pro_micro 20 GPIO_ACTIVE_HIGH>
            , <&pro_micro 21 GPIO_ACTIVE_HIGH>
            ;
    };

};

&left_encoder {
    status = "okay";
};

/*
 * Copyright (c) 2023 The ZMK Contributors
 *
 * SPDX-License-Identifier: MIT
 */

#include "levinson.dtsi"

/ {
    kscan0: kscan {
        compatible = "zmk,kscan-gpio-matrix";
        label = "KSCAN";
        diode-direction = "col2row";

		col-gpios
			= <&pro_micro  1 GPIO_ACTIVE_HIGH>
			, <&pro_micro  3 GPIO_ACTIVE_HIGH>
			, <&pro_micro  0 GPIO_ACTIVE_HIGH>
			, <&pro_micro 15 GPIO_ACTIVE_HIGH>
			, <&pro_micro 14 GPIO_ACTIVE_HIGH>
			, <&pro_micro 16 GPIO_ACTIVE_HIGH>
			;

		row-gpios
			= <&pro_micro 4 (GPIO_ACTIVE_HIGH | GPIO_PULL_DOWN)>
			, <&pro_micro 7 (GPIO_ACTIVE_HIGH | GPIO_PULL_DOWN)>
			, <&pro_micro 8 (GPIO_ACTIVE_HIGH | GPIO_PULL_DOWN)>
			, <&pro_micro 9 (GPIO_ACTIVE_HIGH | GPIO_PULL_DOWN)>
			;
	};	
};

## app/boards/shields/levinson/Kconfig.defconfig
```kconfig
# Copyright (c) 2023 The ZMK Contributors
# SPDX-License-Identifier: MIT
 
 
if SHIELD_LEVINSON_LEFT

config ZMK_KEYBOARD_NAME
	default "Levinson"

config ZMK_SPLIT_BLE_ROLE_CENTRAL
	default y

endif

if SHIELD_LEVINSON_LEFT || SHIELD_LEVINSON_RIGHT

config ZMK_SPLIT
	default y

endif
```

## app/boards/shields/levinson/Kconfig.shield
```kconfig
# Copyright (c) 2021 The ZMK Contributors
# SPDX-License-Identifier: MIT

config SHIELD_LEVINSON_LEFT
	def_bool $(shields_list_contains,levinson_left)

config SHIELD_LEVINSON_RIGHT
	def_bool $(shields_list_contains,levinson_right)
```

## app/boards/shields/lily58/Kconfig.defconfig
```kconfig
if SHIELD_LILY58_LEFT

config ZMK_KEYBOARD_NAME
	default "Lily58 Left"

endif

if SHIELD_LILY58_RIGHT

config ZMK_KEYBOARD_NAME
	default "Lily58 Right"

endif
```

## app/boards/shields/lily58/Kconfig.shield
```kconfig
# Copyright (c) 2020 Pete Johanson
# SPDX-License-Identifier: MIT

config SHIELD_LILY58_LEFT
    def_bool $(shields_list_contains,lily58_left)

config SHIELD_LILY58_RIGHT
    def_bool $(shields_list_contains,lily58_right)

include:
    board: nice_nano_v2
    shield: lily58_left
    shield: lily58_left nice_view_adapter nice_view

    board: nice_nano_v2
    shield: lily58_right
    shield: lily58_right nice_view_adapter nice_view
```

## app/boards/shields/lodash33/Kconfig.defconfig
```kconfig
# Copyright (c) 2020 The ZMK Contributors
# SPDX-License-Identifier: MIT

if SHIELD_LODASH33

config ZMK_KEYBOARD_NAME
    default "LODASH33"

endif
```

## app/boards/shields/lodash33/Kconfig.shield
```kconfig
# Copyright (c) 2020 The ZMK Contributors
# SPDX-License-Identifier: MIT

config SHIELD_LODASH33
   def_bool $(shields_list_contains,lodash33)
```

## app/boards/shields/lotus58/Kconfig.defconfig
```kconfig
# Copyright (c) 2022 The ZMK Contributors
# SPDX-License-Identifier: MIT

if SHIELD_LOTUS58_LEFT

config ZMK_KEYBOARD_NAME
    default "Lotus58"

config ZMK_SPLIT_ROLE_CENTRAL
    default y

endif

if SHIELD_LOTUS58_LEFT || SHIELD_LOTUS58_RIGHT

config ZMK_SPLIT
    default y

if ZMK_DISPLAY

config I2C
    default y

config SSD1306
    default y

endif # ZMK_DISPLAY

if LVGL

config LV_Z_VDB_SIZE
    default 64

config LV_DPI_DEF
    default 148

config LV_Z_BITS_PER_PIXEL
    default 1

choice LV_COLOR_DEPTH
    default LV_COLOR_DEPTH_1
endchoice

endif # LVGL

endif
```

## app/boards/shields/lotus58/Kconfig.shield
```kconfig
# Copyright (c) 2022 The ZMK Contributors
# SPDX-License-Identifier: MIT

config SHIELD_LOTUS58_LEFT
	def_bool $(shields_list_contains,lotus58_left)

config SHIELD_LOTUS58_RIGHT
	def_bool $(shields_list_contains,lotus58_right)
```

## app/boards/shields/lugg46e/Kconfig.defconfig
```kconfig
if SHIELD_LUGG46E_LEFT

config ZMK_KEYBOARD_NAME
    default "Lugg46e"

config ZMK_SPLIT_ROLE_CENTRAL
    default y

endif

if SHIELD_LUGG46E_LEFT || SHIELD_LUGG46E_RIGHT

config ZMK_SPLIT
    default y

endif
```

## app/boards/shields/lugg46e/Kconfig.shield
```kconfig
config SHIELD_LUGG46E_LEFT
    def_bool $(shields_list_contains,lugg46e_left)
    
config SHIELD_LUGG46E_RIGHT
    def_bool $(shields_list_contains,lugg46e_right)
```

## app/boards/shields/m60/Kconfig.defconfig
```kconfig
# Copyright (c) 2020 The ZMK Contributors
# SPDX-License-Identifier: MIT

if SHIELD_M60

config ZMK_KEYBOARD_NAME
    default "m60"

if ZMK_BACKLIGHT

config PWM
    default y

config LED_PWM
    default y

endif # ZMK_BACKLIGHT

endif
```

## app/boards/shields/m60/Kconfig.shield
```kconfig
# Copyright (c) 2020 The ZMK Contributors
# SPDX-License-Identifier: MIT

config SHIELD_M60
	def_bool $(shields_list_contains,m60)
```

## app/boards/shields/mach3/Kconfig.defconfig
```kconfig
if SHIELD_MACH3

config ZMK_KEYBOARD_NAME
    default "mach3"

endif # BOARD_MACH3
```

## app/boards/shields/mercury/Kconfig.defconfig
```kconfig
if SHIELD_MERCURY_LEFT

config ZMK_KEYBOARD_NAME
	default "Mercury-UL"

config ZMK_SPLIT_BLE_ROLE_CENTRAL
	default y

endif


if SHIELD_MERCURY_RIGHT

config ZMK_KEYBOARD_NAME
	default "Mercury-R"

endif


if SHIELD_MERCURY_LEFT || SHIELD_MERCURY_RIGHT

config ZMK_SPLIT
	default y

endif
```

## app/boards/shields/mercury/Kconfig.shield
```kconfig
config SHIELD_MERCURY_LEFT
	def_bool $(shields_list_contains,mercury_left)

config SHIELD_MERCURY_RIGHT
	def_bool $(shields_list_contains,mercury_right)
```

## app/boards/shields/mf68/Kconfig.defconfig
```kconfig
# Copyright (c) 2021 The ZMK Contributors
# SPDX-License-Identifier: MIT

if SHIELD_MF68

config ZMK_KEYBOARD_NAME
	default "MF68"

endif

if SHIELD_MF68_FEATHER

config ZMK_KEYBOARD_NAME
	default "MF68"

endif
```

## app/boards/shields/mf68/Kconfig.shield
```kconfig
# Copyright (c) 2021 The ZMK Contributors
# SPDX-License-Identifier: MIT

config SHIELD_MF68
	def_bool $(shields_list_contains,mf68)

config SHIELD_MF68_FEATHER
	def_bool $(shields_list_contains,mf68_feather)
```

## app/boards/shields/microdox/Kconfig.defconfig
```kconfig
# Copyright (c) 2020 The ZMK Contributors
# SPDX-License-Identifier: MIT

if SHIELD_MICRODOX_LEFT || SHIELD_MICRODOX_V2_LEFT

config ZMK_KEYBOARD_NAME
    default "Microdox"

config ZMK_SPLIT_ROLE_CENTRAL
    default y

endif

if SHIELD_MICRODOX_LEFT || SHIELD_MICRODOX_RIGHT || SHIELD_MICRODOX_V2_LEFT || SHIELD_MICRODOX_V2_RIGHT

config ZMK_SPLIT
    default y

if ZMK_DISPLAY

config I2C
    default y

config SSD1306
    default y

endif # ZMK_DISPLAY

if LVGL

config LV_Z_VDB_SIZE
    default 64

config LV_DPI_DEF
    default 148

config LV_Z_BITS_PER_PIXEL
    default 1

choice LV_COLOR_DEPTH
    default LV_COLOR_DEPTH_1
endchoice

endif # LVGL

endif
```

## app/boards/shields/microdox/Kconfig.shield
```kconfig
# Copyright (c) 2020 The ZMK Contributors
# SPDX-License-Identifier: MIT

config SHIELD_MICRODOX_LEFT
    def_bool $(shields_list_contains,microdox_left)

config SHIELD_MICRODOX_RIGHT
    def_bool $(shields_list_contains,microdox_right)

config SHIELD_MICRODOX_V2_LEFT
    def_bool $(shields_list_contains,microdox_v2_left)

config SHIELD_MICRODOX_V2_RIGHT
    def_bool $(shields_list_contains,microdox_v2_right)
```

## app/boards/shields/minivan_studio_tester/Kconfig.defconfig
```kconfig
# Copyright (c) 2024 The ZMK Contributors
# SPDX-License-Identifier: MIT

if SHIELD_MINIVAN_STUDIO_TESTER

config ZMK_KEYBOARD_NAME
    default "MiniVan Tester"

endif
```

## app/boards/shields/minivan_studio_tester/Kconfig.shield
```kconfig
# Copyright (c) 2024 The ZMK Contributors
# SPDX-License-Identifier: MIT

config SHIELD_MINIVAN_STUDIO_TESTER
    def_bool $(shields_list_contains,minivan_studio_tester)
    select ZMK_STUDIO
    select UART_NATIVE_POSIX_PORT_1_ENABLE
    select CBPRINTF_LIBC_SUBSTS
    select ZMK_STUDIO_TRANSPORT_UART
```

## app/boards/shields/moc_feather/Kconfig.defconfig
```kconfig
# Copyright (c) 2022 The ZMK Contributors
# SPDX-License-Identifier: MIT

if SHIELD_MOC_FEATHER

config ZMK_KEYBOARD_NAME
    default "moc_feather"

endif
```

## app/boards/shields/moc_feather/Kconfig.shield
```kconfig
# Copyright (c) 2022 The ZMK Contributors
# SPDX-License-Identifier: MIT

config SHIELD_MOC_FEATHER
   def_bool $(shields_list_contains,moc_feather)
```

## app/boards/shields/mokulua/Kconfig.shield
```kconfig
#Copyright (c) 2022 The ZMK Contributors
#SPDX-License-Identifier: MIT

config SHIELD_MOKULUA_LEFT
	def_bool $(shields_list_contains,mokulua_left)

config SHIELD_MOKULUA_RIGHT
	def_bool $(shields_list_contains,mokulua_right)
```

/*
 * Copyright (c) 2022 The ZMK Contributors
 *
 * SPDX-License-Identifier: MIT
 */

nice_view_spi: &spi0 {
	compatible = "nordic,nrf-spim";
	sck-pin = <20>;
	mosi-pin = <17>;
	miso-pin = <5>;
	cs-gpios = <&pro_micro 1 GPIO_ACTIVE_HIGH>;
};

&pro_micro_i2c {
	status = "disabled";
};

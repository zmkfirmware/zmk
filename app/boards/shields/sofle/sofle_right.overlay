/*
 * Copyright (c) 2020 Ryan Cross
 *
 * SPDX-License-Identifier: MIT
 */

#include "sofle.dtsi"

&default_transform {
	col-offset = <6>;
};

&kscan0 {
	col-gpios
		= <&pro_micro_d 10 GPIO_ACTIVE_HIGH>
		, <&pro_micro_d 16 GPIO_ACTIVE_HIGH>
		, <&pro_micro_d 14 GPIO_ACTIVE_HIGH>
		, <&pro_micro_d 15 GPIO_ACTIVE_HIGH>
		, <&pro_micro_a  0 GPIO_ACTIVE_HIGH>
		, <&pro_micro_a  1 GPIO_ACTIVE_HIGH>
		;
};

&right_encoder {
	status = "okay";
};

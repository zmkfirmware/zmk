## app/boards/shields/sofle/Kconfig.shield
```kconfig
# Copyright (c) 2020 Ryan Cross
# SPDX-License-Identifier: MIT

config SHIELD_SOFLE_LEFT
	def_bool $(shields_list_contains,sofle_left)

config SHIELD_SOFLE_RIGHT
	def_bool $(shields_list_contains,sofle_right)
```

## app/boards/shields/sofle_rgb_keyhive/Kconfig.shield
```kconfig
# Copyright (c) 2022 The ZMK Contributors
# SPDX-License-Identifier: MIT

config SHIELD_SOFLE_RGB_KEYHIVE_LEFT
	def_bool $(shields_list_contains,sofle_rgb_keyhive_left)

config SHIELD_SOFLE_RGB_KEYHIVE_RIGHT
	def_bool $(shields_list_contains,sofle_rgb_keyhive_right)
```

## app/boards/shields/soyuz/Kconfig.defconfig
```kconfig
# Copyright (c) 2020 The ZMK Contributors
# SPDX-License-Identifier: MIT

if SHIELD_SOYUZ

config ZMK_KEYBOARD_NAME
	default "soyuz"

endif
```

## app/boards/shields/soyuz/Kconfig.shield
```kconfig
# Copyright (c) 2020 The ZMK Contributors
# SPDX-License-Identifier: MIT

config SHIELD_SOYUZ
	def_bool $(shields_list_contains,soyuz)
```

## app/boards/shields/spacepad/Kconfig.shield
```kconfig
# Copyright (c) 2020 The ZMK Contributors
# SPDX-License-Identifier: MIT

config SHIELD_SPACEPAD
	def_bool $(shields_list_contains,spacepad)
```

## app/boards/shields/spacepad/boards/Kconfig.defconfig
```kconfig
# Copyright (c) 2020 The ZMK Contributors
# SPDX-License-Identifier: MIT

if SHIELD_SPACEPAD

config ZMK_KEYBOARD_NAME
	default "Spacepad v1"

endif
```

## app/boards/shields/splitkb_aurora_corne/Kconfig.shield
```kconfig
# Copyright (c) 2022 The ZMK Contributors
# SPDX-License-Identifier: MIT

config SHIELD_SPLITKB_AURORA_CORNE_LEFT
	def_bool $(shields_list_contains,splitkb_aurora_corne_left)

config SHIELD_SPLITKB_AURORA_CORNE_RIGHT
	def_bool $(shields_list_contains,splitkb_aurora_corne_right)
```

## app/boards/shields/splitkb_aurora_helix/Kconfig.defconfig
```kconfig
# Copyright (c) 2023 The ZMK Contributors
# SPDX-License-Identifier: MIT

if SHIELD_SPLITKB_AURORA_HELIX_LEFT

config ZMK_KEYBOARD_NAME
    default "Aurora Helix"

config ZMK_SPLIT_ROLE_CENTRAL
    default y

endif # SHIELD_SPLITKB_AURORA_HELIX_LEFT

if SHIELD_SPLITKB_AURORA_HELIX_LEFT || SHIELD_SPLITKB_AURORA_HELIX_RIGHT

config ZMK_SPLIT
    default y

config ZMK_RGB_UNDERGLOW
    select WS2812_STRIP
    select SPI

if ZMK_DISPLAY

config SSD1306
    default y

config I2C
    default y

config SSD1306_REVERSE_MODE
    default y

endif # ZMK_DISPLAY

if LVGL

config LV_Z_VDB_SIZE
    default 64

config LV_DPI_DEF
    default 148

config LV_Z_BITS_PER_PIXEL
    default 1

choice LV_COLOR_DEPTH
    default LV_COLOR_DEPTH_1
endchoice

endif # LVGL

endif # SHIELD_SPLITKB_AURORA_HELIX_LEFT || SHIELD_SPLITKB_AURORA_HELIX_RIGHT
```

## app/boards/shields/splitkb_aurora_helix/Kconfig.shield
```kconfig
# Copyright (c) 2023 The ZMK Contributors
# SPDX-License-Identifier: MIT

config SHIELD_SPLITKB_AURORA_HELIX_LEFT
    def_bool $(shields_list_contains,splitkb_aurora_helix_left)

config SHIELD_SPLITKB_AURORA_HELIX_RIGHT
    def_bool $(shields_list_contains,splitkb_aurora_helix_right)
```

## app/boards/shields/splitkb_aurora_lily58/Kconfig.shield
```kconfig
# Copyright (c) 2022 The ZMK Contributors
# SPDX-License-Identifier: MIT

config SHIELD_SPLITKB_AURORA_LILY58_LEFT
    def_bool $(shields_list_contains,splitkb_aurora_lily58_left)

config SHIELD_SPLITKB_AURORA_LILY58_RIGHT
    def_bool $(shields_list_contains,splitkb_aurora_lily58_right)
```

## app/boards/shields/splitkb_aurora_sofle/Kconfig.shield
```kconfig
# Copyright (c) 2023 The ZMK Contributors
# SPDX-License-Identifier: MIT

# Central parts
config SHIELD_SPLITKB_AURORA_SOFLE_DONGLE
    def_bool $(shields_list_contains,splitkb_aurora_sofle_dongle)

config SHIELD_SPLITKB_AURORA_SOFLE_LEFT
    def_bool $(shields_list_contains,splitkb_aurora_sofle_left)

# Peripheral parts
config SHIELD_SPLITKB_AURORA_SOFLE_PERIPHERAL_LEFT
    def_bool $(shields_list_contains,splitkb_aurora_sofle_peripheral_left)

config SHIELD_SPLITKB_AURORA_SOFLE_RIGHT
    def_bool $(shields_list_contains,splitkb_aurora_sofle_right)
```

## app/boards/shields/splitkb_aurora_sweep/Kconfig.defconfig
```kconfig
# Copyright (c) 2022 The ZMK Contributors
# SPDX-License-Identifier: MIT

if SHIELD_SPLITKB_AURORA_SWEEP_LEFT

config ZMK_KEYBOARD_NAME
    default "Aurora Sweep"

config ZMK_SPLIT_ROLE_CENTRAL
    default y

endif # SHIELD_SPLITKB_AURORA_SWEEP_LEFT

if SHIELD_SPLITKB_AURORA_SWEEP_LEFT || SHIELD_SPLITKB_AURORA_SWEEP_RIGHT

config ZMK_SPLIT
    default y

config ZMK_RGB_UNDERGLOW
    select WS2812_STRIP
    select SPI

config ZMK_DISPLAY

if ZMK_DISPLAY

config SSD1306
    default y

config I2C
    default y

endif # ZMK_DISPLAY

if LVGL

config LV_Z_VDB_SIZE
    default 64

config LV_DPI_DEF
    default 148

config LV_Z_BITS_PER_PIXEL
    default 1

choice LV_COLOR_DEPTH
    default LV_COLOR_DEPTH_1
endchoice

endif # LVGL

endif # SHIELD_SPLITKB_AURORA_SWEEP_LEFT || SHIELD_SPLITKB_AURORA_SWEEP_RIGHT
```

## app/boards/shields/splitkb_aurora_sweep/Kconfig.shield
```kconfig
# Copyright (c) 2022 The ZMK Contributors
# SPDX-License-Identifier: MIT

config SHIELD_SPLITKB_AURORA_SWEEP_LEFT
	def_bool $(shields_list_contains,splitkb_aurora_sweep_left)

config SHIELD_SPLITKB_AURORA_SWEEP_RIGHT
	def_bool $(shields_list_contains,splitkb_aurora_sweep_right)
```

## app/boards/shields/splitreus62/Kconfig.defconfig
```kconfig
# Copyright (c) 2020 Derek Schmell
# SPDX-License-Identifier: MIT
 
 
if SHIELD_SPLITREUS62_LEFT

config ZMK_KEYBOARD_NAME
	default "Splitreus62"

config ZMK_SPLIT_BLE_ROLE_CENTRAL
	default y

endif

if SHIELD_SPLITREUS62_LEFT || SHIELD_SPLITREUS62_RIGHT

config ZMK_SPLIT
	default y
	
endif
```

## app/boards/shields/splitreus62/Kconfig.shield
```kconfig
# Copyright (c) 2020 Derek Schmell
# SPDX-License-Identifier: MIT

config SHIELD_SPLITREUS62_LEFT
	def_bool $(shields_list_contains,splitreus62_left)

config SHIELD_SPLITREUS62_RIGHT
	def_bool $(shields_list_contains,splitreus62_right)
```

## app/boards/shields/stream_cheap/Kconfig.defconfig
```kconfig
if SHIELD_STREAM_CHEAP || SHIELD_STREAM_CHEAP_2X4

config ZMK_KEYBOARD_NAME
	default "Stream Cheap"

endif
```

## app/boards/shields/stream_cheap/Kconfig.shield
```kconfig
# Copyright (c) 2022 Luigi311
# SPDX-License-Identifier: MIT

config SHIELD_STREAM_CHEAP
	def_bool $(shields_list_contains,stream_cheap)

config SHIELD_STREAM_CHEAP_2X4
	def_bool $(shields_list_contains,stream_cheap_2x4)
```

## app/boards/shields/sugarglider/Kconfig.shield
```kconfig
# Copyright (c) 2022 The ZMK Contributors
# SPDX-License-Identifier: MIT

config SHIELD_OBE
    def_bool $(shields_list_contains,obe)
```

## app/boards/shields/summer_breeze/Kconfig.defconfig
```kconfig
if SHIELD_SUMMER_BREEZE_LEFT

config ZMK_KEYBOARD_NAME
	default "SBreeze Left"

config ZMK_SPLIT_BLE_ROLE_CENTRAL
	default y

endif

if SHIELD_SUMMER_BREEZE_RIGHT

config ZMK_KEYBOARD_NAME
	default "SBreeze Right"

endif

if SHIELD_SUMMER_BREEZE_LEFT || SHIELD_SUMMER_BREEZE_RIGHT

config ZMK_SPLIT
	default y

endif
```

## app/boards/shields/summer_breeze/Kconfig.shield
```kconfig
# Copyright (c) 2020 Pete Johanson
# SPDX-License-Identifier: MIT

config SHIELD_SUMMER_BREEZE_LEFT
	def_bool $(shields_list_contains,summer_breeze_left)

config SHIELD_SUMMER_BREEZE_RIGHT
	def_bool $(shields_list_contains,summer_breeze_right)
```

## app/boards/shields/sway/Kconfig.defconfig
```kconfig
if SHIELD_SWAY_LEFT

# Name must be less than 16 characters long!
config ZMK_KEYBOARD_NAME
    default "🍃Sway"


# config ZMK_RGB_UNDERGLOW
#     select WS2812_STRIP
#     select SPI
    
config ZMK_SPLIT_ROLE_CENTRAL
    default y

endif

if SHIELD_SWAY_LEFT || SHIELD_SWAY_RIGHT

config ZMK_SPLIT
    default y

endif
```

## app/boards/shields/sway/Kconfig.shield
```kconfig
# No whitespace after the comma or in your part name!
config SHIELD_SWAY_LEFT
    def_bool $(shields_list_contains,sway_left)

# No whitespace after the comma or in your part name!
config SHIELD_SWAY_RIGHT
    def_bool $(shields_list_contains,sway_right)
```

## app/boards/shields/sweet16/Kconfig.defconfig
```kconfig
# Copyright (c) 2022 The ZMK Contributors
# SPDX-License-Identifier: MIT

if SHIELD_SWEET16

config ZMK_KEYBOARD_NAME
    default "Sweet 16"

endif
```

## app/boards/shields/sweet16/Kconfig.shield
```kconfig
# Copyright (c) 2022 The ZMK Contributors
# SPDX-License-Identifier: MIT

config SHIELD_SWEET16
    def_bool $(shields_list_contains,sweet16)
```

## app/boards/shields/swept/Kconfig.shield
```kconfig
# Copyright (c) 2023 The ZMK Contributors
# SPDX-License-Identifier: MIT

config SHIELD_SWEPT_LEFT
	def_bool $(shields_list_contains,swept_left)

config SHIELD_SWEPT_RIGHT
	def_bool $(shields_list_contains,swept_right)
```

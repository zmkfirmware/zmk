## app/boards/shields/hummingbird/Kconfig.defconfig
```kconfig
# Copyright (c) 2022 The ZMK Contributors
# SPDX-License-Identifier: MIT

if SHIELD_HUMMINGBIRD

config ZMK_KEYBOARD_NAME
    default "Hummingbird"

endif
```

## app/boards/shields/intro/Kconfig.defconfig
```kconfig
# Copyright (c) 2023 ZMK
# SPDX-License-Identifier: MIT

config ZMK_USB
	default y

if SHIELD_INTRO_LEFT

config ZMK_KEYBOARD_NAME
	default "Intro"

config ZMK_SPLIT_ROLE_CENTRAL
	default y

endif

if SHIELD_INTRO_LEFT || SHIELD_INTRO_RIGHT

config ZMK_SPLIT
	default y

endif
```

## app/boards/shields/intro/Kconfig.shield
```kconfig
# Copyright (c) 2023 ZMK
# SPDX-License-Identifier: MIT

config SHIELD_INTRO_LEFT
	def_bool $(shields_list_contains,intro_left)

config SHIELD_INTRO_RIGHT
	def_bool $(shields_list_contains,intro_right)
```

## app/boards/shields/iris/Kconfig.defconfig
```kconfig
# Copyright (c) 2020 Pete Johanson, Kurtis Lew
# SPDX-License-Identifier: MIT

if SHIELD_IRIS_LEFT

config ZMK_KEYBOARD_NAME
	default "Iris"

config ZMK_SPLIT_ROLE_CENTRAL
	default y

endif

if SHIELD_IRIS_LEFT || SHIELD_IRIS_RIGHT

config ZMK_SPLIT
	default y
	
endif
```

## app/boards/shields/iris/Kconfig.shield
```kconfig
# Copyright (c) 2020 Pete Johanson, Kurtis Lew
# SPDX-License-Identifier: MIT

config SHIELD_IRIS_LEFT
	def_bool $(shields_list_contains,iris_left)

config SHIELD_IRIS_RIGHT
	def_bool $(shields_list_contains,iris_right)
```

## app/boards/shields/j46k/Kconfig.defconfig
```kconfig
# Copyright (c) 2020 Pete Johanson, Richard Jones
# SPDX-License-Identifier: MIT

if SHIELD_j46k

config ZMK_KEYBOARD_NAME
	default "J46K"

endif
```

## app/boards/shields/j46k/Kconfig.shield
```kconfig
# Copyright (c) 2020 Pete Johanson, Richard Jones
# SPDX-License-Identifier: MIT

config SHIELD_j46k
	def_bool $(shields_list_contains,j46k)
```

## app/boards/shields/j46kcol/Kconfig.defconfig
```kconfig
# Copyright (c) 2020 Pete Johanson, Richard Jones
# SPDX-License-Identifier: MIT

if SHIELD_j46kcol

config ZMK_KEYBOARD_NAME
	default "J46KCol"

endif
```

## app/boards/shields/jian/Kconfig.defconfig
```kconfig
if SHIELD_JIAN_LEFT

config ZMK_KEYBOARD_NAME
	default "Jian"

config ZMK_SPLIT_ROLE_CENTRAL
	default y

endif

if SHIELD_JIAN_LEFT || SHIELD_JIAN_RIGHT

config ZMK_SPLIT
	default y

endif
```

## app/boards/shields/jian/Kconfig.shield
```kconfig
# Copyright (c) 2020 The ZMK Contributors
# SPDX-License-Identifier: MIT

config SHIELD_JIAN_LEFT
	def_bool $(shields_list_contains,jian_left)

config SHIELD_JIAN_RIGHT
	def_bool $(shields_list_contains,jian_right)
```

## app/boards/shields/jiran/Kconfig.defconfig
```kconfig
# Copyright (c) 2021 The ZMK Contributors
# SPDX-License-Identifier: MIT

if SHIELD_JIRAN_LEFT

config ZMK_KEYBOARD_NAME
	default "Jiran"

config ZMK_SPLIT_BLE_ROLE_CENTRAL
	default y

endif

if SHIELD_JIRAN_LEFT || SHIELD_JIRAN_RIGHT

config ZMK_SPLIT
	default y

endif
```

## app/boards/shields/jiran/Kconfig.shield
```kconfig
# Copyright (c) 2021 The ZMK Contributors
# SPDX-License-Identifier: MIT

config SHIELD_JIRAN_LEFT
	def_bool $(shields_list_contains,jiran_left)

config SHIELD_JIRAN_RIGHT
	def_bool $(shields_list_contains,jiran_right)
```

## app/boards/shields/jorne/Kconfig.shield
```kconfig
# Copyright (c) 2020 The ZMK Contributors
# SPDX-License-Identifier: MIT

config SHIELD_JORNE_LEFT
	def_bool $(shields_list_contains,jorne_left)

config SHIELD_JORNE_RIGHT
	def_bool $(shields_list_contains,jorne_right)
```

## app/boards/shields/knob_goblin/Kconfig.defconfig
```kconfig
# Copyright (c) 2022 The ZMK Contributors
# SPDX-License-Identifier: MIT

if SHIELD_KNOB_GOBLIN

config ZMK_KEYBOARD_NAME
  default "Knob Goblin"

if ZMK_DISPLAY

config I2C
  default y

config SSD1306
  default y

endif # ZMK_DISPLAY

if LVGL

config LV_Z_VDB_SIZE
  default 64

config LV_DPI_DEF
  default 148

config LV_Z_BITS_PER_PIXEL
  default 1

choice LV_COLOR_DEPTH
  default LV_COLOR_DEPTH_1
endchoice

endif # LVGL

endif # SHIELD_KNOB_GOBLIN
```

## app/boards/shields/knob_goblin/Kconfig.shield
```kconfig
# Copyright (c) 2022 The ZMK Contributors
# SPDX-License-Identifier: MIT

config SHIELD_KNOB_GOBLIN
  def_bool $(shields_list_contains,knob_goblin)
```

## app/boards/shields/kyria/Kconfig.defconfig
```kconfig
if SHIELD_KYRIA_LEFT || SHIELD_KYRIA_REV2_LEFT || SHIELD_KYRIA_REV3_LEFT

config ZMK_KEYBOARD_NAME
    default "Kyria"

config ZMK_SPLIT_ROLE_CENTRAL
    default y

endif

if SHIELD_KYRIA

config ZMK_SPLIT
    default y

if ZMK_DISPLAY

config I2C
    default y

config SSD1306
    default y

endif # ZMK_DISPLAY

if LVGL

config LV_Z_VDB_SIZE
    default 64

config LV_DPI_DEF
    default 148

config LV_Z_BITS_PER_PIXEL
    default 1

choice LV_COLOR_DEPTH
    default LV_COLOR_DEPTH_1
endchoice

endif # LVGL

endif
```

## app/boards/shields/kyria/Kconfig.shield
```kconfig
# Copyright (c) 2020 Pete Johanson
# SPDX-License-Identifier: MIT

config SHIELD_KYRIA
    bool

config SHIELD_KYRIA_LEFT
	def_bool $(shields_list_contains,kyria_left)
	select SHIELD_KYRIA

config SHIELD_KYRIA_RIGHT
	def_bool $(shields_list_contains,kyria_right)
	select SHIELD_KYRIA

config SHIELD_KYRIA_REV2_LEFT
	def_bool $(shields_list_contains,kyria_rev2_left)
	select SHIELD_KYRIA

config SHIELD_KYRIA_REV2_RIGHT
	def_bool $(shields_list_contains,kyria_rev2_right)
	select SHIELD_KYRIA
```

## app/boards/shields/launchpad/Kconfig.defconfig
```kconfig
# Copyright (c) 2020 The ZMK Contributors
# SPDX-License-Identifier: MIT

if SHIELD_LAUNCHPAD

config ZMK_KEYBOARD_NAME
    default "LaunchPad"

config ZMK_USB
    default y

endif
```

## app/boards/shields/launchpad/Kconfig.shield
```kconfig
# Copyright (c) 2020 The ZMK Contributors
# SPDX-License-Identifier: MIT

config SHIELD_LAUNCHPAD
	def_bool $(shields_list_contains,launchpad)
```

## app/boards/shields/leeloo/Kconfig.defconfig
```kconfig
# Copyright (c) 2023 The ZMK Contributors
# SPDX-License-Identifier: MIT

if SHIELD_LEELOO_REV2_LEFT

config ZMK_KEYBOARD_NAME
    default "Leeloo v2"

config ZMK_SPLIT_ROLE_CENTRAL
    default y

endif

if SHIELD_LEELOO_LEFT

config ZMK_KEYBOARD_NAME
    default "Leeloo"

config ZMK_SPLIT_ROLE_CENTRAL
    default y

endif

if SHIELD_LEELOO

config ZMK_SPLIT
    default y

if ZMK_DISPLAY

config I2C
    default y

config SSD1306
    default y

config SSD1306_REVERSE_MODE
    default y

endif # ZMK_DISPLAY

if LVGL

config LV_Z_VDB_SIZE
    default 64

config LV_Z_DPI
    default 148

config LV_Z_BITS_PER_PIXEL
    default 1

choice LV_COLOR_DEPTH
    default LV_COLOR_DEPTH_1
endchoice

endif # LVGL

endif
```

## app/boards/shields/leeloo/Kconfig.shield
```kconfig
# Copyright (c) 2023 The ZMK Contributors
# SPDX-License-Identifier: MIT

config SHIELD_LEELOO
    bool

config SHIELD_LEELOO_LEFT
    def_bool $(shields_list_contains,leeloo_left)
    select SHIELD_LEELOO

config SHIELD_LEELOO_RIGHT
    def_bool $(shields_list_contains,leeloo_right)
    select SHIELD_LEELOO

config SHIELD_LEELOO_REV2_LEFT
    def_bool $(shields_list_contains,leeloo_rev2_left)
    select SHIELD_LEELOO

config SHIELD_LEELOO_REV2_RIGHT
    def_bool $(shields_list_contains,leeloo_rev2_right)
    select SHIELD_LEELOO
```

## app/boards/shields/leeloo_micro/Kconfig.shield
```kconfig
# Copyright (c) 2023 The ZMK Contributors
# SPDX-License-Identifier: MIT

config SHIELD_LEELOO_MICRO
    bool

config SHIELD_LEELOO_MICRO_LEFT
    def_bool $(shields_list_contains,leeloo_micro_left)
    select SHIELD_LEELOO_MICRO

config SHIELD_LEELOO_MICRO_RIGHT
    def_bool $(shields_list_contains,leeloo_micro_right)
    select SHIELD_LEELOO_MICRO
```

## app/boards/shields/lets_split/Kconfig.defconfig
```kconfig
# Copyright (c) 2020 The ZMK Contributors
# SPDX-License-Identifier: MIT

if SHIELD_LETS_SPLIT_LEFT

config ZMK_KEYBOARD_NAME
    default "LS_Left"

config ZMK_SPLIT_BLE_ROLE_CENTRAL
    default y

endif

if SHIELD_LETS_SPLIT_RIGHT

config ZMK_KEYBOARD_NAME
    default "LS_Right"

endif

if SHIELD_LETS_SPLIT_LEFT || SHIELD_LETS_SPLIT_RIGHT

config ZMK_SPLIT
    default y

endif
```

## app/boards/shields/lets_split/Kconfig.shield
```kconfig
# Copyright (c) 2020 The ZMK Contributors
# SPDX-License-Identifier: MIT

config SHIELD_LETS_SPLIT_LEFT
    def_bool $(shields_list_contains,lets_split_left)

config SHIELD_LETS_SPLIT_RIGHT
    def_bool $(shields_list_contains,lets_split_right)
```

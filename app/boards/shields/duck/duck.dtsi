/* Copyright (c) 2020 The ZMK Contributors
 * SPDX-License-Identitfier: MIT
 *
 * Author: Jack Hartstein
 */
/ {
	left_encoder: encoder_left {
        	compatible = "alps,ec11";
   	     	label = "LEFT_ENCODER";
       		a-gpios = <&pro_micro_a 1 (GPIO_ACTIVE_HIGH | GPIO_PULL_UP)>;
        	b-gpios = <&pro_micro_a 2 (GPIO_ACTIVE_HIGH | GPIO_PULL_UP)>;
        	resolution = <2>;
    	};

	sensors {
        	compatible = "zmk,keymap-sensors";
        	sensors = <&left_encoder>;
    	};
};

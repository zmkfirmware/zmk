## app/boards/shields/atreus42/Kconfig.shield
```kconfig
# Copyright (c) 2023 The ZMK Contributors
# SPDX-License-Identifier: MIT

config SHIELD_ATREUS42
  def_bool $(shields_list_contains,atreus42)
```

## app/boards/shields/atreus62/Kconfig.defconfig
```kconfig
if SHIELD_ATREUS62

config ZMK_KEYBOARD_NAME
    default "Atreus62"

config ZMK_BLE
    default y

config ZMK_USB
    default y

endif
```

## app/boards/shields/atreus_choc/Kconfig.defconfig
```kconfig
# Copyright (c) 2021 The ZMK Contributors
# SPDX-License-Identifier: MIT

if SHIELD_MY_BOARD

config ZMK_KEYBOARD_NAME
    default "Atreus Choc"

endif
```

## app/boards/shields/atreus_choc/Kconfig.shield
```kconfig
# Copyright (c) 2021 The ZMK Contributors
# SPDX-License-Identifier: MIT

config SHIELD_ATREUS_CHOC
    def_bool $(shields_list_contains,atreus_choc)
```

## app/boards/shields/babyvble/Kconfig.defconfig
```kconfig
# Copyright (c) 2021 The ZMK Contributors 
# SPDX-License-Identifier: MIT 

if SHIELD_babyvble

config ZMK_KEYBOARD_NAME
	default "BabyvBle"

endif
```

## app/boards/shields/babyvble/Kconfig.shield
```kconfig
# Copyright (c) 2021 Pete Johanson, Richard Jones
# SPDX-License-Identifier: MIT

config SHIELD_babyvble
	def_bool $(shields_list_contains,babyvble)
```

## app/boards/shields/bastyl/Kconfig.shield
```kconfig
# Copyright (c) 2020 Derek Schmell
# SPDX-License-Identifier: MIT

config SHIELD_BASTYL_LEFT
	def_bool $(shields_list_contains,bastyl_left)

config SHIELD_BASTYL_RIGHT
	def_bool $(shields_list_contains,bastyl_right)
```

## app/boards/shields/bat43/Kconfig.defconfig
```kconfig
# Copyright (c) 2021 The ZMK Contributors
# SPDX-License-Identifier: MIT

if SHIELD_BAT43

config ZMK_KEYBOARD_NAME
    default "Bat43"

endif
```

## app/boards/shields/bat43/Kconfig.shield
```kconfig
# Copyright (c) 2021 The ZMK Contributors
# SPDX-License-Identifier: MIT

config SHIELD_BAT43
    def_bool $(shields_list_contains,bat43)
```

## app/boards/shields/bb65/Kconfig.defconfig
```kconfig
# Copyright (c) 2023 The ZMK Contributors
# SPDX-License-Identifier: MIT

if SHIELD_BB65

config ZMK_KEYBOARD_NAME
    default "BB65"

if LVGL

config LV_Z_VDB_SIZE
    default 64

config LV_DPI_DEF
    default 148

config LV_Z_BITS_PER_PIXEL
    default 1

choice LV_COLOR_DEPTH
    default LV_COLOR_DEPTH_1
endchoice

endif # LVGL

endif
```

## app/boards/shields/bb65/Kconfig.shield
```kconfig
# Copyright (c) 2023 The ZMK Contributors
# SPDX-License-Identifier: MIT

config SHIELD_BB65
    def_bool $(shields_list_contains,bb65)
```

## app/boards/shields/bfo9000/Kconfig.defconfig
```kconfig
# Copyright (c) 2020 The ZMK Contributors
# SPDX-License-Identifier: MIT

if SHIELD_BFO9000_LEFT

config ZMK_KEYBOARD_NAME
	default "BFO-9000"

config ZMK_SPLIT_ROLE_CENTRAL
	default y

endif

if SHIELD_BFO9000_LEFT || SHIELD_BFO9000_RIGHT

config ZMK_SPLIT
	default y

endif
```

## app/boards/shields/bfo9000/Kconfig.shield
```kconfig
# Copyright (c) 2020 The ZMK Contributors
# SPDX-License-Identifier: MIT

config SHIELD_BFO9000_LEFT
	def_bool $(shields_list_contains,bfo9000_left)

config SHIELD_BFO9000_RIGHT
	def_bool $(shields_list_contains,bfo9000_right)
```

## app/boards/shields/bluehand/Kconfig.defconfig
```kconfig
# Copyright (c) 2022 The ZMK Contributors
# SPDX-License-Identifier: MIT

if SHIELD_BLUEHAND

config ZMK_KEYBOARD_NAME
    default "BlueHand"

endif
```

## app/boards/shields/bluehand/Kconfig.shield
```kconfig
# Copyright (c) 2022 The ZMK Contributors
# SPDX-License-Identifier: MIT

config SHIELD_BLUEHAND
    def_bool $(shields_list_contains,bluehand)
```

## app/boards/shields/boardsource3x4/Kconfig.defconfig
```kconfig
# Copyright (c) 2020 The ZMK Contributors
# SPDX-License-Identifier: MIT

if SHIELD_BOARDSOURCE3X4

config ZMK_KEYBOARD_NAME
    default "Boardsource 3x4"

endif
```

## app/boards/shields/boardsource3x4/Kconfig.shield
```kconfig
# Copyright (c) 2020 The ZMK Contributors
# SPDX-License-Identifier: MIT

config SHIELD_BOARDSOURCE3X4
	def_bool $(shields_list_contains,boardsource3x4)
```

## app/boards/shields/boardsource5x12/Kconfig.defconfig
```kconfig
# Copyright (c) 2021 The ZMK Contributors
# SPDX-License-Identifier: MIT

if SHIELD_BOARDSOURCE5X12

config ZMK_KEYBOARD_NAME
    default "boardsource5x12"

endif
```

## app/boards/shields/boardsource5x12/Kconfig.shield
```kconfig
# Copyright (c) 2021 The ZMK Contributors
# SPDX-License-Identifier: MIT

config SHIELD_BOARDSOURCE5X12
    def_bool $(shields_list_contains,boardsource5x12)
```

## app/boards/shields/breeze/Kconfig.defconfig
```kconfig
if SHIELD_BREEZE_LEFT

config ZMK_KEYBOARD_NAME
	default "Breeze"

config ZMK_SPLIT_BLE_ROLE_CENTRAL
	default y

endif

if SHIELD_BREEZE_LEFT || SHIELD_BREEZE_RIGHT

config ZMK_SPLIT
	default y
 
endif
```

## app/boards/shields/breeze/Kconfig.shield
```kconfig
# Copyright (c) 2022 The ZMK Contributors
# SPDX-License-Identifier: MIT

config SHIELD_BREEZE_LEFT
    def_bool $(shields_list_contains,breeze_left)

config SHIELD_BREEZE_RIGHT
    def_bool $(shields_list_contains,breeze_right)
```

## app/boards/shields/cafeBabe/Kconfig.shield
```kconfig
 # Copyright (c) 2020 The ZMK Contributors
 # SPDX-License-Identifier: MIT

config SHIELD_CAFEBABE
    def_bool $(shields_list_contains,cafeBabe)
```

## app/boards/shields/dactyl_cc/Kconfig.defconfig
```kconfig
# Copyright (c) 2023 Matt Adereth
# SPDX-License-Identifier: MIT
if SHIELD_DACTYL_CC_LEFT

config ZMK_KEYBOARD_NAME
    default "Dactyl CC"

config ZMK_SPLIT_ROLE_CENTRAL
    default y

endif

if SHIELD_DACTYL_CC_LEFT || SHIELD_DACTYL_CC_RIGHT

config ZMK_SPLIT
    default y

endif
```

## app/boards/shields/dactyl_cc/Kconfig.shield
```kconfig
# Copyright (c) 2023 Michael Johns
# SPDX-License-Identifier: MIT

config SHIELD_DACTYL_CC_LEFT
    def_bool $(shields_list_contains,dactyl_cc_left)

config SHIELD_DACTYL_CC_RIGHT
    def_bool $(shields_list_contains,dactyl_cc_right)
```

## app/boards/shields/dactyl_lightcycle/Kconfig.defconfig
```kconfig
# Copyright (c) 2023 Matt Adereth
# SPDX-License-Identifier: MIT
if SHIELD_DACTYL_LIGHTCYCLE_LEFT

config ZMK_KEYBOARD_NAME
    default "DactylLightcycle"

config ZMK_SPLIT_ROLE_CENTRAL
    default y

endif

if SHIELD_DACTYL_LIGHTCYCLE_LEFT || SHIELD_DACTYL_LIGHTCYCLE_RIGHT

config ZMK_SPLIT
    default y

endif
```

## app/boards/shields/dactyl_lightcycle/Kconfig.shield
```kconfig
# Copyright (c) 2023 Matthew Adereth
# SPDX-License-Identifier: MIT

config SHIELD_DACTYL_LIGHTCYCLE_LEFT
    def_bool $(shields_list_contains,dactyl_lightcycle_left)

config SHIELD_DACTYL_LIGHTCYCLE_RIGHT
    def_bool $(shields_list_contains,dactyl_lightcycle_right)
```

## app/boards/shields/dactyl_manuform/Kconfig.defconfig
```kconfig
# Copyright (c) 2020 The ZMK Contributors
# SPDX-License-Identifier: MIT

if SHIELD_DACTYLMANUFORM

config ZMK_KEYBOARD_NAME
    default "dactyl_manuform"

# TODO: MOVE TO PARTICLE BOARD
config BUILD_OUTPUT_UF2
	default y

# TODO: MOVE TO PARTICLE BOARD
config FLASH_LOAD_OFFSET 
 	default 0x26000

config BT_CTLR
	default BT

config ZMK_BLE
	default y

config ZMK_USB
	default y

config USB_NRFX
	default y

config USB_DEVICE_STACK
	default y

# TODO: ADD SUPPORT FOR ZMK
# config ZMK_BATTERY_VOLTAGE_DIVIDER
# 	default y

endif # SHIELD_DACTYLMANUFORM
```

## app/boards/shields/dactyl_manuform/Kconfig.shield
```kconfig
# Copyright (c) 2020 The ZMK Contributors
# SPDX-License-Identifier: MIT

config SHIELD_DACTYLMANUFORM
	def_bool $(shields_list_contains,dactyl_manuform)
```

## app/boards/shields/dactyl_manuform_4x5/Kconfig.defconfig
```kconfig
if SHIELD_DACTYL_MANUFORM_4X5_LEFT

config ZMK_KEYBOARD_NAME
    default "Dactyl 4x5 Left"

config ZMK_SPLIT_BLE_ROLE_CENTRAL
    default y

endif

if SHIELD_DACTYL_MANUFORM_4X5_RIGHT

config ZMK_KEYBOARD_NAME
    default "Dactyl 4x5 Right"

endif

if SHIELD_DACTYL_MANUFORM_4X5_LEFT || SHIELD_DACTYL_MANUFORM_4X5_RIGHT

config ZMK_SPLIT
    default y
endif
```

## app/boards/shields/dactyl_manuform_4x5/Kconfig.shield
```kconfig
config SHIELD_DACTYL_MANUFORM_4X5_LEFT
    def_bool $(shields_list_contains,dactyl_manuform_4x5_left)

config SHIELD_DACTYL_MANUFORM_4X5_RIGHT
    def_bool $(shields_list_contains,dactyl_manuform_4x5_right)
```

## app/boards/shields/dactyl_tracer/Kconfig.defconfig
```kconfig
# Copyright (c) 2023 Matt Adereth
# SPDX-License-Identifier: MIT
if SHIELD_DACTYL_TRACER_LEFT

config ZMK_KEYBOARD_NAME
    default "Dactyl Tracer"

config ZMK_SPLIT_ROLE_CENTRAL
    default y

endif

if SHIELD_DACTYL_TRACER_LEFT || SHIELD_DACTYL_TRACER_RIGHT

config ZMK_SPLIT
    default y

endif
```

## app/boards/shields/dactyl_tracer/Kconfig.shield
```kconfig
# Copyright (c) 2023 Michael Johns
# SPDX-License-Identifier: MIT

config SHIELD_DACTYL_TRACER_LEFT
    def_bool $(shields_list_contains,dactyl_tracer_left)

config SHIELD_DACTYL_TRACER_RIGHT
    def_bool $(shields_list_contains,dactyl_tracer_right)
```

## app/boards/shields/derivative_dongle/Kconfig.defconfig
```kconfig
# Copyright (c) 2024 The ZMK Contributors
# SPDX-License-Identifier: MIT

if SHIELD_DERIVATIVE_DONGLE

config ZMK_KEYBOARD_NAME
    default "derivative"

# This device is the split central and the HID host endpoint.
config ZMK_SPLIT
    default y

config ZMK_SPLIT_ROLE_CENTRAL
    default y

# One peripheral: the derivative keyboard.
config ZMK_SPLIT_BLE_CENTRAL_PERIPHERALS
    default 1

# The dongle presents the keyboard to the host over USB and/or BLE.
config ZMK_USB
    default y

config ZMK_BLE
    default y

endif # SHIELD_DERIVATIVE_DONGLE
```

## app/boards/shields/derivative_dongle/Kconfig.shield
```kconfig
# Copyright (c) 2024 The ZMK Contributors
# SPDX-License-Identifier: MIT

config SHIELD_DERIVATIVE_DONGLE
    def_bool $(shields_list_contains,derivative_dongle)
```

## app/boards/shields/derivative_peripheral/Kconfig.defconfig
```kconfig
# Copyright (c) 2024 The ZMK Contributors
# SPDX-License-Identifier: MIT
#
# Config-only shield: turns the standalone derivative-rev-a board into a split
# PERIPHERAL that talks to the derivative_dongle central. The board's kscan,
# matrix transform, physical layout and RGB strip are all reused as-is.

if SHIELD_DERIVATIVE_PERIPHERAL

config ZMK_SPLIT
    default y

# Leave ZMK_SPLIT_ROLE_CENTRAL unset -> this side is the peripheral.

# Studio requires (!ZMK_SPLIT || ZMK_SPLIT_ROLE_CENTRAL); it lives on the dongle
# now, so force it off here to satisfy that dependency (see app/Kconfig).
config ZMK_STUDIO
    default n

endif # SHIELD_DERIVATIVE_PERIPHERAL
```

## app/boards/shields/derivative_peripheral/Kconfig.shield
```kconfig
# Copyright (c) 2024 The ZMK Contributors
# SPDX-License-Identifier: MIT

config SHIELD_DERIVATIVE_PERIPHERAL
    def_bool $(shields_list_contains,derivative_peripheral)
```

## app/boards/shields/dokkaebi/Kconfig.defconfig
```kconfig
if SHIELD_DOKKAEBI_LEFT

config ZMK_KEYBOARD_NAME
    default "dokkaebi"

config ZMK_SPLIT_ROLE_CENTRAL
    default y

endif

if SHIELD_DOKKAEBI_LEFT || SHIELD_DOKKAEBI_RIGHT

config ZMK_SPLIT
    default y

endif
```

## app/boards/shields/dokkaebi/Kconfig.shield
```kconfig
config SHIELD_DOKKAEBI_LEFT
    def_bool $(shields_list_contains,dokkaebi_left)

config SHIELD_DOKKAEBI_RIGHT
    def_bool $(shields_list_contains,dokkaebi_right)
```

## app/boards/shields/duck/Kconfig.defconfig
```kconfig
 # Copyright (c) 2020 The ZMK Contributors
 # SPDX-License-Identifier: MIT
 #
 # Author: Jack Hartstein

if SHIELD_DUCK

config ZMK_KEYBOARD_NAME
	default "duck"

endif
```

## app/boards/shields/duck/Kconfig.shield
```kconfig
 # Copyright (c) 2020 The ZMK Contributors
 # SPDX-License-Identifier: MIT
 #
 # Author: Jack Hartstein

config SHIELD_DUCK
	def_bool $(shields_list_contains, duck)
```

## app/boards/shields/duckboard/Kconfig.defconfig
```kconfig
 # Copyright (c) 2020 The ZMK Contributors
 # SPDX-License-Identifier: MIT
 #
 # Author: Jack Hartstein

if SHIELD_DUCKBOARD

config ZMK_KEYBOARD_NAME
	default "duckboard"

config ZMK_USB
	default y

config ZMK_BLE
	default y

endif
```

## app/boards/shields/duckboard/Kconfig.shield
```kconfig
 # Copyright (c) 2020 The ZMK Contributors
 # SPDX-License-Identifier: MIT
 #
 # Author: Jack Hartstein

config SHIELD_DUCKBOARD
	def_bool $(shields_list_contains,duckboard)
```

## app/boards/shields/dumbo/Kconfig.shield
```kconfig
# Copyright (c) 2021 The ZMK Contributors
# SPDX-License-Identifier: MIT

config SHIELD_DUMBO_LEFT
	def_bool $(shields_list_contains,dumbo_left)

config SHIELD_DUMBO_RIGHT
	def_bool $(shields_list_contains,dumbo_right)
```

## app/boards/shields/dumbpad/Kconfig.shield
```kconfig
# Copyright (c) 2022 The ZMK Contributors
# SPDX-License-Identifier: MIT

config SHIELD_DUMBPAD
	def_bool $(shields_list_contains,dumbpad)

config SHIELD_DUMBPAD_OLED_TOP
	def_bool $(shields_list_contains,dumbpad_oled_top)
```

## app/boards/shields/eek/Kconfig.defconfig
```kconfig
# Copyright (c) 2020 The ZMK Contributors
# SPDX-License-Identifier: MIT

if SHIELD_EEK

config ZMK_KEYBOARD_NAME
    default "eek! ~ Keyboard"

endif
```

## app/boards/shields/eek/Kconfig.shield
```kconfig
 #
 # Copyright (c) 2020 The ZMK Contributors
 #
 # SPDX-License-Identifier: MIT
 #

config SHIELD_EEK
    def_bool $(shields_list_contains,eek)
```

## app/boards/shields/elephant42/Kconfig.defconfig
```kconfig
# Copyright (c) 2021 The ZMK Contributors
# SPDX-License-Identifier: MIT

if SHIELD_ELEPHANT42_LEFT

config ZMK_KEYBOARD_NAME
    default "Elephant42"

config ZMK_SPLIT_ROLE_CENTRAL
    default y

endif

if SHIELD_ELEPHANT42_LEFT || SHIELD_ELEPHANT42_RIGHT

config ZMK_SPLIT
	default y
 
if ZMK_DISPLAY

config I2C
	default y

config SSD1306
	default y

config SSD1306_REVERSE_MODE
	default y

endif # ZMK_DISPLAY

if LVGL

config LVGL_HOR_RES_MAX
	default 128

config LVGL_VER_RES_MAX
	default 32

config LVGL_VDB_SIZE
	default 64

config LVGL_DPI
	default 148

config LVGL_BITS_PER_PIXEL
	default 1

choice LVGL_COLOR_DEPTH
	default LVGL_COLOR_DEPTH_1
endchoice

endif # LVGL

endif
```

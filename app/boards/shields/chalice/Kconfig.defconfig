## app/boards/shields/chalice/Kconfig.defconfig
```kconfig
# Copyright (c) 2021 The ZMK Contributors
# SPDX-License-Identifier: MIT

if SHIELD_CHALICE

config ZMK_KEYBOARD_NAME
    default "Chalice"

endif
```

## app/boards/shields/chalice/Kconfig.shield
```kconfig
# Copyright (c) 2021 The ZMK Contributors
# SPDX-License-Identifier: MIT

config SHIELD_CHALICE
    def_bool $(shields_list_contains,chalice)
```

## app/boards/shields/chocofi/Kconfig.shield
```kconfig
# Copyright (c) 2023 The ZMK Contributors
# SPDX-License-Identifier: MIT

config SHIELD_CHOCOFI_LEFT
    def_bool $(shields_list_contains,chocofi_left)

config SHIELD_CHOCOFI_RIGHT
    def_bool $(shields_list_contains,chocofi_right)
```

## app/boards/shields/clog/Kconfig.defconfig
```kconfig
# Copyright (c) 2022 The ZMK Contributors
# SPDX-License-Identifier: MIT

if SHIELD_CLOG_LEFT

config ZMK_KEYBOARD_NAME
	default "Clog"

config ZMK_SPLIT_BLE_ROLE_CENTRAL
	default y

endif

if SHIELD_CLOG_LEFT || SHIELD_CLOG_RIGHT

config ZMK_SPLIT
	default y

endif
```

## app/boards/shields/clog/Kconfig.shield
```kconfig
# Copyright (c) 2022 The ZMK Contributors
# SPDX-License-Identifier: MIT

config SHIELD_CLOG_LEFT
	def_bool $(shields_list_contains,clog_left)

config SHIELD_CLOG_RIGHT
	def_bool $(shields_list_contains,clog_right)
```

## app/boards/shields/clueboard_california/Kconfig.defconfig
```kconfig
if SHIELD_CLUEBOARD_CALIFORNIA

config ZMK_KEYBOARD_NAME
	default "Clueboard California Macropad"

# Unable to use interrupts as the same pin number is used
# across A & B controllers, and STM32F303CCT6 can't enable
# interrutps for multiple controllers for the same "line"
# for the external interrupts.
config ZMK_KSCAN_DIRECT_POLLING
	default y

endif
```

## app/boards/shields/clueboard_california/Kconfig.shield
```kconfig
# Copyright (c) 2020 Pete Johanson
# SPDX-License-Identifier: MIT

config SHIELD_CLUEBOARD_CALIFORNIA
	def_bool $(shields_list_contains,clueboard_california)
```

## app/boards/shields/contra/Kconfig.defconfig
```kconfig
# Copyright (c) 2020 The ZMK Contributors
# SPDX-License-Identifier: MIT

if SHIELD_CONTRA

config ZMK_KEYBOARD_NAME
    default "Contra Keyboard"

endif
```

## app/boards/shields/contra/Kconfig.shield
```kconfig
# Copyright (c) 2021 The ZMK Contributors
# SPDX-License-Identifier: MIT

config SHIELD_CONTRA
    def_bool $(shields_list_contains,contra)
```

## app/boards/shields/corne/Kconfig.defconfig
```kconfig
if SHIELD_CORNE_DONGLE

config ZMK_KEYBOARD_NAME
    default "Corne_DONGLE"

config ZMK_SPLIT_ROLE_CENTRAL
    default y

endif

if SHIELD_CORNE_LEFT || SHIELD_CORNE_RIGHT || SHIELD_CORNE_DONGLE

config ZMK_SPLIT
    default y

if ZMK_DISPLAY

config I2C
    default n

config SSD1306
    default n

endif # ZMK_DISPLAY

if LVGL

config LV_Z_VDB_SIZE
    default 64

config LV_DPI_DEF
    default 148

config LV_Z_BITS_PER_PIXEL
    default 1

choice LV_COLOR_DEPTH
    default LV_COLOR_DEPTH_1
endchoice

endif # LVGL

endif
```

## app/boards/shields/corne/Kconfig.shield
```kconfig
# Copyright (c) 2020 Pete Johanson
# SPDX-License-Identifier: MIT

config SHIELD_CORNE_LEFT
	def_bool $(shields_list_contains,corne_left)

config SHIELD_CORNE_RIGHT
	def_bool $(shields_list_contains,corne_right)
```

## app/boards/shields/corneish_zen_dongle/Kconfig.defconfig
```kconfig
# Copyright (c) 2020 The ZMK Contributors
# SPDX-License-Identifier: MIT

if SHIELD_CORNEISH_ZEN_DONGLE

config BOARD
    default "corneish_zen"

config ZMK_KEYBOARD_NAME
	default "Corne-ish Zen"
	
config ZMK_SPLIT_BLE_ROLE_CENTRAL
	default y
	
config ZMK_USB
	default y

config ZMK_SPLIT
	default y

config ZMK_BLE
	default y
	
endif
```

## app/boards/shields/corneish_zen_dongle/Kconfig.shield
```kconfig
# Copyright (c) 2020 The ZMK Contributors
# SPDX-License-Identifier: MIT

config SHIELD_CORNEISH_ZEN_DONGLE
	def_bool $(shields_list_contains,corneish_zen_dongle)
```

## app/boards/shields/cornix_dongle_adapter/Kconfig.shield
```kconfig
config SHIELD_CORNIX_DONGLE_ADAPTER
	def_bool $(shields_list_contains,cornix_dongle_adapter)

#vim: set ft=kconfig:
```

## app/boards/shields/cornixqf/Kconfig.defconfig
```kconfig
if SHIELD_CORNIXQF_DONGLE

config ZMK_KEYBOARD_NAME
    default "DONGLE_CORNIX"

config ZMK_SPLIT_ROLE_CENTRAL
    default y

endif


if SHIELD_CORNIXQF_LEFT || SHIELD_CORNIXQF_RIGHT || SHIELD_CORNIXQF_DONGLE 

config ZMK_SPLIT
    default y

if ZMK_DISPLAY

config I2C
    default n

config SSD1306
    default n

endif # ZMK_DISPLAY

if LVGL

config LV_Z_VDB_SIZE
    default 64

config LV_DPI_DEF
    default 148

config LV_Z_BITS_PER_PIXEL
    default 1

choice LV_COLOR_DEPTH
    default LV_COLOR_DEPTH_1
endchoice

endif # LVGL

endif
```

## app/boards/shields/cornixqf/Kconfig.shield
```kconfig
# Copyright (c) 2020 Pete Johanson
# SPDX-License-Identifier: MIT

config SHIELD_CORNIXQF_LEFT
    def_bool $(shields_list_contains,cornixqf_left)

config SHIELD_CORNIXQF_RIGHT
    def_bool $(shields_list_contains,cornixqf_right)

config SHIELD_CORNIXQF_DONGLE
    def_bool $(shields_list_contains,cornixqf_dongle)
```

## app/boards/shields/cradio/Kconfig.defconfig
```kconfig
# Copyright (c) 2020 The ZMK Contributors
# SPDX-License-Identifier: MIT

if SHIELD_CRADIO_LEFT

config ZMK_KEYBOARD_NAME
	default "cradio left"

config ZMK_SPLIT_BLE_ROLE_CENTRAL
	default y

endif

if SHIELD_CRADIO_RIGHT

config ZMK_KEYBOARD_NAME
	default "cradio right"

endif

if SHIELD_CRADIO_LEFT || SHIELD_CRADIO_RIGHT

config ZMK_SPLIT
	default y
	
endif
```

## app/boards/shields/cradio/Kconfig.shield
```kconfig
# Copyright (c) 2020 The ZMK Contributors
# SPDX-License-Identifier: MIT

config SHIELD_CRADIO_LEFT
	def_bool $(shields_list_contains,cradio_left)

config SHIELD_CRADIO_RIGHT
	def_bool $(shields_list_contains,cradio_right)
```

## app/boards/shields/cradios/Kconfig.defconfig
```kconfig
config ZMK_KEYBOARD_NAME
	default "cradios"

# Unable to use interrupts as the same pin number is used
# across A & B controllers, and STM32F303CCT6 can't enable
# interrutps for multiple controllers for the same "line"
# for the external interrupts.
config ZMK_KSCAN_GPIO_POLLING
	default y
```

## app/boards/shields/cradios/Kconfig.shield
```kconfig
# Copyright (c) 2020 Pete Johanson
# SPDX-License-Identifier: MIT

config SHIELD_CRADIOS
	def_bool $(shields_list_contains,cradios)
```

## app/boards/shields/crbn/Kconfig.defconfig
```kconfig
# Copyright (c) 2020 The ZMK Contributors
# SPDX-License-Identifier: MIT

if SHIELD_CRBN

config ZMK_KEYBOARD_NAME
	default "CRBN"

endif
```

## app/boards/shields/crbn/Kconfig.shield
```kconfig
# Copyright (c) 2020 The ZMK Contributors
# SPDX-License-Identifier: MIT

config SHIELD_CRBN
	def_bool $(shields_list_contains,crbn)
```

## app/boards/shields/dactyl/Kconfig.defconfig
```kconfig
# Copyright (c) 2023 Matt Adereth
# SPDX-License-Identifier: MIT
if SHIELD_DACTYL_LEFT

config ZMK_KEYBOARD_NAME
    default "Dactyl"

config ZMK_SPLIT_ROLE_CENTRAL
    default y

endif

if SHIELD_DACTYL_LEFT || SHIELD_DACTYL_RIGHT

config ZMK_SPLIT
    default y

endif
```

## app/boards/shields/dactyl/Kconfig.shield
```kconfig
# Copyright (c) 2023 Matt Adereth
# SPDX-License-Identifier: MIT

config SHIELD_DACTYL_LEFT
    def_bool $(shields_list_contains,dactyl_left)

config SHIELD_DACTYL_RIGHT
    def_bool $(shields_list_contains,dactyl_right)
```

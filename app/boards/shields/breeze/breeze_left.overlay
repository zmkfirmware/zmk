/*
 * Copyright (c) 2020 Pete Johanson
 *
 * SPDX-License-Identifier: MIT
 */

#include "breeze.dtsi"

&kscan0 {
		row-gpios
			= <&pro_micro_a 3  (GPIO_ACTIVE_HIGH | GPIO_PULL_DOWN)>
			, <&pro_micro_a 2  (GPIO_ACTIVE_HIGH | GPIO_PULL_DOWN)>
			, <&pro_micro_a 1  (GPIO_ACTIVE_HIGH | GPIO_PULL_DOWN)>
			, <&pro_micro_a 0  (GPIO_ACTIVE_HIGH | GPIO_PULL_DOWN)>
			, <&pro_micro_d 15 (GPIO_ACTIVE_HIGH | GPIO_PULL_DOWN)>
			;

};

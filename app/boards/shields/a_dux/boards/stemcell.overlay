/*
 * Copyright (c) 2022 The ZMK Contributors
 *
 * SPDX-License-Identifier: MIT
 */

/ {
	chosen {
		zmk,split-serial = &usart1;
	};
};

&usart1 {
	status = "okay";
};

&kscan0 {
	input-gpios =
		<&pro_micro_d  5 (GPIO_ACTIVE_LOW | GPIO_PULL_UP)>,
		<&pro_micro_d  0 (GPIO_ACTIVE_LOW | GPIO_PULL_UP)>,
		<&pro_micro_a  0 (GPIO_ACTIVE_LOW | GPIO_PULL_UP)>,
		<&pro_micro_d 16 (GPIO_ACTIVE_LOW | GPIO_PULL_UP)>,
		<&pro_micro_a  3 (GPIO_ACTIVE_LOW | GPIO_PULL_UP)>,
		<&pro_micro_d  6 (GPIO_ACTIVE_LOW | GPIO_PULL_UP)>,
		<&pro_micro_d  2 (GPIO_ACTIVE_LOW | GPIO_PULL_UP)>, /* Changed since swapped pins */
		<&pro_micro_a  1 (GPIO_ACTIVE_LOW | GPIO_PULL_UP)>,
		<&pro_micro_d 14 (GPIO_ACTIVE_LOW | GPIO_PULL_UP)>,
		<&pro_micro_a  2 (GPIO_ACTIVE_LOW | GPIO_PULL_UP)>,
		<&pro_micro_d  7 (GPIO_ACTIVE_LOW | GPIO_PULL_UP)>,
		<&pro_micro_d  4 (GPIO_ACTIVE_LOW | GPIO_PULL_UP)>,
		<&pro_micro_d  1 (GPIO_ACTIVE_LOW | GPIO_PULL_UP)>, /* TODO: Use 0 if Console is needed */
		<&pro_micro_d 15 (GPIO_ACTIVE_LOW | GPIO_PULL_UP)>,
		<&pro_micro_d 10 (GPIO_ACTIVE_LOW | GPIO_PULL_UP)>,
		<&pro_micro_d  8 (GPIO_ACTIVE_LOW | GPIO_PULL_UP)>,
		<&pro_micro_d  9 (GPIO_ACTIVE_LOW | GPIO_PULL_UP)>
	;
};

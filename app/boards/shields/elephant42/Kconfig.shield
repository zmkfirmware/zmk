## app/boards/shields/elephant42/Kconfig.shield
```kconfig
# Copyright (c) 2021 The ZMK Contributors
# SPDX-License-Identifier: MIT

config SHIELD_ELEPHANT42_LEFT
    def_bool $(shields_list_contains,elephant42_left)

config SHIELD_ELEPHANT42_RIGHT
    def_bool $(shields_list_contains,elephant42_right)
```

## app/boards/shields/ergo_s1_oe/Kconfig.shield
```kconfig
# Copyright (c) 2021 The ZMK Contributors
# SPDX-License-Identifier: MIT

config SHIELD_ERGO_S1_OE_LEFT
    def_bool $(shields_list_contains,ergo_s1_oe_left)

config SHIELD_ERGO_S1_OE_RIGHT
    def_bool $(shields_list_contains,ergo_s1_oe_right)
```

## app/boards/shields/ergodash/Kconfig.defconfig
```kconfig
# Copyright (c) 2020 The ZMK Contributors
# SPDX-License-Identifier: MIT

if SHIELD_ERGODASH_LEFT

config ZMK_KEYBOARD_NAME
	default "Ergodash"

config ZMK_SPLIT_ROLE_CENTRAL
	default y

endif

if SHIELD_ERGODASH_LEFT || SHIELD_ERGODASH_RIGHT

config ZMK_SPLIT
	default y

endif
```

## app/boards/shields/ergodash/Kconfig.shield
```kconfig
# Copyright (c) 2020 The ZMK Contributors
# SPDX-License-Identifier: MIT

config SHIELD_ERGODASH_LEFT
	def_bool $(shields_list_contains,ergodash_left)

config SHIELD_ERGODASH_RIGHT
	def_bool $(shields_list_contains,ergodash_right)
```

## app/boards/shields/ergos1_oe/Kconfig.defconfig
```kconfig
# Copyright (c) 2021 The ZMK Contributors
# SPDX-License-Identifier: MIT
if SHIELD_ERGOS1_OE_LEFT

config ZMK_KEYBOARD_NAME
    default "Ergo S-1"

config ZMK_SPLIT_ROLE_CENTRAL
    default y

endif

if SHIELD_ERGOS1_OE_LEFT || SHIELD_ERGOS1_OE_RIGHT

config ZMK_SPLIT
    default y

endif
```

## app/boards/shields/ergos1_oe/Kconfig.shield
```kconfig
# Copyright (c) 2021 The ZMK Contributors
# SPDX-License-Identifier: MIT
config SHIELD_ERGOS1_OE_LEFT
    def_bool $(shields_list_contains,ergos1_oe_left)

config SHIELD_ERGOS1_OE_RIGHT
    def_bool $(shields_list_contains,ergos1_oe_right)
```

## app/boards/shields/ergos1_ose/Kconfig.shield
```kconfig
# Copyright (c) 2021 The ZMK Contributors
# SPDX-License-Identifier: MIT
config SHIELD_ERGOS1_OSE_LEFT
	def_bool $(shields_list_contains,ergos1_ose_left)

config SHIELD_ERGOS1_OSE_RIGHT
	def_bool $(shields_list_contains,ergos1_ose_right)
```

## app/boards/shields/eternal_keypad/Kconfig.defconfig
```kconfig
# Copyright (c) 2022 The ZMK Contributors
# SPDX-License-Identifier: MIT

if SHIELD_ETERNAL_KEYPAD || SHIELD_ETERNAL_KEYPAD_LEFTY

config ZMK_KEYBOARD_NAME
	default "Eternal Keypad"

endif
```

## app/boards/shields/eternal_keypad/Kconfig.shield
```kconfig
# Copyright (c) 2022 The ZMK Contributors
# SPDX-License-Identifier: MIT

config SHIELD_ETERNAL_KEYPAD
	def_bool $(shields_list_contains,eternal_keypad)

config SHIELD_ETERNAL_KEYPAD_LEFTY
	def_bool $(shields_list_contains,eternal_keypad_lefty)
```

## app/boards/shields/fa65/Kconfig.defconfig
```kconfig
# Copyright (c) 2020 The ZMK Contributors
# SPDX-License-Identifier: MIT

if SHIELD_FA65

config ZMK_KEYBOARD_NAME
	default "fa65"

endif
```

## app/boards/shields/fa65/Kconfig.shield
```kconfig
# Copyright (c) 2020 The ZMK Contributors
# SPDX-License-Identifier: MIT

config SHIELD_FA65
	def_bool $(shields_list_contains,fa65)
```

## app/boards/shields/ferris_sweep_v2/Kconfig.shield
```kconfig
# Copyright (c) 2021 The ZMK Contributors
# SPDX-License-Identifier: MIT

config SHIELD_FERRIS_SWEEP_V2_LEFT
	def_bool $(shields_list_contains,ferris_sweep_v2_left)

config SHIELD_FERRIS_SWEEP_V2_RIGHT
	def_bool $(shields_list_contains,ferris_sweep_v2_right)
```

## app/boards/shields/fifi/Kconfig.shield
```kconfig
# Copyright (c) 2022 The ZMK Contributors
# SPDX-License-Identifier: MIT

config SHIELD_FIFI_LEFT
	def_bool $(shields_list_contains,fifi_left)

config SHIELD_FIFI_RIGHT
	def_bool $(shields_list_contains,fifi_right)
```

## app/boards/shields/float/Kconfig.defconfig
```kconfig
if SHIELD_FLOAT_LEFT

config ZMK_KEYBOARD_NAME
    default "float"

config ZMK_SPLIT_ROLE_CENTRAL
    default y

endif

if SHIELD_FLOAT_LEFT || SHIELD_FLOAT_RIGHT

config ZMK_SPLIT
    default y

if LVGL

config LV_Z_VDB_SIZE
    default 64

config LV_DPI_DEF
    default 148

config LV_Z_BITS_PER_PIXEL
    default 1

choice LV_COLOR_DEPTH
    default LV_COLOR_DEPTH_1
endchoice

endif # LVGL

endif
```

## app/boards/shields/float/Kconfig.shield
```kconfig
# Copyright (c) 2020 Pete Johanson
# SPDX-License-Identifier: MIT

config SHIELD_FLOAT_LEFT
    def_bool $(shields_list_contains,float_left)

config SHIELD_FLOAT_RIGHT
    def_bool $(shields_list_contains,float_right)
```

## app/boards/shields/fourier/Kconfig.defconfig
```kconfig
# Copyright (c) 2021 The ZMK Contributors
# SPDX-License-Identifier: MIT


if SHIELD_FOURIER_LEFT

config ZMK_KEYBOARD_NAME
	default "Fourier"

config ZMK_SPLIT_ROLE_CENTRAL
	default y

endif

if SHIELD_FOURIER_LEFT || SHIELD_FOURIER_RIGHT

config ZMK_SPLIT
	default y

endif
```

## app/boards/shields/fourier/Kconfig.shield
```kconfig
# Copyright (c) 2021 The ZMK Contributors
# SPDX-License-Identifier: MIT


config SHIELD_FOURIER_LEFT
	def_bool $(shields_list_contains,fourier_left)

config SHIELD_FOURIER_RIGHT
	def_bool $(shields_list_contains,fourier_right)
```

## app/boards/shields/gherkin/Kconfig.defconfig
```kconfig
# Copyright (c) 2020 The ZMK Contributors
# SPDX-License-Identifier: MIT

if SHIELD_GHERKIN

config ZMK_KEYBOARD_NAME
    default "Gherkin"

endif
```

## app/boards/shields/helix/Kconfig.defconfig
```kconfig
# Copyright (c) 2020 The ZMK Contributors
# SPDX-License-Identifier: MIT

if SHIELD_HELIX_LEFT

config ZMK_KEYBOARD_NAME
    default "Helix"

config ZMK_SPLIT_ROLE_CENTRAL
    default y

endif

if SHIELD_HELIX_LEFT || SHIELD_HELIX_RIGHT

config ZMK_SPLIT
    default y

endif
```

## app/boards/shields/helix/Kconfig.shield
```kconfig
# Copyright (c) 2020 The ZMK Contributors
# SPDX-License-Identifier: MIT

config SHIELD_HELIX_LEFT
    def_bool $(shields_list_contains,helix_left)

config SHIELD_HELIX_RIGHT
    def_bool $(shields_list_contains,helix_right)
```

## app/boards/shields/helix_4/Kconfig.defconfig
```kconfig
# Copyright (c) 2021 The ZMK Contributors
# SPDX-License-Identifier: MIT

if SHIELD_HELIX_4_LEFT

config ZMK_KEYBOARD_NAME
	default "Helix"

config ZMK_SPLIT_BLE_ROLE_CENTRAL
	default y

endif

if SHIELD_HELIX_4_RIGHT

config ZMK_KEYBOARD_NAME
	default "Helix Right"

config USB
	default y

endif

if SHIELD_HELIX_4_LEFT || SHIELD_HELIX_4_RIGHT

config ZMK_SPLIT
  default y

# config DEVICE_POWER_MANAGEMENT
# 	default y

if ZMK_RGB_UNDERGLOW

config WS2812_STRIP
	default y

endif # ZMK_RGB_UNDERGLOW

endif
```

## app/boards/shields/helix_4/Kconfig.shield
```kconfig
# Copyright (c) 2020 The ZMK Contributors
# SPDX-License-Identifier: MIT

config SHIELD_HELIX_4_LEFT
  def_bool $(shields_list_contains,helix_4_left)

config SHIELD_HELIX_4_RIGHT
  def_bool $(shields_list_contains,helix_4_right)
```

## app/boards/shields/hillside/Kconfig.defconfig
```kconfig
# Copyright (c) 2021 The ZMK Contributors
# SPDX-License-Identifier: MIT

if SHIELD_HILLSIDE_LEFT

config ZMK_KEYBOARD_NAME
    default "Hillside"

config ZMK_SPLIT_BLE_ROLE_CENTRAL
    default y

endif

if SHIELD_HILLSIDE_LEFT || SHIELD_HILLSIDE_RIGHT

config ZMK_SPLIT
    default y

endif
```

## app/boards/shields/hillside/Kconfig.shield
```kconfig
# Copyright (c) 2021 The ZMK Contributors
# SPDX-License-Identifier: MIT

config SHIELD_HILLSIDE_LEFT
    def_bool $(shields_list_contains,hillside_left)

config SHIELD_HILLSIDE_RIGHT
    def_bool $(shields_list_contains,hillside_right)
```

## app/boards/shields/horizon/Kconfig.shield
```kconfig
# Copyright (c) 2021 The ZMK Contributors
# SPDX-License-Identifier: MIT

config SHIELD_HORIZON
    def_bool $(shields_list_contains,horizon)
```

/*
 * Copyright (c) 2020 Pete Johanson
 *
 * SPDX-License-Identifier: MIT
 */

#include "pteron36.dtsi"

&kscan0 {
	col-gpios
		= <&pro_micro_a  1 (GPIO_ACTIVE_HIGH | GPIO_PULL_DOWN)>
		, <&pro_micro_a  0 (GPIO_ACTIVE_HIGH | GPIO_PULL_DOWN)>
		, <&pro_micro_d 15 (GPIO_ACTIVE_HIGH | GPIO_PULL_DOWN)>
		, <&pro_micro_d 14 (GPIO_ACTIVE_HIGH | GPIO_PULL_DOWN)>
		, <&pro_micro_d 16 (GPIO_ACTIVE_HIGH | GPIO_PULL_DOWN)>
		;
};

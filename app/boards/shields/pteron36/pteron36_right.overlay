/*
 * Copyright (c) 2020 Pete Johanson
 *
 * SPDX-License-Identifier: MIT
 */

#include "pteron36.dtsi"

&default_transform {
	col-offset = <5>;
};

&kscan0 {
	col-gpios
		= <&pro_micro  16 (GPIO_ACTIVE_HIGH | GPIO_PULL_DOWN)>
		, <&pro_micro  14 (GPIO_ACTIVE_HIGH | GPIO_PULL_DOWN)>
		, <&pro_micro  15 (GPIO_ACTIVE_HIGH | GPIO_PULL_DOWN)>
		, <&pro_micro   0 (GPIO_ACTIVE_HIGH | GPIO_PULL_DOWN)>
		, <&pro_micro   1 (GPIO_ACTIVE_HIGH | GPIO_PULL_DOWN)>
		;
};

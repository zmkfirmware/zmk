#include <dt-bindings/zmk/matrix_transform.h>

/ {
    chosen {
        zmk,kscan = &kscan0;
        zmk,matrix-transform = &transform0;
    };

    kscan0: kscan {
        compatible = "zmk,kscan-gpio-direct";
        wakeup-source;
        debounce-press-ms = <10>;
        debounce-release-ms = <10>;
        input-gpios
            = <&gpio0 11 (GPIO_ACTIVE_LOW | GPIO_PULL_UP)>
            , <&gpio0 12 (GPIO_ACTIVE_LOW | GPIO_PULL_UP)>
            , <&gpio0 24 (GPIO_ACTIVE_LOW | GPIO_PULL_UP)>
            , <&gpio0 25 (GPIO_ACTIVE_LOW | GPIO_PULL_UP)>;
    };

    transform0: keymap_transform {
        compatible = "zmk,matrix-transform";
        columns = <4>;
        rows = <1>;
        map = <RC(0,0)  RC(0,1)  RC(0,2)  RC(0,3)>;
    };
};

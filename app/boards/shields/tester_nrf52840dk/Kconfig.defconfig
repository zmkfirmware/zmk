## app/boards/shields/tester_nrf52840dk/Kconfig.defconfig
```kconfig
if SHIELD_TESTER_NRF52840DK

config ZMK_KEYBOARD_NAME
    default "ZMK Tester"

config ZMK_BLE
    def_bool n

config SETTINGS
    def_bool n

endif
```

## app/boards/shields/tester_nrf52840dk/Kconfig.shield
```kconfig
config SHIELD_TESTER_NRF52840DK
    def_bool $(shields_list_contains,tester_nrf52840dk)
```

## app/boards/shields/tester_pro_micro/Kconfig.defconfig
```kconfig
if SHIELD_TESTER_PRO_MICRO

config ZMK_KEYBOARD_NAME
    default "ZMK Tester"

config ZMK_BLE
    def_bool n

config SETTINGS
    def_bool n

endif
```

## app/boards/shields/tester_pro_micro/Kconfig.shield
```kconfig
config SHIELD_TESTER_PRO_MICRO
    def_bool $(shields_list_contains,tester_pro_micro)
```

## app/boards/shields/tester_rpi_pico/Kconfig.defconfig
```kconfig
if SHIELD_TESTER_RPI_PICO

config ZMK_KEYBOARD_NAME
    default "ZMK Tester"

config ZMK_BLE
    def_bool n

config SETTINGS
    def_bool n

endif
```

## app/boards/shields/tester_rpi_pico/Kconfig.shield
```kconfig
config SHIELD_TESTER_RPI_PICO
    def_bool $(shields_list_contains,tester_rpi_pico)
```

## app/boards/shields/tester_xiao/Kconfig.defconfig
```kconfig
if SHIELD_TESTER_XIAO

config ZMK_KEYBOARD_NAME
    default "ZMK Tester"

config ZMK_BLE
    def_bool n

config SETTINGS
    def_bool n

endif
```

## app/boards/shields/tg4x/Kconfig.defconfig
```kconfig
# Copyright (c) 2020 The ZMK Contributors
# SPDX-License-Identifier: MIT

if SHIELD_TG4X

config ZMK_KEYBOARD_NAME
    default "TG4x"

endif
```

## app/boards/shields/tg4x/Kconfig.shield
```kconfig
# Copyright (c) 2020 The ZMK Contributors
# SPDX-License-Identifier: MIT

config SHIELD_TG4X
	def_bool $(shields_list_contains,tg4x)
```

## app/boards/shields/tg4x/boards/nice_nano.conf
```kconfig
# Copyright (c) 2020 The ZMK Contributors
# SPDX-License-Identifier: MIT

# Enable underglow
CONFIG_ZMK_RGB_UNDERGLOW=y
```

## app/boards/shields/tidbit/Kconfig.shield
```kconfig
# Copyright (c) 2020 The ZMK Contributors
# SPDX-License-Identifier: MIT

config SHIELD_TIDBIT
	def_bool $(shields_list_contains,tidbit)

config SHEILD_TIDBIT_19KEY
	def_bool $(shields_list_contains,tidbit_19key)
```

## app/boards/shields/tkl_nrf52832/Kconfig.shield
```kconfig
# Copyright (c) 2025 The ZMK Contributors
# SPDX-License-Identifier: MIT

config SHIELD_TKL_NRF52832
    def_bool $(shields_list_contains,tkl_nrf52832)
```

## app/boards/shields/two_percent_milk/Kconfig.defconfig
```kconfig
# Copyright (c) 2022 The ZMK Contributors
# SPDX-License-Identifier: MIT

if SHIELD_TWO_PERCENT_MILK

config ZMK_KEYBOARD_NAME
    default "2% Milk"

endif
```

## app/boards/shields/two_percent_milk/Kconfig.shield
```kconfig
# Copyright (c) 2022 The ZMK Contributors
# SPDX-License-Identifier: MIT

config SHIELD_TWO_PERCENT_MILK
    def_bool $(shields_list_contains,two_percent_milk)
```

## app/boards/shields/ut47/Kconfig.defconfig
```kconfig
# Copyright (c) 2020 The ZMK Contributors
# SPDX-License-Identifier: MIT

if SHIELD_UT47

config ZMK_KEYBOARD_NAME
    default "UT47"

endif
```

## app/boards/shields/ut47/Kconfig.shield
```kconfig
# Copyright (c) 2020 The ZMK Contributors
# SPDX-License-Identifier: MIT

config SHIELD_UT47
   def_bool $(shields_list_contains,ut47)
```

## app/boards/shields/viterbi/Kconfig.defconfig
```kconfig
# Copyright (c) 2020 The ZMK Contributors
# SPDX-License-Identifier: MIT

if SHIELD_VITERBI_REV2_LEFT

config ZMK_KEYBOARD_NAME
	default "Viterbi"

config ZMK_SPLIT_ROLE_CENTRAL
	default y

endif

if SHIELD_VITERBI

config ZMK_SPLIT
	default y

endif
```

## app/boards/shields/viterbi/Kconfig.shield
```kconfig
# Copyright (c) 2020 The ZMK Contributors
# SPDX-License-Identifier: MIT

config SHIELD_VITERBI_REV2_LEFT
	def_bool $(shields_list_contains,viterbi_rev2_left)

config SHIELD_VITERBI_REV2_RIGHT
	def_bool $(shields_list_contains,viterbi_rev2_right)
```

## app/boards/shields/waterfowl/Kconfig.shield
```kconfig
#Copyright (c) 2022 The ZMK Contributors
#SPDX-License-Identifier: MIT


config SHIELD_WATERFOWL_LEFT
	def_bool $(shields_list_contains,waterfowl_left)

config SHIELD_WATERFOWL_RIGHT
	def_bool $(shields_list_contains,waterfowl_right)
```

## app/boards/shields/wing36/Kconfig.defconfig
```kconfig
if SHIELD_WING36_LEFT

config ZMK_KEYBOARD_NAME
    default "wing36"

config ZMK_SPLIT_ROLE_CENTRAL
    default y

endif

if SHIELD_WING36_LEFT || SHIELD_WING36_RIGHT

config ZMK_SPLIT
    default y

endif
```

## app/boards/shields/wing36/Kconfig.shield
```kconfig
config SHIELD_WING36_LEFT
  def_bool $(shields_list_contains,wing36_left)

config SHIELD_WING36_RIGHT
  def_bool $(shields_list_contains,wing36_right)
```

## app/boards/shields/zmk_uno/Kconfig.defconfig
```kconfig
# Copyright (c) 2022 The ZMK Contributors
# SPDX-License-Identifier: MIT

if SHIELD_ZMK_UNO_BASE

config SHIELD_ZMK_UNO_PM
    bool "ZMK Uno Automatic Power Management"
    default y
    select ZMK_POWER_DOMAINS
    select ZMK_POWER_DOMAINS_DYNAMIC_DEFAULT
    select PM_DEVICE
    select PM_DEVICE_POWER_DOMAIN
    select PM_DEVICE_RUNTIME
    select POWER_DOMAIN
    select POWER_DOMAIN_GPIO

config ZMK_KEYBOARD_NAME
    default "ZMK Uno"

config ZMK_BACKLIGHT
    select LED
    select LED_GPIO

config SHIELD_SSD1306_128X64
    select ZMK_DISPLAY

config SHIELD_SSD1306_128X32
    select ZMK_DISPLAY

config ZMK_RGB_UNDERGLOW
    select WS2812_STRIP
    select SPI

config ZMK_PM_SOFT_OFF
    default y if BOARD_NRF52840DK_NRF52840

endif
```

## app/boards/shields/zmk_uno/Kconfig.shield
```kconfig
# Copyright (c) 2022 The ZMK Contributors
# SPDX-License-Identifier: MIT

config SHIELD_ZMK_UNO_BASE
    bool

config SHIELD_ZMK_UNO
    def_bool $(shields_list_contains,zmk_uno)
    select SHIELD_ZMK_UNO_BASE

config SHIELD_ZMK_UNO_SPLIT_LEFT
    def_bool $(shields_list_contains,zmk_uno_split_left)
    select SHIELD_ZMK_UNO_BASE
    select ZMK_SPLIT
    select ZMK_SPLIT_ROLE_CENTRAL

config SHIELD_ZMK_UNO_SPLIT_RIGHT
    def_bool $(shields_list_contains,zmk_uno_split_right)
    select SHIELD_ZMK_UNO_BASE
    select ZMK_SPLIT
```

/*
 * Copyright (c) 2022 The ZMK Contributors
 *
 * SPDX-License-Identifier: MIT
 */

#include <behaviors.dtsi>
#include <dt-bindings/zmk/params.h>

#define BASE 0
#define BLE 1

/ {
        keymap {
            compatible = "zmk,keymap";

            base_layer {
              display-name = "BASE";
              bindings = <
                // ╭─────────────┬──────────────┬──────────────────┬─────────────┬─────────────╮
                     &mo BLE      &kp C_PREVIOUS  &kp C_PLAY_PAUSE    &kp C_NEXT   &kp C_MUTE
                // ╰─────────────┴──────────────┴──────────────────┴─────────────┴─────────────╯
              >;
              sensor-bindings = <&inc_dec_kp C_VOL_UP C_VOL_DN>;
            };

            ble_layer {
              display-name = "BLE";
              bindings = <
                // ╭─────────────┬─────────────┬─────────────┬─────────────┬─────────────╮
                     &trans     &out OUT_TOG   &bt BT_PRV    &bt BT_NXT    &bt BT_CLR
                // ╰─────────────┴─────────────┴─────────────┴─────────────┴─────────────╯
              >;
            };
        };
};


/ {
	chosen {
		zmk,kscan = &kscan0;
	};

	kscan0: kscan {
		compatible = "zmk,kscan-gpio-matrix";
		label = "KSCAN";

		diode-direction = "row2col";
		row-gpios = <&pro_micro_d 6 (GPIO_ACTIVE_LOW | GPIO_PULL_UP)>,
		            <&pro_micro_d 7 (GPIO_ACTIVE_LOW | GPIO_PULL_UP)>;
		col-gpios = <&pro_micro_d 8 (GPIO_ACTIVE_LOW | GPIO_PULL_UP)>,
		            <&pro_micro_d 9 (GPIO_ACTIVE_LOW | GPIO_PULL_UP)>;
	};
};

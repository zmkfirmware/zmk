/*
 * Copyright (c) 2020 Pete Johanson
 *
 * SPDX-License-Identifier: MIT
 */

#include "kyria.dtsi"

&default_transform {
	col-offset = <8>;
};

&kscan0 {
	col-gpios
		= <&pro_micro 10 GPIO_ACTIVE_HIGH>
		, <&pro_micro 16 GPIO_ACTIVE_HIGH>
		, <&pro_micro 14 GPIO_ACTIVE_HIGH>
		, <&pro_micro 15 GPIO_ACTIVE_HIGH>
		, <&pro_micro 18 GPIO_ACTIVE_HIGH>
		, <&pro_micro 19 GPIO_ACTIVE_HIGH>
		, <&pro_micro 20 GPIO_ACTIVE_HIGH>
		, <&pro_micro 21 GPIO_ACTIVE_HIGH>
		;
};


&right_encoder {
	status = "okay";
};

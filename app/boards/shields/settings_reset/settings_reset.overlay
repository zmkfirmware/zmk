/*
 * Copyright (c) 2020 The ZMK Contributors
 *
 * SPDX-License-Identifier: MIT
 */

#include <dt-bindings/zmk/matrix_transform.h>

/ {
    chosen {
        zmk,matrix-input = &settings_reset_matrix;
    };

    settings_reset_matrix: settings_reset_matrix {
        compatible = "zmk,input-matrix-mock";
        columns = <1>;
        rows = <0>;

        events = <>;
    };

};


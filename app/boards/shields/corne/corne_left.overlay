/*
 * Copyright (c) 2020 Pete Johanson
 *
 * SPDX-License-Identifier: MIT
 */

#include "corne.dtsi"

&kscan0 {
    diode-direction = "col2row";
    row-gpios
        = <&gpio0  4 (GPIO_ACTIVE_HIGH | GPIO_PULL_DOWN)>
        , <&gpio0  29 (GPIO_ACTIVE_HIGH | GPIO_PULL_DOWN)>
        , <&gpio0  1 (GPIO_ACTIVE_HIGH | GPIO_PULL_DOWN)>
        , <&gpio0 17 (GPIO_ACTIVE_HIGH | GPIO_PULL_DOWN)>
        ;

    col-gpios
        = <&gpio1 11 GPIO_ACTIVE_HIGH>
        , <&gpio1 10 GPIO_ACTIVE_HIGH>
        , <&gpio0  3 GPIO_ACTIVE_HIGH>
        , <&gpio0 28 GPIO_ACTIVE_HIGH>
        , <&gpio1 20 GPIO_ACTIVE_HIGH>
        , <&gpio0  2 GPIO_ACTIVE_HIGH>
        ;
};

// &kscan0 {
//     diode-direction = "col2row";
//     row-gpios
//         = <&gpio0  4 (GPIO_ACTIVE_HIGH | GPIO_PULL_DOWN)>
//         , <&gpio0  8 (GPIO_ACTIVE_HIGH | GPIO_PULL_DOWN)>
//         , <&gpio0  6 (GPIO_ACTIVE_HIGH | GPIO_PULL_DOWN)>
//         , <&gpio0 26 (GPIO_ACTIVE_HIGH | GPIO_PULL_DOWN)>
//         ;

//     col-gpios
//         = <&gpio1 11 GPIO_ACTIVE_HIGH>
//         , <&gpio1 10 GPIO_ACTIVE_HIGH>
//         , <&gpio0  3 GPIO_ACTIVE_HIGH>
//         , <&gpio0 28 GPIO_ACTIVE_HIGH>
//         , <&gpio1 13 GPIO_ACTIVE_HIGH>
//         , <&gpio0  2 GPIO_ACTIVE_HIGH>
//         ;
// };
/ {
    lfclk: lfclk {
        compatible = "fixed-clock";
        clock-frequency = <32768>;
        #clock-cells = <0>;
        status = "okay";
    };
};
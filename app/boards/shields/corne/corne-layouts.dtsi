#include <layouts/foostan/corne/5column.dtsi>
#include <layouts/foostan/corne/6column.dtsi>

&foostan_corne_6col_layout {
    transform = <&default_transform>;
};

&foostan_corne_5col_layout {
    transform = <&five_column_transform>;
};

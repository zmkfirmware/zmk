/*
 * Copyright (c) 2020 The ZMK Contributors
 *
 * SPDX-License-Identifier: MIT
 */

#include "jorne.dtsi"

&kscan0 {
	col-gpios
		= <&pro_micro_a  3 GPIO_ACTIVE_HIGH>
		, <&pro_micro_a  2 GPIO_ACTIVE_HIGH>
		, <&pro_micro_a  1 GPIO_ACTIVE_HIGH>
		, <&pro_micro_a  0 GPIO_ACTIVE_HIGH>
		, <&pro_micro_d 15 GPIO_ACTIVE_HIGH>
		, <&pro_micro_d 14 GPIO_ACTIVE_HIGH>
		;
};

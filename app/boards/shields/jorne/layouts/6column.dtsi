#include <layouts/foostan/corne/6column.dtsi>
#include <physical_layouts.dtsi>

#include "position_map.dtsi"

&layouts_foostan_corne_position_map {
    status = "disabled";
};

&layouts_joric_jorne_position_map {
    joric_jorne_6col_posmap: six {
        physical-layout = <&foostan_corne_6col_layout>;
        positions
            = <42  0  1  2  3  4  5        6  7  8  9 10 11 43>
            , <   12 13 14 15 16 17       18 19 20 21 22 23   >
            , <   24 25 26 27 28 29       30 31 32 33 34 35   >
            , <               36 37 38 39 40 41               >;
    };
};

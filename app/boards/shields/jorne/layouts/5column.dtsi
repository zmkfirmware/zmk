#include <layouts/foostan/corne/5column.dtsi>
#include <physical_layouts.dtsi>

#include "position_map.dtsi"

&layouts_foostan_corne_position_map {
    status = "disabled";
};

&layouts_joric_jorne_position_map {
    joric_jorne_5col_posmap: five {
        physical-layout = <&foostan_corne_5col_layout>;
        positions
            = <36 37  0  1  2  3  4        5  6  7  8  9 38 39>
            , <   40 10 11 12 13 14       15 16 17 18 19 41   >
            , <   42 20 21 22 23 24       25 26 27 28 29 43   >
            , <               30 31 32 33 34 35               >;
    };
};

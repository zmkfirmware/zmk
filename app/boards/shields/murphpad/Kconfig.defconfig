## app/boards/shields/murphpad/Kconfig.defconfig
```kconfig
# Copyright (c) 2020 The ZMK Contributors
# SPDX-License-Identifier: MIT

if SHIELD_MURPHPAD

config ZMK_KEYBOARD_NAME
	default "MurphPad"

endif
```

## app/boards/shields/murphpad/Kconfig.shield
```kconfig
# Copyright (c) 2021 The ZMK Contributors
# SPDX-License-Identifier: MIT

config SHIELD_MURPHPAD
	def_bool $(shields_list_contains,murphpad)
```

## app/boards/shields/murphpad/boards/nice_nano.conf
```kconfig
# Uncomment both to enable underglow
CONFIG_ZMK_RGB_UNDERGLOW=y
CONFIG_WS2812_STRIP=y
```

## app/boards/shields/naked60/Kconfig.defconfig
```kconfig
# Copyright (c) 2020 The ZMK Contributors
# SPDX-License-Identifier: MIT

if SHIELD_NAKED60

config ZMK_KEYBOARD_NAME
	default "naked60bmp"

endif
```

## app/boards/shields/naked60/Kconfig.shield
```kconfig
# Copyright (c) 2020 The ZMK Contributors
# SPDX-License-Identifier: MIT

config SHIELD_NAKED60
    def_bool $(shields_list_contains,naked60)
```

## app/boards/shields/newhorizons/Kconfig.defconfig
```kconfig
# Copyright (c) 2020 The ZMK Contributors
# SPDX-License-Identifier: MIT

if SHIELD_NEWHORIZONS

config ZMK_KEYBOARD_NAME
    default "New Horizons"

endif
```

## app/boards/shields/newhorizons/Kconfig.shield
```kconfig
# Copyright (c) 2023 The ZMK Contributors
# SPDX-License-Identifier: MIT

config SHIELD_NEWHORIZONS
    def_bool $(shields_list_contains,newhorizons)
```

## app/boards/shields/nibble/Kconfig.defconfig
```kconfig
# Copyright (c) 2020 The ZMK Contributors
# SPDX-License-Identifier: MIT

if SHIELD_NIBBLE

config ZMK_KEYBOARD_NAME
    default "NIBBLE"

if ZMK_DISPLAY

config I2C
    default y

config SSD1306
    default y

config SSD1306_REVERSE_MODE
    default y

endif # ZMK_DISPLAY

if LVGL

config LV_Z_VDB_SIZE
    default 64

config LV_Z_DPI
    default 148

config LV_Z_BITS_PER_PIXEL
    default 1

choice LV_COLOR_DEPTH
    default LV_COLOR_DEPTH_1
endchoice

endif # LVGL

endif
```

## app/boards/shields/nibble/Kconfig.shield
```kconfig
# Copyright (c) 2020 The ZMK Contributors
# SPDX-License-Identifier: MIT

config SHIELD_NIBBLE
	def_bool $(shields_list_contains,nibble)
```

## app/boards/shields/nice_view/Kconfig.defconfig
```kconfig
# Copyright (c) 2023 The ZMK Contributors
# SPDX-License-Identifier: MIT

if SHIELD_NICE_VIEW

config LV_Z_VDB_SIZE
    default 100

config LV_Z_DPI
    default 161

config LV_Z_BITS_PER_PIXEL
    default 1

choice LV_COLOR_DEPTH
    default LV_COLOR_DEPTH_1
endchoice

choice ZMK_DISPLAY_WORK_QUEUE
    default ZMK_DISPLAY_WORK_QUEUE_DEDICATED
endchoice

choice ZMK_DISPLAY_STATUS_SCREEN
    default ZMK_DISPLAY_STATUS_SCREEN_CUSTOM
endchoice

config ZMK_DISPLAY_STATUS_SCREEN_CUSTOM
    imply NICE_VIEW_WIDGET_STATUS

config NICE_VIEW_WIDGET_STATUS
    bool "Custom nice!view status widget"
    select LV_FONT_MONTSERRAT_16
    select LV_USE_IMG
    select LV_USE_CANVAS

config NICE_VIEW_WIDGET_INVERTED
    bool "Invert custom status widget colors"

if !ZMK_SPLIT || ZMK_SPLIT_ROLE_CENTRAL

config NICE_VIEW_WIDGET_STATUS
    select LV_FONT_MONTSERRAT_18
    select LV_FONT_MONTSERRAT_14
    select LV_FONT_UNSCII_8
    select ZMK_WPM

endif # !ZMK_SPLIT || ZMK_SPLIT_ROLE_CENTRAL

config ZMK_DISPLAY_STATUS_SCREEN_BUILT_IN
    select LV_FONT_MONTSERRAT_26

endif # SHIELD_NICE_VIEW
```

## app/boards/shields/nice_view/Kconfig.shield
```kconfig
# Copyright (c) 2022 The ZMK Contributors
# SPDX-License-Identifier: MIT

config SHIELD_NICE_VIEW
    def_bool $(shields_list_contains,nice_view)
```

## app/boards/shields/nice_view_adapter/Kconfig.shield
```kconfig
# Copyright (c) 2022 The ZMK Contributors
# SPDX-License-Identifier: MIT

config SHIELD_NICE_VIEW_ADAPTER
	def_bool $(shields_list_contains,nice_view_adapter)
```

## app/boards/shields/nice_view_oled/Kconfig.shield
```kconfig
# Copyright (c) 2022 The ZMK Contributors
# SPDX-License-Identifier: MIT

config SHIELD_NICE_VIEW_OLED
	def_bool $(shields_list_contains,nice_view_oled)
```

## app/boards/shields/obe/Kconfig.defconfig
```kconfig
# Copyright (c) 2022 The ZMK Contributors
# SPDX-License-Identifier: MIT

if SHIELD_OBE

config ZMK_KEYBOARD_NAME
    default "OrangeBoyErgo"

if LVGL

config LVGL_VDB_SIZE
    default 64

config LVGL_DPI
    default 148

config LVGL_BITS_PER_PIXEL
    default 1

choice LVGL_COLOR_DEPTH
    default LVGL_COLOR_DEPTH_1
endchoice

endif # LVGL

endif
```

## app/boards/shields/obe/Kconfig.shield
```kconfig
# Copyright (c) 2023 The ZMK Contributors
# SPDX-License-Identifier: MIT

config SHIELD_OBE
    def_bool $(shields_list_contains,obe)
```

## app/boards/shields/obe/boards/blackpill_f401ce.conf
```kconfig
# Necessary to stop double matrix reads on first row
CONFIG_ZMK_KSCAN_MATRIX_WAIT_BEFORE_INPUTS=150
CONFIG_ZMK_KSCAN_MATRIX_WAIT_BETWEEN_OUTPUTS=150
```

## app/boards/shields/orthrus/Kconfig.defconfig
```kconfig
if SHIELD_ORTHRUS_LEFT

config ZMK_KEYBOARD_NAME
  default "Orthrus"

config ZMK_SPLIT_BLE_ROLE_CENTRAL
  default y

endif

if SHIELD_ORTHRUS_LEFT || SHIELD_ORTHRUS_RIGHT

config ZMK_SPLIT
  default y
 
endif
```

## app/boards/shields/orthrus/Kconfig.shield
```kconfig
# Copyright (c) 2020 Pete Johanson
# SPDX-License-Identifier: MIT

config SHIELD_ORTHRUS_LEFT
	def_bool $(shields_list_contains,orthrus_left)

config SHIELD_ORTHRUS_RIGHT
	def_bool $(shields_list_contains,orthrus_right)
```

## app/boards/shields/osprette/Kconfig.defconfig
```kconfig
# Copyright (c) 2021 The ZMK Contributors
# SPDX-License-Identifier: MIT

if SHIELD_OSPRETTE

config ZMK_KEYBOARD_NAME
    default "Osprette"

endif
```

## app/boards/shields/osprette/Kconfig.shield
```kconfig
# Copyright (c) 2021 The ZMK Contributors
# SPDX-License-Identifier: MIT

config SHIELD_OSPRETTE
    def_bool $(shields_list_contains,osprette)
```

## app/boards/shields/pancake/Kconfig.defconfig
```kconfig
# Copyright (c) 2022 The ZMK Contributors
# SPDX-License-Identifier: MIT

if SHIELD_PANCAKE

config ZMK_KEYBOARD_NAME
    default "Pancake"

endif
```

## app/boards/shields/pancake/Kconfig.shield
```kconfig
# Copyright (c) 2022 The ZMK Contributors
# SPDX-License-Identifier: MIT

config SHIELD_PANCAKE
	def_bool $(shields_list_contains,pancake)
```

## app/boards/shields/petejohanson_handwire/Kconfig.shield
```kconfig
# Copyright (c) 2019 Linaro Limited
# SPDX-License-Identifier: MIT

config SHIELD_PETEJOHANSON_HANDWIRE
	def_bool $(shields_list_contains,petejohanson_handwire)
```

## app/boards/shields/petejohanson_pro_micro_handwire/Kconfig.defconfig
```kconfig
if SHIELD_PETEJOHANSON_PRO_MICRO_HANDWIRE

config ZMK_KEYBOARD_NAME
	default "Pete's ProMicro Compat Handwire"

config ZMK_USB
	default y

config ZMK_ACTION_MOD_TAP
	default y

endif
```

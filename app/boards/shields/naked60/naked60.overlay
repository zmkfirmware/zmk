/*
 * Copyright (c) 2020 The ZMK Contributors
 *
 * SPDX-License-Identifier: MIT
 */

/ {
    chosen {
        zmk,kscan = &kscan0;
    };

    kscan0: kscan_0 {
        compatible = "zmk,kscan-gpio-matrix";
        label = "KSCAN";
        diode-direction = "col2row";

        col-gpios
            = <&pro_micro_a 3 GPIO_ACTIVE_HIGH> // col 0
            , <&pro_micro_a 2 GPIO_ACTIVE_HIGH> // col 1
            , <&pro_micro_a 1 GPIO_ACTIVE_HIGH> // col 2
            , <&pro_micro_a 0 GPIO_ACTIVE_HIGH> // col 3
            , <&pro_micro_d 15 GPIO_ACTIVE_HIGH> // col 4
            , <&pro_micro_d 14 GPIO_ACTIVE_HIGH> // col 5
            , <&pro_micro_d 16 GPIO_ACTIVE_HIGH> // col 6
            , <&pro_micro_d 6 GPIO_ACTIVE_HIGH> // col 7
            , <&pro_micro_d 7 GPIO_ACTIVE_HIGH> // col 8
            , <&pro_micro_d 8 GPIO_ACTIVE_HIGH> // col 9
            , <&pro_micro_d 9 GPIO_ACTIVE_HIGH> // col 10
            , <&pro_micro_d 1 GPIO_ACTIVE_HIGH> // col 11
            ;

        row-gpios
            = <&pro_micro_d 10 (GPIO_ACTIVE_HIGH | GPIO_PULL_DOWN)> // row 0
            , <&pro_micro_d 2 (GPIO_ACTIVE_HIGH | GPIO_PULL_DOWN)> // row 1
            , <&pro_micro_d 3 (GPIO_ACTIVE_HIGH | GPIO_PULL_DOWN)> // row 2
            , <&pro_micro_d 4 (GPIO_ACTIVE_HIGH | GPIO_PULL_DOWN)> // row 3
            , <&pro_micro_d 5 (GPIO_ACTIVE_HIGH | GPIO_PULL_DOWN)> // row 4
            ;
    };
};
/*
 * Copyright (c) 2020 The ZMK Contributors
 *
 * SPDX-License-Identifier: MIT
 */

#include "lets_split.dtsi"

&default_transform {
    col-offset = <6>;
};

&kscan0 {

    row-gpios
    = <&pro_micro_d 15 (GPIO_ACTIVE_HIGH | GPIO_PULL_DOWN)>
    , <&pro_micro_d 14 (GPIO_ACTIVE_HIGH | GPIO_PULL_DOWN)>
    , <&pro_micro_d 16 (GPIO_ACTIVE_HIGH | GPIO_PULL_DOWN)>
    , <&pro_micro_d 10 (GPIO_ACTIVE_HIGH | GPIO_PULL_DOWN)>
    ;

    col-gpios
    = <&pro_micro_d 4 GPIO_ACTIVE_HIGH>
    , <&pro_micro_d 5 GPIO_ACTIVE_HIGH>
    , <&pro_micro_d 6 GPIO_ACTIVE_HIGH>
    , <&pro_micro_d 7 GPIO_ACTIVE_HIGH>
    , <&pro_micro_d 8 GPIO_ACTIVE_HIGH>
    , <&pro_micro_d 9 GPIO_ACTIVE_HIGH>
    ;
};

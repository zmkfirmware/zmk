/*
 * Copyright (c) 2020 Pete Johanson
 *
 * SPDX-License-Identifier: MIT
 */

#include "cornixqf.dtsi"

&kscan0 {
    diode-direction = "col2row";
    row-gpios
        = <&gpio0  20 (GPIO_ACTIVE_HIGH | GPIO_PULL_DOWN)>
        , <&gpio0  17 (GPIO_ACTIVE_HIGH | GPIO_PULL_DOWN)>
        , <&gpio0  0 (GPIO_ACTIVE_HIGH | GPIO_PULL_DOWN)>
        , <&gpio0 4 (GPIO_ACTIVE_HIGH | GPIO_PULL_DOWN)>
        ;

    col-gpios
        = <&gpio0 15 GPIO_ACTIVE_HIGH>
        , <&gpio0 31 GPIO_ACTIVE_HIGH>
        , <&gpio0 30 GPIO_ACTIVE_HIGH>
        , <&gpio0 29 GPIO_ACTIVE_HIGH>
        , <&gpio1 3 GPIO_ACTIVE_HIGH>
        , <&gpio0 2 GPIO_ACTIVE_HIGH>
        ;
};


/ {
    lfclk: lfclk {
        compatible = "fixed-clock";
        clock-frequency = <32768>;
        #clock-cells = <0>;
        status = "okay";
    };
};
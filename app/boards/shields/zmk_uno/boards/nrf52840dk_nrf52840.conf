## app/boards/shields/zodiark/Kconfig.shield
```kconfig
# Copyright (c) 2021 The ZMK Contributors
# SPDX-License-Identifier: MIT

config SHIELD_ZODIARK_LEFT
	def_bool $(shields_list_contains,zodiark_left)

config SHIELD_ZODIARK_RIGHT
	def_bool $(shields_list_contains,zodiark_right)
```

## app/boards/sparkfun/pro_micro_rp2040/Kconfig.sparkfun_pro_micro_rp2040
```kconfig
# Copyright (c) 2026 The ZMK Contributors
# SPDX-License-Identifier: MIT

config BOARD_SPARKFUN_PRO_MICRO_RP2040
    select ZMK_BOARD_COMPAT if BOARD_SPARKFUN_PRO_MICRO_RP2040_RP2040_ZMK
    imply RETAINED_MEM if BOARD_SPARKFUN_PRO_MICRO_RP2040_RP2040_ZMK
    imply RETENTION if BOARD_SPARKFUN_PRO_MICRO_RP2040_RP2040_ZMK
    imply RETENTION_BOOT_MODE if BOARD_SPARKFUN_PRO_MICRO_RP2040_RP2040_ZMK
```

## app/boards/sparkfun/pro_micro_rp2040/board.yml
```yaml
board:
  extend: sparkfun_pro_micro_rp2040
  variants:
    - name: zmk
      qualifier: rp2040
```

## app/boards/waveshare/rp2040_zero/board.yml
```yaml
board:
  extend: rp2040_zero
  variants:
    - name: zmk
      qualifier: rp2040
```

## app/boards/waveshare/rp2040_zero/rp2040_zero_rp2040_zmk_defconfig
```kconfig
CONFIG_SYS_CLOCK_HW_CYCLES_PER_SEC=125000000

# Core deps
CONFIG_RESET=y
CONFIG_CLOCK_CONTROL=y
CONFIG_GPIO=y

# Build Output
CONFIG_USE_DT_CODE_PARTITION=y
CONFIG_BUILD_OUTPUT_UF2=y
CONFIG_BUILD_OUTPUT_HEX=y

# USB HID
CONFIG_ZMK_USB=y

# Settings Support
CONFIG_MPU_ALLOW_FLASH_WRITE=y
CONFIG_NVS=y
CONFIG_SETTINGS_NVS=y
CONFIG_FLASH=y
CONFIG_FLASH_PAGE_LAYOUT=y
CONFIG_FLASH_MAP=y

# Bootloader Support
CONFIG_RETAINED_MEM=y
CONFIG_RETENTION=y
CONFIG_RETENTION_BOOT_MODE=y
```

## app/boards/weact/blackpill_f401cc/Kconfig.blackpill_f401cc
```kconfig
# Copyright (c) 2026 The ZMK Contributors
# SPDX-License-Identifier: MIT

config BOARD_BLACKPILL_F401CC
    select ZMK_BOARD_COMPAT
```

## app/boards/weact/blackpill_f401cc/board.yml
```yaml
board:
  extend: blackpill_f401cc
  variants:
    - name: zmk
      qualifier: stm32f401xc
```

## app/boards/weact/blackpill_f401ce/Kconfig.blackpill_f401ce
```kconfig
# Copyright (c) 2026 The ZMK Contributors
# SPDX-License-Identifier: MIT

config BOARD_BLACKPILL_F401CE
    select ZMK_BOARD_COMPAT
```

## app/boards/weact/blackpill_f401ce/board.yml
```yaml
board:
  extend: blackpill_f401ce
  variants:
    - name: zmk
      qualifier: stm32f401xe
```

## app/boards/weact/blackpill_f411ce/Kconfig.blackpill_f411ce
```kconfig
# Copyright (c) 2026 The ZMK Contributors
# SPDX-License-Identifier: MIT

config BOARD_BLACKPILL_F411CE
    select ZMK_BOARD_COMPAT
```

## app/boards/weact/blackpill_f411ce/blackpill_f411ce_zmk_defconfig
```kconfig
# SPDX-License-Identifier: MIT

# Enable MPU
CONFIG_ARM_MPU=y

# Enable HW stack protection
CONFIG_HW_STACK_PROTECTION=y


# Enable GPIO
CONFIG_GPIO=y

# USB HID
CONFIG_ZMK_USB=y

# Defaults for matrix scanning to avoid interrupt issues
CONFIG_ZMK_KSCAN_MATRIX_POLLING=y
```

## app/boards/weact/blackpill_f411ce/board.yml
```yaml
board:
  extend: blackpill_f411ce
  variants:
    - name: zmk
      qualifier: stm32f411xe
```

## app/boards/zhiayang/mikoto/Kconfig.mikoto
```kconfig
# Copyright (c) 2020 The ZMK Contributors
# SPDX-License-Identifier: Apache-2.0

config BOARD_MIKOTO
    select SOC_NRF52840_QIAA
    imply RETAINED_MEM
    imply RETENTION
    imply RETENTION_BOOT_MODE
    imply I2C if BOARD_REVISION="7.2.0"
```

## app/drivers/Kconfig
```kconfig
# Copyright (c) 2020 The ZMK Contributors
# SPDX-License-Identifier: MIT

rsource "gpio/Kconfig"
rsource "kscan/Kconfig"
rsource "led_strip/Kconfig"
rsource "sensor/Kconfig"
rsource "display/Kconfig"
```

## app/drivers/animation/Kconfig
```kconfig
# Copyright (c) 2020 The ZMK Contributors
# SPDX-License-Identifier: MIT

config ZMK_ANIMATION
	bool "RGB Animations"
	depends on I2C
	depends on LED_STRIP
	help
		Enable RGB animations.
```

## app/drivers/display/Kconfig
```kconfig
# Copyright (c) 2021 The ZMK Contributors
# SPDX-License-Identifier: MIT

rsource "Kconfig.il0323"
```

## app/drivers/display/Kconfig.il0323
```kconfig
# Copyright (c) 2020 Phytec Messtechnik GmbH, Peter Johanson
# SPDX-License-Identifier: Apache-2.0

# IL0323 display controller configuration options

config IL0323
    bool "IL0323 compatible display controller driver"
    depends on SPI
    depends on HEAP_MEM_POOL_SIZE != 0
    help
      Enable driver for IL0323 compatible controller.
```

## app/drivers/gpio/Kconfig
```kconfig
menuconfig ZMK_DRIVERS_GPIO
    bool "GPIO"

rsource "Kconfig.max7318"
rsource "Kconfig.595"
```

## app/drivers/gpio/Kconfig.165
```kconfig
# 165 GPIO configuration options

# Copyright (c) 2022 The ZMK Contributors
# SPDX-License-Identifier: MIT

DT_COMPAT_ZMK_GPIO_165 := zmk,gpio-165

menuconfig GPIO_165
    bool "165 Parallel Input Shift Register SPI driver"
    default $(dt_compat_enabled,$(DT_COMPAT_ZMK_GPIO_165))
    depends on SPI
    select HAS_DTS_GPIO
    select ZMK_DRIVERS_GPIO
    help
      Enable driver for 165 shift register chip using SPI.

if GPIO_165

config GPIO_165_INIT_PRIORITY
    int "Init priority"
    default 75
    help
      Device driver initialization priority.

endif #GPIO_165
```

## app/drivers/gpio/Kconfig.max7318
```kconfig
# MAX7318 GPIO configuration options

# Copyright (c) 2022 The ZMK Contributors
# SPDX-License-Identifier: MIT

menuconfig GPIO_MAX7318
	bool "MAX7318 I2C-based GPIO chip"
	depends on I2C
	select HAS_DTS_GPIO
	help
	  Enable driver for MAX7318 I2C-based GPIO chip.

if GPIO_MAX7318

config GPIO_MAX7318_INIT_PRIORITY
	int "Init priority"
	default 75
	help
	  Device driver initialization priority.

endif #GPIO_MAX7318
```

## app/drivers/gpio/mcp23017/Kconfig
```kconfig
# MCP23017 GPIO configuration options

# Copyright (c) 2021 Pete Johanson
# SPDX-License-Identifier: Apache-2.0

menuconfig GPIO_MCP23017
	bool "MCP23017 I2C-based GPIO chip"
	depends on I2C
	select HAS_DTS_GPIO
	help
	  Enable driver for MCP23017 I2C-based GPIO chip.

if GPIO_MCP23017

config GPIO_MCP23017_INIT_PRIORITY
	int "Init priority"
	default 75
	help
	  Device driver initialization priority.

endif #GPIO_MCP23017
```

## app/drivers/kscan/Kconfig
```kconfig
# Copyright (c) 2020 The ZMK Contributors
# SPDX-License-Identifier: MIT

DT_COMPAT_ZMK_KSCAN_COMPOSITE := zmk,kscan-composite
DT_COMPAT_ZMK_KSCAN_GPIO_DEMUX := zmk,kscan-gpio-demux
DT_COMPAT_ZMK_KSCAN_GPIO_DIRECT := zmk,kscan-gpio-direct
DT_COMPAT_ZMK_KSCAN_GPIO_MATRIX := zmk,kscan-gpio-matrix
DT_COMPAT_ZMK_KSCAN_MOCK := zmk,kscan-mock

config ZMK_KSCAN_COMPOSITE_DRIVER
	bool
	default $(dt_compat_enabled,$(DT_COMPAT_ZMK_KSCAN_COMPOSITE))

config ZMK_KSCAN_GPIO_DRIVER
	bool
	select GPIO

config ZMK_KSCAN_GPIO_DEMUX
	bool
	default $(dt_compat_enabled,$(DT_COMPAT_ZMK_KSCAN_GPIO_DEMUX))
	select ZMK_KSCAN_GPIO_DRIVER

config ZMK_KSCAN_GPIO_DIRECT
	bool
	default $(dt_compat_enabled,$(DT_COMPAT_ZMK_KSCAN_GPIO_DIRECT))
	select ZMK_KSCAN_GPIO_DRIVER

config ZMK_KSCAN_GPIO_MATRIX
	bool
	default $(dt_compat_enabled,$(DT_COMPAT_ZMK_KSCAN_GPIO_MATRIX))
	select ZMK_KSCAN_GPIO_DRIVER

config ZMK_KSCAN_MOCK_DRIVER
	bool
	default $(dt_compat_enabled,$(DT_COMPAT_ZMK_KSCAN_MOCK))

if ZMK_KSCAN_GPIO_DRIVER

config ZMK_KSCAN_MATRIX_POLLING
	bool "Poll for key event triggers instead of using interrupts on matrix boards."

config ZMK_KSCAN_DIRECT_POLLING
	bool "Poll for key event triggers instead of using interrupts on direct wired boards."

config ZMK_KSCAN_DEBOUNCE_PRESS_MS
	int "Debounce time for key press in milliseconds."
	default -1
	help
		Global debounce time for key press in milliseconds.
		If this is -1, the debounce time is controlled by the debounce-press-ms
		Devicetree property, which defaults to 5 ms. Otherwise this overrides the
		debounce time for all key scan drivers to the chosen value.

config ZMK_KSCAN_DEBOUNCE_RELEASE_MS
	int "Debounce time for key release in milliseconds."
	default -1
	help
		Global debounce time for key release in milliseconds.
		If this is -1, the debounce time is controlled by the debounce-release-ms
		Devicetree property, which defaults to 5 ms. Otherwise this overrides the
		debounce time for all key scan drivers to the chosen value.

endif

config ZMK_KSCAN_INIT_PRIORITY
	int "Keyboard scan driver init priority"
	default 40
	help
	  Keyboard scan device driver initialization priority.
```

## app/drivers/led/Kconfig
```kconfig
# Copyright (c) 2020 The ZMK Contributors
# SPDX-License-Identifier: MIT

rsource "is31fl3733/Kconfig"


config LED_INIT_PRIORITY
	int "LED initialization priority"
	default 90
	help
	  System initialization priority for LED drivers.
	  
```

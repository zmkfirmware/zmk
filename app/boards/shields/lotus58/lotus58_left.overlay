/*
 * Copyright (c) 2022 The ZMK Contributors
 *
 * SPDX-License-Identifier: MIT
 */

#include "lotus58.dtsi"

&kscan0 {
	col-gpios
		= <&pro_micro 15 GPIO_ACTIVE_HIGH> 
		, <&pro_micro 16 GPIO_ACTIVE_HIGH>
		, <&pro_micro 14 GPIO_ACTIVE_HIGH>
		, <&pro_micro 10 GPIO_ACTIVE_HIGH>
		, <&pro_micro 18 GPIO_ACTIVE_HIGH>
		, <&pro_micro 19 GPIO_ACTIVE_HIGH>
		;
};

&left_encoder {
	status = "okay";
};

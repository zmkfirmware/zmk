## app/boards/shields/reviung39/Kconfig.shield
```kconfig
# Copyright (c) 2020 The ZMK Contributors
# SPDX-License-Identifier: MIT

config SHIELD_REVIUNG39
    def_bool $(shields_list_contains,reviung39)
```

## app/boards/shields/reviung41/Kconfig.defconfig
```kconfig
# Copyright (c) 2020 The ZMK Contributors
# SPDX-License-Identifier: MIT

if SHIELD_REVIUNG41

config ZMK_KEYBOARD_NAME
    default "Reviung41"

endif
```

## app/boards/shields/reviung41/Kconfig.shield
```kconfig
# Copyright (c) 2020 The ZMK Contributors
# SPDX-License-Identifier: MIT

config SHIELD_REVIUNG41
    def_bool $(shields_list_contains,reviung41)
```

## app/boards/shields/reviung5/Kconfig.defconfig
```kconfig
# Copyright (c) 2022 The ZMK Contributors
# SPDX-License-Identifier: MIT

if SHIELD_REVIUNG5

config ZMK_KEYBOARD_NAME
    default "Reviung5"

endif
```

## app/boards/shields/reviung5/Kconfig.shield
```kconfig
# Copyright (c) 2022 The ZMK Contributors
# SPDX-License-Identifier: MIT
config SHIELD_REVIUNG5
    def_bool $(shields_list_contains,reviung5)
```

## app/boards/shields/reviung53/Kconfig.defconfig
```kconfig
# Copyright (c) 2023 The ZMK Contributors
# SPDX-License-Identifier: MIT

if SHIELD_REVIUNG53

config ZMK_KEYBOARD_NAME
    default "Reviung53"

endif
```

## app/boards/shields/reviung53/Kconfig.shield
```kconfig
# Copyright (c) 2023 The ZMK Contributors
# SPDX-License-Identifier: MIT

config SHIELD_REVIUNG53
    def_bool $(shields_list_contains,reviung53)
```

## app/boards/shields/revlp/Kconfig.defconfig
```kconfig
# Copyright (c) 2020 The ZMK Contributors
# SPDX-License-Identifier: MIT

if SHIELD_REVLP

config ZMK_KEYBOARD_NAME
    default "revlp"

if ZMK_BACKLIGHT

config LED_GPIO
    default y

endif # ZMK_BACKLIGHT

endif
```

## app/boards/shields/revlp/Kconfig.shield
```kconfig
# Copyright (c) 2020 The ZMK Contributors
# SPDX-License-Identifier: MIT

config SHIELD_REVLP
    def_bool $(shields_list_contains,revlp)
```

## app/boards/shields/roadster/Kconfig.defconfig
```kconfig
# Copyright (c) 2020 The ZMK Contributors
# SPDX-License-Identifier: MIT

if SHIELD_ROADSTER

config ZMK_KEYBOARD_NAME
    default "Roadster"

endif
```

## app/boards/shields/roadster/Kconfig.shield
```kconfig
# Copyright (c) 2020 The ZMK Contributors
# SPDX-License-Identifier: MIT

config SHIELD_ROADSTER
    def_bool $(shields_list_contains,ROADSTER)
```

## app/boards/shields/romac/Kconfig.defconfig
```kconfig
# Copyright (c) 2020 Pete Johanson, Richard Jones
# SPDX-License-Identifier: MIT

if SHIELD_ROMAC

config ZMK_KEYBOARD_NAME
	default "RoMac"

endif
```

## app/boards/shields/romac/Kconfig.shield
```kconfig
# Copyright (c) 2020 Pete Johanson, Richard Jones
# SPDX-License-Identifier: MIT

config SHIELD_ROMAC
	def_bool $(shields_list_contains,romac)
```

## app/boards/shields/romac_plus/Kconfig.defconfig
```kconfig
# Copyright (c) 2020 The ZMK Contributors
# SPDX-License-Identifier: MIT

if SHIELD_ROMAC_PLUS

config ZMK_KEYBOARD_NAME
	default "RoMac+ v4"

endif
```

## app/boards/shields/romac_plus/Kconfig.shield
```kconfig
# Copyright (c) 2020 The ZMK Contributors
# SPDX-License-Identifier: MIT

config SHIELD_ROMAC_PLUS
	def_bool $(shields_list_contains,romac_plus)
```

## app/boards/shields/settings_reset/Kconfig.defconfig
```kconfig
# Copyright (c) 2020 The ZMK Contributors
# SPDX-License-Identifier: MIT

if SHIELD_SETTINGS_RESET

config ZMK_KEYBOARD_NAME
    default "SETTINGS RESET"

config ZMK_BOOTLOADER_BLE_CLEAR_BONDS
    default y

endif
```

## app/boards/shields/settings_reset/Kconfig.shield
```kconfig
# Copyright (c) 2020 The ZMK Contributors
# SPDX-License-Identifier: MIT

config SHIELD_SETTINGS_RESET
	def_bool $(shields_list_contains,settings_reset)
```

## app/boards/shields/severedduck36/Kconfig.shield
```kconfig
# Copyright (c) 2020 Pete Johanson
# SPDX-License-Identifier: MIT

config SHIELD_SEVEREDDUCK36_LEFT
	def_bool $(shields_list_contains,severedduck36_left)

config SHIELD_SEVEREDDUCK36_RIGHT
	def_bool $(shields_list_contains,severedduck36_right)
```

## app/boards/shields/shapeshifter4060/Kconfig.defconfig
```kconfig
# Copyright (c) 2020 The ZMK Contributors
# SPDX-License-Identifier: MIT

if SHIELD_SHAPESHIFTER4060

config ZMK_KEYBOARD_NAME
    default "Shapeshifter4060"

endif
```

## app/boards/shields/shapeshifter4060/Kconfig.shield
```kconfig
# Copyright (c) 2020 The ZMK Contributors
# SPDX-License-Identifier: MIT

config SHIELD_SHAPESHIFTER4060
    def_bool $(shields_list_contains,shapshifter4060)
```

## app/boards/shields/skew68/Kconfig.defconfig
```kconfig
# Copyright (c) 2020 The ZMK Contributors
# SPDX-License-Identifier: MIT

if SHIELD_SKEW68

config ZMK_KEYBOARD_NAME #键盘的名字
	default "TG73"

endif
```

## app/boards/shields/skew68/Kconfig.shield
```kconfig
# Copyright (c) 2020 The ZMK Contributors
# SPDX-License-Identifier: MIT

config SHIELD_SKEW68
	def_bool $(shields_list_contains,TG73)
```

## app/boards/shields/snap/Kconfig.shield
```kconfig
# Copyright (c) 2022 The ZMK Contributors
# SPDX-License-Identifier: MIT

config SHIELD_SNAP_LEFT
	def_bool $(shields_list_contains,snap_left)

config SHIELD_SNAP_RIGHT
	def_bool $(shields_list_contains,snap_right)
```

## app/boards/shields/sofle/Kconfig.defconfig
```kconfig
# Copyright (c) 2020 Ryan Cross
# SPDX-License-Identifier: MIT

if SHIELD_SOFLE_LEFT

config ZMK_KEYBOARD_NAME
    default "Sofle"

config ZMK_SPLIT_ROLE_CENTRAL
    default y

endif

if SHIELD_SOFLE_LEFT || SHIELD_SOFLE_RIGHT

config ZMK_SPLIT
    default y

if ZMK_DISPLAY

config I2C
    default y

config SSD1306
    default y

endif # ZMK_DISPLAY

if LVGL

config LV_Z_VDB_SIZE
    default 64

config LV_DPI_DEF
    default 148

config LV_Z_BITS_PER_PIXEL
    default 1

choice LV_COLOR_DEPTH
    default LV_COLOR_DEPTH_1
endchoice

endif # LVGL

if ZMK_RGB_UNDERGLOW

config WS2812_STRIP
    default y
endif

endif
```

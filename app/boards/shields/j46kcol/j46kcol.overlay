/*
 * Copyright (c) 2020 Pete Johanson, Richard Jones
 *
 * SPDX-License-Identifier: MIT
 */

#include <dt-bindings/zmk/matrix_transform.h>

/ {
	chosen {
		zmk,kscan = &kscan0;
	};

	kscan0: kscan {
		compatible = "zmk,kscan-gpio-matrix";
		label = "KSCAN";

		diode-direction = "col2row";
		row-gpios
			= <&gpio0 2 (GPIO_ACTIVE_HIGH | GPIO_PULL_DOWN)>
			, <&gpio0 3 (GPIO_ACTIVE_HIGH | GPIO_PULL_DOWN)>
			, <&gpio0 4 (GPIO_ACTIVE_HIGH | GPIO_PULL_DOWN)>
			, <&gpio0 28 (GPIO_ACTIVE_HIGH | GPIO_PULL_DOWN)>
			, <&gpio0 29 (GPIO_ACTIVE_HIGH | GPIO_PULL_DOWN)>
			, <&gpio0 12 (GPIO_ACTIVE_HIGH | GPIO_PULL_DOWN)>
			, <&gpio0 26 (GPIO_ACTIVE_HIGH | GPIO_PULL_DOWN)>
			, <&gpio0 27 (GPIO_ACTIVE_HIGH | GPIO_PULL_DOWN)>
			, <&gpio0 30 (GPIO_ACTIVE_HIGH | GPIO_PULL_DOWN)>
			, <&gpio0 31 (GPIO_ACTIVE_HIGH | GPIO_PULL_DOWN)>
			, <&gpio0 11 (GPIO_ACTIVE_HIGH | GPIO_PULL_DOWN)>
			, <&gpio0 7 (GPIO_ACTIVE_HIGH | GPIO_PULL_DOWN)>
			;

		col-gpios
			= <&gpio0 14 GPIO_ACTIVE_HIGH>
			, <&gpio0 8 GPIO_ACTIVE_HIGH>
			, <&gpio0 6 GPIO_ACTIVE_HIGH>
			, <&gpio0 25 GPIO_ACTIVE_HIGH>
			;

	};
};


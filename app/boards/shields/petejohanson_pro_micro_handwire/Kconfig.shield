## app/boards/shields/petejohanson_pro_micro_handwire/Kconfig.shield
```kconfig
# Copyright (c) 2020 Pete Johanson
# SPDX-License-Identifier: MIT

config SHIELD_PETEJOHANSON_PRO_MICRO_HANDWIRE
	def_bool $(shields_list_contains,petejohanson_pro_micro_handwire)
```

## app/boards/shields/petejohanson_proton_handwire/Kconfig.defconfig
```kconfig
if SHIELD_PETEJOHANSON_PROTON_HANDWIRE

config ZMK_KEYBOARD_NAME
	default "Pete's Proton Handwire"

config ZMK_USB
	default y

config ZMK_ACTION_MOD_TAP
	default y

endif
```

## app/boards/shields/petejohanson_proton_handwire/Kconfig.shield
```kconfig
# Copyright (c) 2020 Pete Johanson
# SPDX-License-Identifier: MIT

config SHIELD_PETEJOHANSON_PROTON_HANDWIRE
	def_bool $(shields_list_contains,petejohanson_proton_handwire)
```

## app/boards/shields/pico87/Kconfig.defconfig
```kconfig
# Copyright (c) 2023 The ZMK Contributors
# SPDX-License-Identifier: MIT

if SHIELD_PICO87

config ZMK_KEYBOARD_NAME
    default "Pico 87"

endif
```

## app/boards/shields/pico87/Kconfig.shield
```kconfig
# Copyright (c) 2023 The ZMK Contributors
# SPDX-License-Identifier: MIT

config SHIELD_PICO87
    def_bool $(shields_list_contains,pico87)
```

## app/boards/shields/pinky4/Kconfig.shield
```kconfig
# Copyright (c) 2022 Shawn Rutledge
# SPDX-License-Identifier: MIT

config SHIELD_PINKY4_LEFT
	def_bool $(shields_list_contains,pinky4_left)

config SHIELD_PINKY4_RIGHT
	def_bool $(shields_list_contains,pinky4_right)
```

## app/boards/shields/pockettype/Kconfig.defconfig
```kconfig
# Copyright (c) 2020 The ZMK Contributors
# SPDX-License-Identifier: MIT

if SHIELD_POCKETTYPE

config ZMK_KEYBOARD_NAME
    default "Pockettype"

endif
```

## app/boards/shields/posix_pro_micro/Kconfig.defconfig
```kconfig
# Copyright (c) 2024 The ZMK Contributors
# SPDX-License-Identifier: MIT

if SHIELD_POSIX_PRO_MICRO

config ZMK_STUDIO
    select UART_NATIVE_POSIX_PORT_1_ENABLE

endif
```

## app/boards/shields/posix_pro_micro/Kconfig.shield
```kconfig
# Copyright (c) 2024 The ZMK Contributors
# SPDX-License-Identifier: MIT

config SHIELD_POSIX_PRO_MICRO
    def_bool $(shields_list_contains,posix_pro_micro)
```

## app/boards/shields/posix_seeed_xiao/Kconfig.defconfig
```kconfig
# Copyright (c) 2024 The ZMK Contributors
# SPDX-License-Identifier: MIT

if SHIELD_POSIX_SEEED_XIAO

config ZMK_STUDIO
    select UART_NATIVE_POSIX_PORT_1_ENABLE

endif
```

## app/boards/shields/posix_seeed_xiao/Kconfig.shield
```kconfig
# Copyright (c) 2024 The ZMK Contributors
# SPDX-License-Identifier: MIT

config SHIELD_POSIX_SEEED_XIAO
    def_bool $(shields_list_contains,posix_seeed_xiao)
```

## app/boards/shields/pteron36/Kconfig.defconfig
```kconfig
if SHIELD_PTERON36_LEFT

config ZMK_KEYBOARD_NAME
    default "Pteron36 Left"

config ZMK_SPLIT_BLE_ROLE_CENTRAL
    default y

endif

if SHIELD_PTERON36_RIGHT

config ZMK_KEYBOARD_NAME
    default "Pteron36 Right"

endif

if SHIELD_PTERON36_LEFT || SHIELD_PTERON36_RIGHT

config ZMK_SPLIT
    default y

endif
```

## app/boards/shields/pteron36/Kconfig.shield
```kconfig
config SHIELD_PTERON36_LEFT
    def_bool $(shields_list_contains,pteron36_left)

config SHIELD_PTERON36_RIGHT
    def_bool $(shields_list_contains,pteron36_right)
```

## app/boards/shields/puckbuddy/Kconfig.shield
```kconfig
# Copyright (c) 2022 The ZMK Contributors
# SPDX-License-Identifier: MIT

config SHIELD_PUCKBUDDY
    def_bool $(shields_list_contains,puckbuddy)
```

## app/boards/shields/qaz/Kconfig.defconfig
```kconfig
# Copyright (c) 2020 The ZMK Contributors
# SPDX-License-Identifier: MIT

if SHIELD_QAZ

config ZMK_KEYBOARD_NAME
    default "QAZ"

endif
```

## app/boards/shields/qaz/Kconfig.shield
```kconfig
# Copyright (c) 2020 The ZMK Contributors
# SPDX-License-Identifier: MIT

config SHIELD_QAZ
   def_bool $(shields_list_contains,qaz)
```

## app/boards/shields/quefrency/Kconfig.defconfig
```kconfig
# Copyright (c) 2020 The ZMK Contributors
# SPDX-License-Identifier: MIT
 
 
if SHIELD_QUEFRENCY_LEFT

config ZMK_KEYBOARD_NAME
	default "Quefrency"

config ZMK_SPLIT_BLE_ROLE_CENTRAL
	default y

endif

if SHIELD_QUEFRENCY_LEFT || SHIELD_QUEFRENCY_RIGHT

config ZMK_SPLIT
	default y

endif
```

## app/boards/shields/quefrency/Kconfig.shield
```kconfig
# Copyright (c) 2020 The ZMK Contributors
# SPDX-License-Identifier: MIT

config SHIELD_QUEFRENCY_LEFT
	def_bool $(shields_list_contains,quefrency_left)

config SHIELD_QUEFRENCY_RIGHT
	def_bool $(shields_list_contains,quefrency_right)
```

## app/boards/shields/rebound/Kconfig.defconfig
```kconfig
# Copyright (c) 2020 The ZMK Contributors
# SPDX-License-Identifier: MIT

if SHIELD_REBOUND_V4

config ZMK_KEYBOARD_NAME
    default "Rebound v4"

endif
```

## app/boards/shields/rebound/Kconfig.shield
```kconfig
# Copyright (c) 2020 The ZMK Contributors
# SPDX-License-Identifier: MIT

config SHIELD_REBOUND_V4
    def_bool $(shields_list_contains,rebound_v4)
```

## app/boards/shields/redox/Kconfig.defconfig
```kconfig
# Copyright (c) 2021 The ZMK Contributors
# SPDX-License-Identifier: MIT
if SHIELD_REDOX_LEFT

config ZMK_KEYBOARD_NAME
	default "Redox"

config ZMK_SPLIT_BLE_ROLE_CENTRAL
	default y

endif

if SHIELD_REDOX_LEFT || SHIELD_REDOX_RIGHT

config ZMK_SPLIT
	default y

endif
```

## app/boards/shields/redox/Kconfig.shield
```kconfig
# Copyright (c) 2021 The ZMK Contributors
# SPDX-License-Identifier: MIT
config SHIELD_REDOX_LEFT
	def_bool $(shields_list_contains,redox_left)

config SHIELD_REDOX_RIGHT
	def_bool $(shields_list_contains,redox_right)
```

## app/boards/shields/reviung34/Kconfig.defconfig
```kconfig
# Copyright (c) 2023 The ZMK Contributors
# SPDX-License-Identifier: MIT

if SHIELD_REVIUNG34

config ZMK_KEYBOARD_NAME
    default "REVIUNG34"

endif
```

## app/boards/shields/reviung34/Kconfig.shield
```kconfig
# Copyright (c) 2023 The ZMK Contributors
# SPDX-License-Identifier: MIT

config SHIELD_REVIUNG34
    def_bool $(shields_list_contains,reviung34)
```

## app/boards/shields/reviung39/Kconfig.defconfig
```kconfig
# Copyright (c) 2020 The ZMK Contributors
# SPDX-License-Identifier: MIT

if SHIELD_REVIUNG39

config ZMK_KEYBOARD_NAME
    default "Reviung39"

endif
```

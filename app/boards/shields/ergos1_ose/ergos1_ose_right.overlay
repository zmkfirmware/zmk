/*
 * Copyright (c) 2021 The ZMK Contributors
 *
 * SPDX-License-Identifier: MIT
 */

#include "ergos1_ose.dtsi"

&default_transform {
	col-offset = <8>;
};

&kscan0 {
	col-gpios
		= <&gpio0 20 GPIO_ACTIVE_HIGH>
		, <&gpio0 22 GPIO_ACTIVE_HIGH>
		, <&gpio0 24 GPIO_ACTIVE_HIGH>
		, <&gpio1 0 GPIO_ACTIVE_HIGH>
		, <&gpio0 11 GPIO_ACTIVE_HIGH>
		, <&gpio1 4 GPIO_ACTIVE_HIGH>
		, <&gpio0 10 GPIO_ACTIVE_HIGH>
		, <&gpio1 11 GPIO_ACTIVE_HIGH>
		;
};

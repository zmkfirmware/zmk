/*
 * Copyright (c) 2020 Pete Johanson, Kurtis Lew
 *
 * SPDX-License-Identifier: MIT
 */

#include "redox.dtsi"

&default_transform {
	col-offset = <8>;
};

&kscan0 {
	col-gpios
		= <&pro_micro_d 10 GPIO_ACTIVE_HIGH>
		, <&pro_micro_d 16 GPIO_ACTIVE_HIGH>
		, <&pro_micro_d 14 GPIO_ACTIVE_HIGH>
		, <&pro_micro_a  0 GPIO_ACTIVE_HIGH>
		, <&pro_micro_a  1 GPIO_ACTIVE_HIGH>
		, <&pro_micro_a  2 GPIO_ACTIVE_HIGH>
		, <&pro_micro_a  3 GPIO_ACTIVE_HIGH>
		;
};

&bt_unpair_combo {
	key-positions = <11 71>;
};

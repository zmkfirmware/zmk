/delete-node/ &code_partition;
/delete-node/ &storage_partition;

&flash0 {
	partitions {
		code_partition: partition@1000 {
			label = "code_partition";
			reg = <0x00001000 0x000d3000>;
		};

		storage_partition: partition@d4000 {
			label = "storage";
			reg = <0x000d4000 0x00020000>;
		};
	};
};

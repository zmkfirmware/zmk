## app/boards/bmk/corne54v3/Kconfig.corne54v3_left
```kconfig
#
# Copyright (c) 2023 The ZMK Contributors
# SPDX-License-Identifier: MIT
#

config BOARD_CORNE54V3_LEFT
    select SOC_NRF52840_QIAA
    imply RETAINED_MEM
    imply RETENTION
    imply RETENTION_BOOT_MODE
```

## app/boards/bmk/corne54v3/board.yml
```yaml
boards:
  - name: corne54v3_left
    vendor: bmk
    socs:
      - name: nrf52840
        variants:
          - name: zmk
  - name: corne54v3_right
    vendor: bmk
    socs:
      - name: nrf52840
        variants:
          - name: zmk
```

## app/boards/bmk/corne54v3/corne54v3_right_defconfig
```kconfig
#
# Copyright (c) 2023 The ZMK Contributors
# SPDX-License-Identifier: MIT
#


# Enable MPU
CONFIG_ARM_MPU=y

# enable GPIO
CONFIG_GPIO=y

# Enable SPI for LEDS
CONFIG_PINCTRL=y
CONFIG_SPI=y
CONFIG_SPI_NRFX=y

# Enable writing to flash
CONFIG_USE_DT_CODE_PARTITION=y
CONFIG_MPU_ALLOW_FLASH_WRITE=y
CONFIG_NVS=y
CONFIG_SETTINGS_NVS=y
CONFIG_FLASH=y
CONFIG_FLASH_PAGE_LAYOUT=y
CONFIG_FLASH_MAP=y

# Keyboard IDs
CONFIG_ZMK_KEYBOARD_NAME="Corne54v3 Right"
CONFIG_USB_DEVICE_PID=0x27dd
CONFIG_USB_DEVICE_VID=0x16c2
CONFIG_USB_DEVICE_MANUFACTURER="BMK"
CONFIG_USB_DEVICE_SN="corne54v3rt20244"

CONFIG_BT_DIS_PNP_PID=0x27df
CONFIG_BT_DIS_PNP_VID=0x16c2
CONFIG_BT_DIS_MANUF="BMK"
CONFIG_BT_DIS_MODEL="Corne54v3"

# Enable 32kHz crystal
#CONFIG_CLOCK_CONTROL_NRF_K32SRC_XTAL=y
#CONFIG_CLOCK_CONTROL_NRF_K32SRC_150PPM=y

CONFIG_ZMK_EXT_POWER=y

# LED matrix config
CONFIG_ZMK_LED_MATRIX=y
CONFIG_ZMK_LED_MATRIX_AUTO_OFF_IDLE=y
CONFIG_ZMK_LED_MATRIX_EXT_POWER=y
CONFIG_ZMK_LED_MATRIX_ON_START=n
CONFIG_ZMK_LED_MATRIX_BRT_START=40
CONFIG_ZMK_LED_MATRIX_BRT_STEP=10
CONFIG_ZMK_LED_MATRIX_PROFILE_START=0

#Backlighting configuration
#CONFIG_PWM=y
#CONFIG_LED_PWM=y
#CONFIG_ZMK_BACKLIGHT=y
#CONFIG_ZMK_BACKLIGHT_BRT_START=20
#CONFIG_ZMK_BACKLIGHT_AUTO_OFF_IDLE=y

#Misc configuration
#CONFIG_BT_CTLR_TX_PWR_PLUS_8=y
CONFIG_ZMK_HID_REPORT_TYPE_NKRO=y
CONFIG_ZMK_HID_CONSUMER_REPORT_USAGES_BASIC=y
CONFIG_BUILD_OUTPUT_UF2=y
CONFIG_ZMK_BLE=y

#CONFIG_ZMK_DISPLAY=y
#CONFIG_ZMK_DISPLAY_STATUS_SCREEN_BUILT_IN=y
#CONFIG_ZMK_DISPLAY_WORK_QUEUE_DEDICATED=y
#CONFIG_ZMK_DISPLAY_STATUS_SCREEN_CUSTOM=y
#CONFIG_ZMK_WIDGET_WPM_STATUS=y

# Enable nice!view
CONFIG_ZMK_DISPLAY=y
#CONFIG_ZMK_DISPLAY_STATUS_SCREEN_CUSTOM=y
# Disable idle blanking
CONFIG_ZMK_DISPLAY_BLANK_ON_IDLE=y
#CONFIG_ZMK_WIDGET_WPM_STATUS=y
CONFIG_ZMK_LV_FONT_DEFAULT_SMALL_MONTSERRAT_16=y
CONFIG_LVGL=y
CONFIG_ZMK_DISPLAY_TICK_PERIOD_MS=250

CONFIG_LV_Z_MEM_POOL_SIZE=8192

#CONFIG_EC11_TRIGGER_OWN_THREAD=y
CONFIG_EC11_TRIGGER_GLOBAL_THREAD=y

CONFIG_ZMK_STUDIO_LOCKING=n
CONFIG_ZMK_HID_INDICATORS=y

CONFIG_ZMK_IDLE_TIMEOUT=15000
CONFIG_ZMK_SLEEP=y
CONFIG_ZMK_IDLE_SLEEP_TIMEOUT=3600000

CONFIG_ZMK_BATTERY_REPORTING=y
CONFIG_ZMK_SPLIT_BLE_CENTRAL_BATTERY_LEVEL_PROXY=y
CONFIG_ZMK_SPLIT_BLE_CENTRAL_BATTERY_LEVEL_FETCHING=y
```

## app/boards/bmk/n52test/Kconfig.defconfig
```kconfig
# Copyright (c) 2026 The ZMK Contributors
# SPDX-License-Identifier: MIT

if BOARD_N52TEST

config ZMK_KEYBOARD_NAME
    default "n52test"

if USB_DEVICE_STACK

config USB_NRFX
    default y

endif # USB_DEVICE_STACK

config BT_CTLR
    default BT

endif # BOARD_N52TEST
```

## app/boards/bmk/n52test/Kconfig.n52test
```kconfig
# Copyright (c) 2026 The ZMK Contributors
# SPDX-License-Identifier: MIT

config BOARD_N52TEST
    select SOC_NRF52840_QIAA
    select ZMK_BOARD_COMPAT
    imply RETAINED_MEM
    imply RETENTION
    imply RETENTION_BOOT_MODE
```

## app/boards/bmk/n52test/board.yml
```yaml
boards:
  - name: n52test
    vendor: bmk
    socs:
      - name: nrf52840
        variants:
          - name: zmk
```

## app/boards/bmk/n52test/n52test_nrf52840_zmk_defconfig
```kconfig
# Copyright (c) 2026 The ZMK Contributors
# SPDX-License-Identifier: MIT

CONFIG_ARM_MPU=y
CONFIG_PINCTRL=y
CONFIG_GPIO=y

CONFIG_PM_DEVICE=y
CONFIG_PM_DEVICE_RUNTIME=y

CONFIG_USE_DT_CODE_PARTITION=y
CONFIG_BUILD_OUTPUT_UF2=y

CONFIG_MPU_ALLOW_FLASH_WRITE=y
CONFIG_FLASH=y
CONFIG_FLASH_PAGE_LAYOUT=y
CONFIG_FLASH_MAP=y
CONFIG_NVS=y
CONFIG_SETTINGS_NVS=y
CONFIG_SETTINGS_NVS_SECTOR_SIZE_MULT=1
CONFIG_SETTINGS_NVS_SECTOR_COUNT=16
CONFIG_ZMK_SETTINGS_SAVE_DEBOUNCE=5000

CONFIG_CLOCK_CONTROL_NRF=y
CONFIG_CLOCK_CONTROL_NRF_K32SRC_XTAL=y
CONFIG_CLOCK_CONTROL_NRF_K32SRC_50PPM=y

CONFIG_PWM=y
CONFIG_ZMK_POINTING=y
CONFIG_ZMK_LED_MATRIX=y
CONFIG_ZMK_LED_MATRIX_BRT_START=100
CONFIG_ZMK_LED_MATRIX_BRT_STEP=10
CONFIG_ZMK_LED_MATRIX_AUTO_OFF_IDLE=y
CONFIG_ZMK_LED_MATRIX_IDLE_STATUS_WAKE_TIMEOUT=0
CONFIG_ZMK_IDLE_TIMEOUT=30000

CONFIG_ZMK_USB=y
CONFIG_ZMK_BLE=y

CONFIG_SYSTEM_WORKQUEUE_STACK_SIZE=4096
CONFIG_ZMK_LOW_PRIORITY_THREAD_STACK_SIZE=3072
```

## app/boards/bmk/numpad/Kconfig
```kconfig
# Copyright (c) 2021 Nick Winans
# SPDX-License-Identifier: MIT

config BOARD_ENABLE_DCDC
	bool "Enable DCDC mode"
	select SOC_DCDC_NRF52X
	default y
	depends on BOARD_NUMPAD


config BOARD_ENABLE_DCDC_HV
    bool "High voltage DCDC converter"
    select SOC_DCDC_NRF52X_HV
    default y
    depends on BOARD_NUMPAD

if BOARD_NUMPAD

config ZMK_WIDGET_LED_MATRIX_EFFECT_STATUS
    bool "Show LED matrix effect name on the numpad custom status screen"
    depends on ZMK_DISPLAY && ZMK_LED_MATRIX
    select LV_USE_LABEL

endif

if BOARD_NUMPAD
config NUMPAD_CALCULATOR
    bool "Board-local numpad calculator"
    default y
    depends on ZMK_DISPLAY && ZMK_DISPLAY_STATUS_SCREEN_CUSTOM
    depends on DT_HAS_ZMK_BEHAVIOR_NUMPAD_CALCULATOR_ENABLED
    select LV_FONT_MONTSERRAT_16
    select LV_FONT_MONTSERRAT_24
    select LV_FONT_MONTSERRAT_32
    select LV_USE_LABEL
    select REQUIRES_FULL_LIBC
    select REQUIRES_FLOAT_PRINTF
    help
      FN+Num Lock toggles the calculator. FN+Enter types the result.
      The implementation and bindings live entirely in this board directory.
endif
```

## app/boards/bmk/numpad/Kconfig.defconfig
```kconfig
# Copyright (c) 2021 Nick Winans
# SPDX-License-Identifier: MIT

if BOARD_NUMPAD

config ZMK_KEYBOARD_NAME
	default "numpad"

if USB_DEVICE_STACK

config USB_NRFX
    default y

endif # USB_DEVICE_STACK

config BT_CTLR
	default BT

if DISPLAY
    
config SPI
    default y

if LVGL

config LV_Z_VDB_SIZE
    default 100

config LV_DPI_DEF
    default 148

config LV_Z_BITS_PER_PIXEL
    default 1

choice LV_COLOR_DEPTH
    default LV_COLOR_DEPTH_1
endchoice

endif # LVGL
endif # DISPLAY

if ZMK_DISPLAY

config ZMK_DISPLAY_BLANK_ON_IDLE
    default n

config ZMK_DISPLAY_DEDICATED_THREAD_STACK_SIZE
    default 4096

endif # ZMK_DISPLAY

if ZMK_DISPLAY && ZMK_LED_MATRIX

config ZMK_WIDGET_LED_MATRIX_EFFECT_STATUS
    default y

endif # ZMK_DISPLAY && ZMK_LED_MATRIX

endif # BOARD_NUMPAD
```

## app/boards/bmk/numpad/board.yml
```yaml
boards:
  - name: numpad
    vendor: bmk
    socs:
      - name: nrf52840
        variants:
          - name: zmk
```

## app/boards/bmk/numpad/calculator/dts/bindings/behaviors/zmk,behavior-numpad-calculator.yaml
```yaml
# SPDX-License-Identifier: MIT
description: Board-local numpad calculator input and mode control
compatible: "zmk,behavior-numpad-calculator"
include: one_param.yaml
properties:
  calculator-layer:
    type: int
    required: true
  function-layer:
    type: int
    required: true
```

## app/boards/bmk/numpadv2/Kconfig
```kconfig
# Copyright (c) 2021 Nick Winans
# SPDX-License-Identifier: MIT

config BOARD_ENABLE_DCDC
    bool "Enable DCDC mode"
    select SOC_DCDC_NRF52X
    default y
    depends on BOARD_NUMPADV2

config ZMK_NUMPADV2_FLASH_DIAGNOSTIC
    bool "Enable numpadv2 Flash/NVS LED diagnostic"
    depends on BOARD_NUMPADV2
    depends on SETTINGS
    depends on ZMK_LED_MATRIX
    default n
    help
      Build a diagnostic-only settings marker test for numpadv2. The test
      reports NVS write and cross-reboot load results using the LED matrix.
      Do not enable this option in normal firmware.
```

## app/boards/bmk/numpadv2/Kconfig.numpadv2
```kconfig
# Copyright (c) 2021 Nick Winans
# Copyright (c) 2024 The ZMK Contributors
# SPDX-License-Identifier: MIT

config BOARD_NUMPADV2
    select SOC_NRF52840_QIAA
    imply RETAINED_MEM
    imply RETENTION
    imply RETENTION_BOOT_MODE
```

## app/boards/bmk/numpadv2/board.yml
```yaml
boards:
  - name: numpadv2
    vendor: bmk
    socs:
      - name: nrf52840
        variants:
          - name: zmk
```

## app/boards/bmk/numpadv2/numpadv2_nrf52840_zmk_defconfig
```kconfig
# Copyright (c) 2021 Nick Winans
# SPDX-License-Identifier: MIT

# Enable MPU
CONFIG_ARM_MPU=y

CONFIG_PINCTRL=y
CONFIG_PM_DEVICE=y
CONFIG_PM_DEVICE_RUNTIME=y

# enable GPIO
CONFIG_GPIO=y

CONFIG_USE_DT_CODE_PARTITION=y
CONFIG_BUILD_OUTPUT_UF2=y

CONFIG_MPU_ALLOW_FLASH_WRITE=y
CONFIG_NVS=y
CONFIG_SETTINGS_NVS=y
CONFIG_SETTINGS_NVS_SECTOR_SIZE_MULT=1
CONFIG_SETTINGS_NVS_SECTOR_COUNT=16
CONFIG_ZMK_SETTINGS_SAVE_DEBOUNCE=5000
CONFIG_FLASH=y
CONFIG_FLASH_PAGE_LAYOUT=y
CONFIG_FLASH_MAP=y
CONFIG_INIT_STACKS=y
CONFIG_STACK_SENTINEL=y
CONFIG_ASSERT=y

CONFIG_ZMK_HID_INDICATORS=y

#CONFIG_ZMK_SLEEP=y
#CONFIG_ZMK_IDLE_SLEEP_TIMEOUT=3600000

CONFIG_ZMK_USB=y
CONFIG_ZMK_BLE=y

CONFIG_ZMK_STUDIO_LOCKING=n

CONFIG_ZMK_EXT_POWER=y

# LED matrix config
CONFIG_ZMK_LED_MATRIX=y
CONFIG_ZMK_LED_MATRIX_EXT_POWER=y
CONFIG_ZMK_LED_MATRIX_AUTO_OFF_IDLE=y
CONFIG_ZMK_LED_MATRIX_BRT_START=40
CONFIG_ZMK_LED_MATRIX_BRT_STEP=10
CONFIG_SYSTEM_WORKQUEUE_STACK_SIZE=4096
CONFIG_ZMK_LOW_PRIORITY_THREAD_STACK_SIZE=3072

CONFIG_ZMK_IDLE_TIMEOUT=15000
```

## app/boards/clickety_split/clickety_split_chiisai/Kconfig.clickety_split_chiisai
```kconfig
# Copyright (c) 2025 Clickety Split Ltd.
# SPDX-License-Identifier: MIT

config BOARD_CLICKETY_SPLIT_CHIISAI
    select SOC_NRF52840_QIAA
    select ZMK_BOARD_COMPAT if BOARD_CLICKETY_SPLIT_CHIISAI_NRF52840_ZMK
    imply RETAINED_MEM if BOARD_CLICKETY_SPLIT_CHIISAI_NRF52840_ZMK
    imply RETENTION if BOARD_CLICKETY_SPLIT_CHIISAI_NRF52840_ZMK
    imply RETENTION_BOOT_MODE if BOARD_CLICKETY_SPLIT_CHIISAI_NRF52840_ZMK
```

## app/boards/clickety_split/clickety_split_chiisai/board.yml
```yaml
board:
  extend: clickety_split_chiisai
  variants:
    - name: zmk
      qualifier: nrf52840
```

## app/boards/shields/tester_rpi_zero/Kconfig.shield
```kconfig
config SHIELD_TESTER_RPI_ZERO
    def_bool $(shields_list_contains,tester_rpi_zero)
```

## app/dts/bindings/behaviors/zmk,behavior-input-speed.yaml
```yaml
# Copyright (c) 2026 The ZMK Contributors
# SPDX-License-Identifier: MIT

description: Behavior for selecting a runtime input speed profile

compatible: "zmk,behavior-input-speed"

include: two_param.yaml

properties:
  processor:
    type: phandle
    required: true
    description: zmk,input-processor-speed-profile device controlled by this behavior.
```

## app/dts/bindings/behaviors/zmk,behavior-leader-key.yaml
```yaml
# Copyright (c) 2022 The ZMK Contributors
# SPDX-License-Identifier: MIT

description: Leader key behavior

compatible: "zmk,behavior-leader-key"

include: zero_param.yaml

properties:
  timeout-ms:
    type: int
    default: -1
  overlap-timeout-ms:
    type: int
    default: 200
  inherit-source:
    type: boolean

child-binding:
  description: "A leader sequence"

  properties:
    bindings:
      type: phandle-array
      required: true
    key-positions:
      type: array
      required: true
    immediate-trigger:
      type: boolean
    last-key-source:
      type: boolean
```

## app/dts/bindings/input_processors/zmk,input-processor-speed-profile.yaml
```yaml
# Copyright (c) 2026 The ZMK Contributors
# SPDX-License-Identifier: MIT

description: Runtime-selectable percentage scaling input processor

compatible: "zmk,input-processor-speed-profile"

include: ip_zero_param.yaml

properties:
  type:
    type: int
    required: true

  codes:
    type: array
    required: true

  speed-percentages:
    type: array
    required: true
    description: One-based speed levels expressed as percentages from 1 through 65535.

  default-speed-level:
    type: int
    required: true
    description: One-based speed level selected when no persisted setting exists.

  persist-speed-level:
    type: boolean
    description: Persist the selected level through the Zephyr settings subsystem.

  track-remainders:
    type: boolean
    required: true
    description: Preserve fractional scaled movement independently for every relative axis.
```

## app/module/boards/clickety_split/clickety_split_chiisai/Kconfig.clickety_split_chiisai
```kconfig
# Copyright (c) 2025 Clickety Split Ltd.
# SPDX-License-Identifier: MIT

config BOARD_CLICKETY_SPLIT_CHIISAI
    select SOC_NRF52840_QIAA
```

## app/module/boards/clickety_split/clickety_split_chiisai/board.yml
```yaml
board:
  name: clickety_split_chiisai
  vendor: clickety_split
  socs:
    - name: nrf52840
```

## app/boards/bmk/numpad/Kconfig.defconfig
```kconfig
# Copyright (c) 2021 Nick Winans
# SPDX-License-Identifier: MIT

if BOARD_NUMPAD

config ZMK_KEYBOARD_NAME
	default "numpad"

if USB_DEVICE_STACK

config USB_NRFX
    default y

endif # USB_DEVICE_STACK

# Board-local USB transport, enabled only with Studio. Diagnostics can opt out.
if ZMK_STUDIO

config ZMK_STUDIO_LOCKING
    default y

config USB_CDC_ACM
    default y

config SERIAL
    default y

config UART_INTERRUPT_DRIVEN
    default y

config UART_LINE_CTRL
    default y

endif # ZMK_STUDIO

config BT_CTLR
	default BT

if DISPLAY
    
config SPI
    default y

if LVGL

config LV_Z_VDB_SIZE
    default 100

config LV_DPI_DEF
    default 148

config LV_Z_BITS_PER_PIXEL
    default 1

choice LV_COLOR_DEPTH
    default LV_COLOR_DEPTH_1
endchoice

endif # LVGL
endif # DISPLAY

if ZMK_DISPLAY

config ZMK_DISPLAY_BLANK_ON_IDLE
    default n

config ZMK_DISPLAY_DEDICATED_THREAD_STACK_SIZE
    default 4096

endif # ZMK_DISPLAY

if ZMK_DISPLAY && ZMK_LED_MATRIX

config ZMK_WIDGET_LED_MATRIX_EFFECT_STATUS
    default y

endif # ZMK_DISPLAY && ZMK_LED_MATRIX

endif # BOARD_NUMPAD
```

## app/src/indicators/Kconfig.indicator_leds
```kconfig
# Copyright (c) 2025 The ZMK Contributors
# SPDX-License-Identifier: MIT

config ZMK_INDICATOR_LEDS
    bool
    default y
    depends on DT_HAS_ZMK_INDICATOR_LEDS_ENABLED
    depends on !ZMK_SPLIT || ZMK_SPLIT_ROLE_CENTRAL || \
               (ZMK_SPLIT_PERIPHERAL_HID_INDICATORS && ZMK_SPLIT_PERIPHERAL_ENDPOINT)
    select LED
    select ZMK_HID_INDICATORS

if ZMK_INDICATOR_LEDS

config ZMK_INDICATOR_LEDS_INIT_PRIORITY
    int "ZMK indicator LED initialization priority"
    default 91
    help
        System initialization priority for ZMK indicator LEDs.

endif # ZMK_INDICATOR_LEDS
```

## app/src/split/Kconfig
```kconfig
# Copyright (c) 2022 The ZMK Contributors
# SPDX-License-Identifier: MIT

menuconfig ZMK_SPLIT
    bool "Split keyboard support"

if ZMK_SPLIT

config ZMK_SPLIT_ROLE_CENTRAL
    bool "Split central device"

config ZMK_SPLIT_BLE
    bool "BLE Split"
    default y
    depends on ZMK_BLE
    select BT_USER_PHY_UPDATE
    select BT_AUTO_PHY_UPDATE

config ZMK_SPLIT_WIRED
    bool "Wired Split"
    default y
    depends on DT_HAS_ZMK_WIRED_SPLIT_ENABLED
    select SERIAL
    select RING_BUFFER
    select CRC

config ZMK_SPLIT_PERIPHERAL_ENDPOINT
    bool "Mirror the selected endpoint on the split peripheral(s)"
    help
      Send the selected and the preferred endpoint to the split peripheral(s), so
      indicator LEDs and the output status widget work there. Enable on both halves.

config ZMK_SPLIT_PERIPHERAL_CENTRAL_BATTERY
    bool "Expose the central battery level on the split peripheral(s)"
    depends on ZMK_BATTERY_REPORTING || !ZMK_SPLIT_ROLE_CENTRAL
    help
      Send the central's battery level and whether it is powered over USB to the split
      peripheral(s). Enable on both halves.

config ZMK_SPLIT_PERIPHERAL_HID_INDICATORS
    bool "Mirror the HID indicators on the split peripheral(s)"
    select ZMK_HID_INDICATORS
    help
      Enable propagating the HID (LED) Indicator state to the split peripheral(s).
      Enable on both halves.

config ZMK_SPLIT_PERIPHERAL_BLE_PROFILE
    bool "Mirror the active BLE profile on the split peripheral(s)"
    depends on ZMK_BLE || !ZMK_SPLIT_ROLE_CENTRAL
    help
      Send the index of the active BLE profile and whether it is connected and bonded
      to the split peripheral(s). Enable on both halves.

config ZMK_SPLIT_PERIPHERAL_LAYER_STATE
    bool "Mirror the layer state on the split peripheral(s)"
    select UTF8 if ZMK_SPLIT_ROLE_CENTRAL
    help
      Send the active layers and the name of the highest active layer to the split
      peripheral(s), so layer widgets work there. Enable on both halves.

config ZMK_SPLIT_PERIPHERAL_CENTRAL_STATE_SYNC
    def_bool ZMK_SPLIT_PERIPHERAL_HID_INDICATORS || \
             ZMK_SPLIT_PERIPHERAL_LAYER_STATE || \
             ZMK_SPLIT_PERIPHERAL_BLE_PROFILE || \
             ZMK_SPLIT_PERIPHERAL_CENTRAL_BATTERY || \
             ZMK_SPLIT_PERIPHERAL_ENDPOINT

config ZMK_SPLIT_PERIPHERAL_CENTRAL_STATE_SYNC_COALESCE_MS
    int "Delay to coalesce central state changes before sending them to peripherals"
    depends on ZMK_SPLIT_PERIPHERAL_CENTRAL_STATE_SYNC && ZMK_SPLIT_ROLE_CENTRAL
    range 1 1000
    default 50
    help
      After a change, the central waits this long before sending, so changes within
      the window go to the peripheral(s) together, with only the latest value of each kind.

endif # ZMK_SPLIT

rsource "bluetooth/Kconfig"
rsource "wired/Kconfig"
```

## app/tests/twister/matrix_transform/fallback/testcase.yaml
```yaml
tests:
  zmk.units.matrix_transform.fallback:
    tags:
      - units
    integration_platforms:
      - native_sim/native/64
```

## app/tests/twister/matrix_transform/mapped/testcase.yaml
```yaml
tests:
  zmk.units.matrix_transform.mapped:
    tags:
      - units
    integration_platforms:
      - native_sim/native/64
```

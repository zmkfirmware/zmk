/*
 * Copyright (c) 2026 The ZMK Contributors
 *
 * SPDX-License-Identifier: MIT
 */

#include <../boards/joric/nrfmicro/nrfmicro_nrf52840_flipped.dts>
#include <common/nordic/nrf52840_uf2_boot_mode.dtsi>

/ {
    // Node name must match original "EXT_POWER" label to preserve user settings.
    EXT_POWER {
        compatible = "zmk,ext-power-generic";
        control-gpios = <&gpio1 9 GPIO_ACTIVE_HIGH>;
        init-delay-ms = <50>;
    };
};

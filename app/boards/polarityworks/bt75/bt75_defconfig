## app/boards/polarityworks/bt75/bt75_defconfig
```kconfig
# SPDX-License-Identifier: MIT

# Enable MPU
CONFIG_ARM_MPU=y

# enable GPIO
CONFIG_GPIO=y
CONFIG_PINCTRL=y

# encoder
CONFIG_EC11=y
CONFIG_EC11_TRIGGER_GLOBAL_THREAD=y

CONFIG_USE_DT_CODE_PARTITION=y
CONFIG_PWM=y
CONFIG_LED_PWM=y
CONFIG_ZMK_BACKLIGHT=y
CONFIG_BUILD_OUTPUT_UF2=y

CONFIG_MPU_ALLOW_FLASH_WRITE=y
CONFIG_NVS=y
CONFIG_SETTINGS_NVS=y
CONFIG_FLASH=y
CONFIG_FLASH_PAGE_LAYOUT=y
CONFIG_FLASH_MAP=y

CONFIG_ZMK_RGB_UNDERGLOW=y
CONFIG_ZMK_RGB_UNDERGLOW_EXT_POWER=y
CONFIG_ZMK_RGB_UNDERGLOW_ON_START=y
CONFIG_ZMK_RGB_UNDERGLOW_HUE_START=262

CONFIG_BT_CTLR_TX_PWR_PLUS_8=y

CONFIG_ZMK_USB=y
CONFIG_ZMK_BLE=y
```

## app/boards/qmk/proton_c/Kconfig.proton_c
```kconfig
# Copyright (c) 2026 The ZMK Contributors
# SPDX-License-Identifier: Apache-2.0

config BOARD_PROTON_C
    select ZMK_BOARD_COMPAT
```

## app/boards/qmk/proton_c/board.yml
```yaml
board:
  extend: proton_c
  variants:
    - name: zmk
      qualifier: stm32f303xc
```

## app/boards/raspberrypi/rpi_pico/Kconfig.rpi_pico
```kconfig
# Copyright (c) 2026 The ZMK Contributors
# SPDX-License-Identifier: MIT

config BOARD_RPI_PICO
    select SOC_RP2040
    select ZMK_BOARD_COMPAT if BOARD_RPI_PICO_RP2040_ZMK
    imply RETAINED_MEM if BOARD_RPI_PICO_RP2040_ZMK
    imply RETENTION if BOARD_RPI_PICO_RP2040_ZMK
    imply RETENTION_BOOT_MODE if BOARD_RPI_PICO_RP2040_ZMK
```

## app/boards/seeed/seeeduino_xiao/Kconfig.seeeduino_xiao
```kconfig
# Copyright (c) 2026 Pete Johanson
# SPDX-License-Identifier: MIT

config BOARD_SEEEDUINO_XIAO
    select ZMK_BOARD_COMPAT if BOARD_SEEEDUINO_XIAO_SAMD21G18A_ZMK
    imply RETAINED_MEM if BOARD_SEEEDUINO_XIAO_SAMD21G18A_ZMK
    imply RETENTION if BOARD_SEEEDUINO_XIAO_SAMD21G18A_ZMK
    imply RETENTION_BOOT_MODE if BOARD_SEEEDUINO_XIAO_SAMD21G18A_ZMK
```

## app/boards/seeed/seeeduino_xiao/board.yml
```yaml
board:
  extend: seeeduino_xiao
  variants:
    - name: zmk
      qualifier: samd21g18a
```

## app/boards/seeed/seeeduino_xiao/seeeduino_xiao_zmk_defconfig
```kconfig
# XTAL setup
CONFIG_SOC_ATMEL_SAMD_XOSC32K=y
CONFIG_SOC_ATMEL_SAMD_XOSC32K_AS_MAIN=y

# Bootloader Setup
CONFIG_BUILD_OUTPUT_UF2=y
CONFIG_BOOTLOADER_BOSSA=y
CONFIG_BOOTLOADER_BOSSA_ADAFRUIT_UF2=y

# ZMK USB Transport
CONFIG_ZMK_USB=y
```

## app/boards/seeed/xiao_ble/Kconfig.xiao_ble
```kconfig
# Copyright (c) 2026 Pete Johanson
# SPDX-License-Identifier: MIT

config BOARD_XIAO_BLE
    select SOC_NRF52840_QIAA
    select ZMK_BOARD_COMPAT if BOARD_XIAO_BLE_NRF52840_ZMK
    imply RETAINED_MEM if BOARD_XIAO_BLE_NRF52840_ZMK
    imply RETENTION if BOARD_XIAO_BLE_NRF52840_ZMK
    imply RETENTION_BOOT_MODE if BOARD_XIAO_BLE_NRF52840_ZMK
```

## app/boards/seeed/xiao_ble/board.yml
```yaml
board:
  extend: xiao_ble
  variants:
    - name: zmk
      qualifier: nrf52840
    - name: zmk_debug
      qualifier: nrf52840
```

## app/boards/seeed/xiao_ble/xiao_ble_zmk_debug_defconfig
```kconfig
# Enable MPU
CONFIG_ARM_MPU=y

# Enable hardware stack protection
CONFIG_HW_STACK_PROTECTION=y

# Enable GPIO
CONFIG_GPIO=y

CONFIG_ZMK_USB=y
CONFIG_ZMK_BLE=y

# Build UF2 by default, supported by the Adafruit nRF52 Bootloader
CONFIG_BUILD_OUTPUT_UF2=y
CONFIG_USE_DT_CODE_PARTITION=y

# Settings Support
CONFIG_MPU_ALLOW_FLASH_WRITE=y
CONFIG_NVS=y
CONFIG_SETTINGS_NVS=y
CONFIG_FLASH=y
CONFIG_FLASH_PAGE_LAYOUT=y
CONFIG_FLASH_MAP=y

# Bootloader Support
CONFIG_RETAINED_MEM=y
CONFIG_RETENTION=y
CONFIG_RETENTION_BOOT_MODE=y
CONFIG_ZMK_BOOTMODE_MAGIC_VALUE_BOOTLOADER_TYPE_ADAFRUIT_NRF52=y

# Enable debug specific settings
CONFIG_DEBUG=y
CONFIG_DEBUG_COREDUMP=y
CONFIG_DEBUG_THREAD_INFO=y
CONFIG_DEBUG_COREDUMP_BACKEND_FLASH_PARTITION=y
# CONFIG_DEBUG_COREDUMP_MEMORY_DUMP_THREADS=y

CONFIG_SOC_FLASH_NRF_RADIO_SYNC_NONE=y
CONFIG_SOC_FLASH_NRF_PARTIAL_ERASE=y
CONFIG_SOC_FLASH_NRF_PARTIAL_ERASE_MS=3
```

## app/boards/seeed/xiao_ble/xiao_ble_zmk_defconfig
```kconfig
# Enable MPU
CONFIG_ARM_MPU=y

# Enable hardware stack protection
CONFIG_HW_STACK_PROTECTION=y

# Enable GPIO
CONFIG_GPIO=y

CONFIG_ZMK_USB=y
CONFIG_ZMK_BLE=y

# Build UF2 by default, supported by the Adafruit nRF52 Bootloader
CONFIG_BUILD_OUTPUT_UF2=y
CONFIG_USE_DT_CODE_PARTITION=y

# Settings Support
CONFIG_MPU_ALLOW_FLASH_WRITE=y
CONFIG_NVS=y
CONFIG_SETTINGS_NVS=y
CONFIG_FLASH=y
CONFIG_FLASH_PAGE_LAYOUT=y
CONFIG_FLASH_MAP=y

# Bootloader Support
CONFIG_RETAINED_MEM=y
CONFIG_RETENTION=y
CONFIG_RETENTION_BOOT_MODE=y
CONFIG_ZMK_BOOTMODE_MAGIC_VALUE_BOOTLOADER_TYPE_ADAFRUIT_NRF52=y
```

## app/boards/seeed/xiao_rp2040/Kconfig.xiao_rp2040
```kconfig
# Copyright (c) 2026 Pete Johanson
# SPDX-License-Identifier: MIT

config BOARD_XIAO_RP2040
    select ZMK_BOARD_COMPAT if BOARD_XIAO_RP2040_RP2040_ZMK
    imply RETAINED_MEM if BOARD_XIAO_RP2040_RP2040_ZMK
    imply RETENTION if BOARD_XIAO_RP2040_RP2040_ZMK
    imply RETENTION_BOOT_MODE if BOARD_XIAO_RP2040_RP2040_ZMK
```

## app/boards/seeed/xiao_rp2040/board.yml
```yaml
board:
  extend: xiao_rp2040
  variants:
    - name: zmk
      qualifier: rp2040
```

## app/boards/seeed/xiao_rp2040/xiao_rp2040_zmk_defconfig
```kconfig
# SPDX-License-Identifier: MIT

CONFIG_SYS_CLOCK_HW_CYCLES_PER_SEC=125000000
CONFIG_RESET=y

# Enable clock control by default
CONFIG_CLOCK_CONTROL=y

# Code partition needed to target the correct flash range
CONFIG_USE_DT_CODE_PARTITION=y

# Output UF2 by default, native bootloader supports it.
CONFIG_BUILD_OUTPUT_UF2=y

# Enable USB HID transport by default
CONFIG_ZMK_USB=y

# Settings Enablement
CONFIG_MPU_ALLOW_FLASH_WRITE=y
CONFIG_NVS=y
CONFIG_SETTINGS_NVS=y
CONFIG_FLASH=y
CONFIG_FLASH_PAGE_LAYOUT=y
CONFIG_FLASH_MAP=y


# Bootloader support
CONFIG_RETAINED_MEM=y
CONFIG_RETENTION=y
CONFIG_RETENTION_BOOT_MODE=y
```

## app/boards/seeeduino_xiao_ble.conf
```kconfig
CONFIG_CONSOLE=n
CONFIG_SERIAL=n
CONFIG_UART_CONSOLE=n
CONFIG_UART_INTERRUPT_DRIVEN=n
CONFIG_ZMK_USB=y
CONFIG_ZMK_BLE=y


CONFIG_MPU_ALLOW_FLASH_WRITE=y
CONFIG_NVS=y
CONFIG_SETTINGS_NVS=y
CONFIG_FLASH=y
CONFIG_FLASH_PAGE_LAYOUT=y
CONFIG_FLASH_MAP=y
```

## app/boards/seeeduino_xiao_ble_nrf52840_sense.conf
```kconfig
CONFIG_MPU_ALLOW_FLASH_WRITE=y
CONFIG_NVS=y
CONFIG_SETTINGS_NVS=y
CONFIG_FLASH=y
CONFIG_FLASH_PAGE_LAYOUT=y
CONFIG_FLASH_MAP=y
```

## app/boards/shields/a_dux/Kconfig.defconfig
```kconfig
# Copyright (c) 2021 The ZMK Contributors
# SPDX-License-Identifier: MIT

if SHIELD_A_DUX_LEFT

config ZMK_KEYBOARD_NAME
	default "A. Dux"

config ZMK_SPLIT_ROLE_CENTRAL
	default y

endif

if SHIELD_A_DUX_LEFT || SHIELD_A_DUX_RIGHT

config ZMK_SPLIT
	default y

endif
```

## app/boards/shields/a_dux/Kconfig.shield
```kconfig
# Copyright (c) 2021 The ZMK Contributors
# SPDX-License-Identifier: MIT

config SHIELD_A_DUX_LEFT
	def_bool $(shields_list_contains,a_dux_left)

config SHIELD_A_DUX_RIGHT
	def_bool $(shields_list_contains,a_dux_right)
```

## app/boards/shields/andante/Kconfig.defconfig
```kconfig
# Copyright (c) 2021 The ZMK Contributors
# SPDX-License-Identifier: MIT

if SHIELD_ANDANTE_LEFT

config ZMK_KEYBOARD_NAME
	default "Andante-L"

config ZMK_SPLIT_BLE_ROLE_CENTRAL
	default y

endif


if SHIELD_ANDANTE_RIGHT

config ZMK_KEYBOARD_NAME
	default "Andante-R"

endif


if SHIELD_ANDANTE_LEFT || SHIELD_ANDANTE_RIGHT

config ZMK_SPLIT
	default y

endif
```

## app/boards/shields/andante/Kconfig.shield
```kconfig
# Copyright (c) 2021 The ZMK Contributors
# SPDX-License-Identifier: MIT

config SHIELD_ANDANTE_LEFT
	def_bool $(shields_list_contains,andante_left)

config SHIELD_ANDANTE_RIGHT
	def_bool $(shields_list_contains,andante_right)
```

## app/boards/shields/architeuthis_dux/Kconfig.defconfig
```kconfig
# Copyright (c) 2021 The ZMK Contributors
# SPDX-License-Identifier: MIT

if SHIELD_ARCHITEUTHIS_DUX_LEFT

config ZMK_KEYBOARD_NAME
	default "Architeuthis Dux"

config ZMK_SPLIT_BLE_ROLE_CENTRAL
	default y

endif

if SHIELD_ARCHITEUTHIS_DUX_RIGHT

config ZMK_KEYBOARD_NAME
	default "A. Dux Right"

endif

if SHIELD_ARCHITEUTHIS_DUX_LEFT || SHIELD_ARCHITEUTHIS_DUX_RIGHT

config ZMK_SPLIT
	default y

endif
```

## app/boards/shields/architeuthis_dux/Kconfig.shield
```kconfig
# Copyright (c) 2021 The ZMK Contributors
# SPDX-License-Identifier: MIT

config SHIELD_ARCHITEUTHIS_DUX_LEFT
	def_bool $(shields_list_contains,architeuthis_dux_left)

config SHIELD_ARCHITEUTHIS_DUX_RIGHT
	def_bool $(shields_list_contains,architeuthis_dux_right)
```

## app/boards/shields/argoworks_ishi80_mk0/Kconfig.defconfig
```kconfig
# Copyright (c) 2022 The ZMK Contributors
# SPDX-License-Identifier: MIT

if SHIELD_ARGOWORKS_ISHI80_MK0

config ZMK_KEYBOARD_NAME
	default "Ishi80 Mk0"

endif
```

## app/boards/shields/argoworks_ishi80_mk0/Kconfig.shield
```kconfig
# Copyright (c) 2022 The ZMK Contributors
# SPDX-License-Identifier: MIT

config SHIELD_ARGOWORKS_ISHI80_MK0
    def_bool $(shields_list_contains,argoworks_ishi80_mk0)
```

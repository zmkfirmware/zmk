/*
 * Standalone (HID-central) keymap for the derivative-rev-a board.
 *
 * The actual layers live in the shared keymap so the dongle central build
 * (derivative_dongle shield) can reuse the exact same bindings and key-position
 * ordering. Edit derivative_keymap.dtsi, not this file.
 */

#include "derivative_keymap.dtsi"

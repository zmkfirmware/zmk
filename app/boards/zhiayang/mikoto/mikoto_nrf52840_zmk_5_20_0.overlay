/*
 * Copyright (c) 2026 The ZMK Contributors
 *
 * SPDX-License-Identifier: MIT
 */

#include <../boards/zhiayang/mikoto/mikoto-pinctrl.dtsi>
#include <../boards/zhiayang/mikoto/arduino_pro_micro_pins_v5.dtsi>

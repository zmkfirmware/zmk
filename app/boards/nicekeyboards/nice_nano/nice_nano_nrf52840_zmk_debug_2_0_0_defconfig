## app/boards/nicekeyboards/nice_nano/nice_nano_nrf52840_zmk_debug_2_0_0_defconfig
```kconfig
# SPDX-License-Identifier: MIT

# Enable MPU
CONFIG_ARM_MPU=y

# Use pinctrl
CONFIG_PINCTRL=y

# enable GPIO
CONFIG_GPIO=y

CONFIG_USE_DT_CODE_PARTITION=y
CONFIG_BUILD_OUTPUT_UF2=y

# Enable debug specific settings
CONFIG_DEBUG=y
CONFIG_DEBUG_COREDUMP=y
CONFIG_DEBUG_THREAD_INFO=y
CONFIG_DEBUG_COREDUMP_BACKEND_FLASH_PARTITION=y
# CONFIG_DEBUG_COREDUMP_MEMORY_DUMP_THREADS=y

CONFIG_SOC_FLASH_NRF_RADIO_SYNC_NONE=y
CONFIG_SOC_FLASH_NRF_PARTIAL_ERASE=y
CONFIG_SOC_FLASH_NRF_PARTIAL_ERASE_MS=3

CONFIG_MPU_ALLOW_FLASH_WRITE=y
CONFIG_NVS=y
CONFIG_SETTINGS_NVS=y
CONFIG_FLASH=y
CONFIG_FLASH_PAGE_LAYOUT=y
CONFIG_FLASH_MAP=y

CONFIG_ZMK_BLE=y
CONFIG_ZMK_USB=y
```

## app/boards/nordic/nrf52840dk/Kconfig.nrf52840dk
```kconfig
config BOARD_NRF52840DK
    select SOC_NRF52840_QIAA if BOARD_NRF52840DK_NRF52840_ZMK
    select ZMK_BOARD_COMPAT if BOARD_NRF52840DK_NRF52840_ZMK
```

## app/boards/nordic/nrf52840dk/board.yml
```yaml
board:
  extend: nrf52840dk
  variants:
    - name: zmk
      qualifier: nrf52840
```

## app/boards/nordic/nrf52840dk/nrf52840dk_nrf52840_zmk_defconfig
```kconfig
# Copyright (c) 2022 The ZMK Contributors
# SPDX-License-Identifier: MIT

# Enable MPU
CONFIG_ARM_MPU=y

# Enable hardware stack protection
CONFIG_HW_STACK_PROTECTION=y

# enable GPIO
CONFIG_GPIO=y

# USB and BLE HID
CONFIG_ZMK_USB=y
CONFIG_ZMK_BLE=y

# Settings Support
CONFIG_MPU_ALLOW_FLASH_WRITE=y
CONFIG_NVS=y
CONFIG_SETTINGS_NVS=y
CONFIG_FLASH=y
CONFIG_FLASH_PAGE_LAYOUT=y
CONFIG_FLASH_MAP=y
```

## app/boards/nordic/nrf52840dongle/Kconfig.nrf52840dongle
```kconfig
# Copyright (c) 2026 The ZMK Contributors
# SPDX-License-Identifier: MIT

config BOARD_NRF52840DONGLE
    select ZMK_BOARD_COMPAT if BOARD_NRF52840DONGLE_NRF52840_ZMK
```

## app/boards/nordic/nrf52840dongle/board.yml
```yaml
board:
  extend: nrf52840dongle
  variants:
    - name: zmk
      qualifier: nrf52840
```

## app/boards/nordic/nrf52840dongle/nrf52840dongle_nrf52840_zmk_defconfig
```kconfig
# Copyright (c) 2026 The ZMK Contributors
# SPDX-License-Identifier: MIT

# Enable MPU
CONFIG_ARM_MPU=y

# Enable hardware stack protection
CONFIG_HW_STACK_PROTECTION=y

# enable GPIO
CONFIG_GPIO=y

# Board Kconfig.defconfig enables USB CDC ACM and should disable USB remote
# wakeup by default. It needs to be disabled here, because the USB nrfx
# driver always overwrites option from Kconfig mentioned above with the
# imply from CONFIG_USB_NRFX.
CONFIG_USB_DEVICE_REMOTE_WAKEUP=n

# HID Transports
CONFIG_ZMK_BLE=y
CONFIG_ZMK_USB=y

# Settings options
CONFIG_MPU_ALLOW_FLASH_WRITE=y
CONFIG_NVS=y
CONFIG_SETTINGS_NVS=y
CONFIG_FLASH=y
CONFIG_FLASH_PAGE_LAYOUT=y
CONFIG_FLASH_MAP=y
```

## app/boards/nrf5340dk_nrf5340_cpuapp.conf
```kconfig
# Copyright (c) 2022 The ZMK Contributors
# SPDX-License-Identifier: MIT

CONFIG_ZMK_USB=y
CONFIG_ZMK_BLE=y

CONFIG_MPU_ALLOW_FLASH_WRITE=y
CONFIG_NVS=y
CONFIG_SETTINGS_NVS=y
CONFIG_FLASH=y
CONFIG_FLASH_PAGE_LAYOUT=y
CONFIG_FLASH_MAP=y

# Default main stack size is too small for HCI RPMsg
CONFIG_MAIN_STACK_SIZE=2048
```

## app/boards/olkb/planck/Kconfig.defconfig
```kconfig
# Planck keyboard configuration

# Copyright (c) 2020 The ZMK Contributors
# SPDX-License-Identifier: MIT

if BOARD_PLANCK_REV6

config ZMK_KEYBOARD_NAME
    default "Planck V6"

config ZMK_KSCAN_MATRIX_POLLING
    default y

endif # BOARD_PLANCK_REV6
```

## app/boards/olkb/planck/Kconfig.planck
```kconfig
# Planck V6 board configuration

# Copyright (c) 2020 The ZMK Contributors
# SPDX-License-Identifier: MIT

config BOARD_PLANCK
    select SOC_STM32F303XC
    select ZMK_BOARD_COMPAT
```

## app/boards/olkb/planck/board.yml
```yaml
board:
  name: planck
  vendor: olkb
  socs:
    - name: stm32f303xc
  revision:
    format: major.minor.patch
    default: 6.0.0
    revisions:
      - name: 6.0.0
```

## app/boards/olkb/preonic/Kconfig.preonic
```kconfig
# Preonic V3 board configuration

# Copyright (c) 2022 The ZMK Contributors
# SPDX-License-Identifier: MIT

config BOARD_PREONIC
    select SOC_STM32F303XC
```

## app/boards/olkb/preonic/board.yml
```yaml
board:
  name: preonic
  vendor: olkb
  socs:
    - name: stm32f303xc
  revision:
    format: major.minor.patch
    default: 3.0.0
    revisions:
      - name: 3.0.0
```

## app/boards/olkb/preonic/preonic_defconfig
```kconfig
# SPDX-License-Identifier: MIT

# 72MHz system clock
CONFIG_SYS_CLOCK_HW_CYCLES_PER_SEC=72000000

# enable pinctrl
CONFIG_PINCTRL=y

# enable GPIO
CONFIG_GPIO=y

# clock configuration
CONFIG_CLOCK_CONTROL=y

CONFIG_ZMK_USB=y
```

## app/boards/pierrechevalier83/ferris/Kconfig.ferris
```kconfig
# Ferris board configuration

# Copyright (c) 2020 The ZMK Contributors
# SPDX-License-Identifier: MIT

config BOARD_FERRIS
    select SOC_STM32F072XB
    imply RETAINED_MEM
    imply RETENTION
    imply RETENTION_BOOT_MODE
    imply STM32_BOOTLOADER
    imply RTC
    imply BBRAM
```

## app/boards/pierrechevalier83/ferris/board.yml
```yaml
board:
  name: ferris
  full_name: Ferris
  vendor: pierrechevalier83
  socs:
    - name: stm32f072xb
      variants:
        - name: zmk
```

## app/boards/polarityworks/bt60/Kconfig.bt60_hs
```kconfig
# BT60 HS board configuration

# Copyright (c) 2022 The ZMK Contributors
# SPDX-License-Identifier: MIT

config BOARD_BT60_HS
    select SOC_NRF52840_QIAA
```

## app/boards/polarityworks/bt60/Kconfig.defconfig
```kconfig
# Copyright (c) 2022 The ZMK Contributors
# SPDX-License-Identifier: MIT

config ZMK_KEYBOARD_NAME
    default "BT60" if BOARD_BT60

if BOARD_BT60

if USB

config USB_NRFX
    default y

config USB_DEVICE_STACK
    default y

endif # USB

config BT_CTLR
    default BT

endif # BOARD_BT60
```

## app/boards/polarityworks/bt60/board.yml
```yaml
boards:
  - name: bt60_hs
    vendor: polarityworks
    socs:
      - name: nrf52840
        variants:
          - name: zmk
  - name: bt60
    vendor: polarityworks
    socs:
      - name: nrf52840
        variants:
          - name: zmk
    revision:
      format: major.minor.patch
      default: 2.0.0
      revisions:
        - name: 1.0.0
        - name: 2.0.0
```

## app/boards/polarityworks/bt65/Kconfig.bt65
```kconfig
# CKP BT65 board configuration

# Copyright (c) 2022 The ZMK Contributors
# SPDX-License-Identifier: MIT

config BOARD_BT65
    select SOC_NRF52840_QIAA
    select ZMK_BOARD_COMPAT
    imply RETAINED_MEM
    imply RETENTION
    imply RETENTION_BOOT_MODE
```

## app/boards/polarityworks/bt65/Kconfig.defconfig
```kconfig
# Copyright (c) 2022 The ZMK Contributors
# SPDX-License-Identifier: MIT

config ZMK_KEYBOARD_NAME
    default "BT65" if BOARD_BT65

if BOARD_BT65

if USB

config USB_NRFX
    default y

config USB_DEVICE_STACK
    default y

endif # USB

config BT_CTLR
    default BT

endif # BOARD_BT65
```

## app/boards/polarityworks/bt65/board.yml
```yaml
board:
  name: bt65
  full_name: BT65
  vendor: polarityworks
  socs:
    - name: nrf52840
      variants:
        - name: zmk
```

## app/boards/polarityworks/bt75/Kconfig.bt75
```kconfig
# CKP BT75 board configuration

# Copyright (c) 2022 The ZMK Contributors
# SPDX-License-Identifier: MIT

config BOARD_BT75
    select SOC_NRF52840_QIAA
    imply RETAINED_MEM
    imply RETENTION
    imply RETENTION_BOOT_MODE
```

## app/boards/polarityworks/bt75/Kconfig.defconfig
```kconfig
# Copyright (c) 2022 The ZMK Contributors
# SPDX-License-Identifier: MIT

config ZMK_KEYBOARD_NAME
    default "BT75" if BOARD_BT75

if BOARD_BT75

if USB

config USB_NRFX
    default y

config USB_DEVICE_STACK
    default y

endif # USB

config BT_CTLR
    default BT

endif # BOARD_BT75
```

## app/boards/polarityworks/bt75/board.yml
```yaml
board:
  name: bt75
  vendor: polarityworks
  socs:
    - name: nrf52840
      variants:
        - name: zmk
```

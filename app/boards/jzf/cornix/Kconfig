## app/boards/jzf/cornix/Kconfig
```kconfig
config BOARD_ENABLE_DCDC
    bool "Enable DCDC mode"
    select SOC_DCDC_NRF52X
    default n
    depends on ( BOARD_CORNIX_LEFT || BOARD_CORNIX_RIGHT || BOARD_CORNIX_PH_LEFT ) && SOC_SERIES_NRF52X

config BOARD_CORNIX_CHARGER
    bool "Enable battery charger"
    default y
    depends on ( BOARD_CORNIX_LEFT || BOARD_CORNIX_RIGHT || BOARD_CORNIX_PH_LEFT )
```

## app/boards/jzf/cornix/Kconfig.cornix_ph_left
```kconfig
# cornix_ph_left board configuration

# Copyright (c) 2020 The ZMK Contributors
# SPDX-License-Identifier: MIT

config BOARD_CORNIX_PH_LEFT
    select SOC_SERIES_NRF52X
    select SOC_NRF52840_QIAA
    imply RETAINED_MEM
    imply RETENTION
    imply RETENTION_BOOT_MODE
```

## app/boards/jzf/cornix/Kconfig.defconfig
```kconfig
# cornix board configuration

# Copyright (c) 2020 The ZMK Contributors
# SPDX-License-Identifier: MIT

## Main device (left side)
if BOARD_CORNIX_LEFT

config ZMK_KEYBOARD_NAME
	default "Cornix"

if USB

config USB_NRFX
    default y

config USB_DEVICE_STACK
    default y

endif # USB
config ZMK_SPLIT_ROLE_CENTRAL
    default y

config ZMK_SPLIT_BLE_ROLE_CENTRAL
	default y

config ZMK_SPLIT_BLE_CENTRAL_BATTERY_LEVEL_FETCHING
	default y

config ZMK_SPLIT_BLE_CENTRAL_BATTERY_LEVEL_PROXY
	default y

endif # BOARD_CORNIX_LEFT

## Peripheral device (right side)
if BOARD_CORNIX_RIGHT || BOARD_CORNIX_PH_LEFT

config ZMK_SPLIT_ROLE_CENTRAL
    default n

config ZMK_SPLIT_BLE_ROLE_CENTRAL
	default n

# Add keyboard debouncing
config ZMK_KSCAN_DEBOUNCE_PRESS_MS
    default 3
config ZMK_KSCAN_DEBOUNCE_RELEASE_MS
    default 3

endif # BOARD_CORNIX_RIGHT

# Common options for both sides
if BOARD_CORNIX_LEFT  || BOARD_CORNIX_PH_LEFT || BOARD_CORNIX_RIGHT


#config BT_CTLR
#    default BT

config BOARD_CORNIX_CHARGER
    default y

config ZMK_SPLIT
	default y

config ZMK_BLE
	default y

## disable rgb by default
config ZMK_RGB_UNDERGLOW
	default n
config ZMK_RGB_UNDERGLOW_EXT_POWER
	default n
    

endif # BOARD_CORNIX_LEFT || BOARD_CORNIX_RIGHT
# vim: set ft=kconfig:
```

## app/boards/jzf/cornix/board.yml
```yaml
boards:
  - name: cornix_left
    vendor: jzf
    revision:
      format: major.minor.patch
      default: 1.0.0
      revisions:
        - name: 1.0.0
  - name: cornix_right
    vendor: jzf
    revision:
      format: major.minor.patch
      default: 1.0.0
      revisions:
        - name: 1.0.0
  - name: cornix_ph_left
    vendor: jzf
    revision:
      format: major.minor.patch
      default: 1.0.0
      revisions:
        - name: 1.0.0
```

## app/boards/jzf/cornix/cornix_dongle_defconfig
```kconfig
# 更改键盘默认显示名称
CONFIG_ZMK_KEYBOARD_NAME="Cornix Dongle"

CONFIG_ZMK_DISPLAY=y

CONFIG_ZMK_USB=y
CONFIG_ZMK_SPLIT=y
CONFIG_ZMK_SPLIT_ROLE_CENTRAL=y

CONFIG_ZMK_BATTERY_REPORT_INTERVAL=60

CONFIG_PINCTRL=y
# enable display drivers

CONFIG_BT_CTLR_TX_PWR_PLUS_8=y

#BLE-passkey
CONFIG_ZMK_BLE_PASSKEY_ENTRY=n

#BLE-clean
CONFIG_ZMK_BLE_CLEAR_BONDS_ON_START=n

CONFIG_ZMK_HID_REPORT_TYPE_NKRO=n

CONFIG_ZMK_POINTING=y

# 3 profiles (n+2)
CONFIG_BT_MAX_CONN=7
CONFIG_BT_MAX_PAIRED=7

CONFIG_ZMK_SPLIT_BLE_CENTRAL_BATTERY_LEVEL_PROXY=y
CONFIG_ZMK_SPLIT_BLE_CENTRAL_BATTERY_LEVEL_FETCHING=y

# dongle mode
CONFIG_ZMK_SPLIT_BLE_CENTRAL_PERIPHERALS=2

CONFIG_BT_BAS=y

CONFIG_ZMK_BACKLIGHT=n

# zmk studio相关配置
CONFIG_ZMK_STUDIO=y
CONFIG_ZMK_STUDIO_LOCKING=n
CONFIG_ZMK_STUDIO_LOCK_ON_DISCONNECT=n
```

## app/boards/jzf/cornix/cornix_left_defconfig
```kconfig
# e73 config

CONFIG_ADC_NRFX_SAADC=y

# Enable MPU
CONFIG_ARM_MPU=y

CONFIG_PINCTRL=y

# enable GPIO
CONFIG_GPIO=y

CONFIG_USE_DT_CODE_PARTITION=y
CONFIG_BUILD_OUTPUT_UF2=y

CONFIG_MPU_ALLOW_FLASH_WRITE=y

CONFIG_NVS=y
CONFIG_SETTINGS_NVS=y

CONFIG_FLASH=y
CONFIG_FLASH_PAGE_LAYOUT=y
CONFIG_FLASH_MAP=y

CONFIG_CLOCK_CONTROL_NRF=y
CONFIG_CLOCK_CONTROL_NRF_K32SRC_RC=y

# e73 config end

CONFIG_ZMK_KEYBOARD_NAME="Cornix"
CONFIG_ZMK_USB=y
CONFIG_ZMK_SPLIT=y
CONFIG_ZMK_SPLIT_ROLE_CENTRAL=y

# 增加键盘的 BLE 无线电的发射功率，用解决延迟和左右通讯不佳的问题
CONFIG_BT_CTLR_TX_PWR_PLUS_8=y
# 更改键盘默认显示名称

# 电池电量报告间隔时间单位是秒
CONFIG_ZMK_BATTERY_REPORT_INTERVAL=60

CONFIG_PINCTRL=y

# RGB
CONFIG_SPI=n

CONFIG_EC11=y
CONFIG_EC11_TRIGGER_GLOBAL_THREAD=y

# enable display drivers
CONFIG_ZMK_DISPLAY=n

#BLE-passkey
CONFIG_ZMK_BLE_PASSKEY_ENTRY=n

#BLE-clean
CONFIG_ZMK_BLE_CLEAR_BONDS_ON_START=n

CONFIG_ZMK_HID_REPORT_TYPE_NKRO=n

CONFIG_ZMK_POINTING=y

# 3 profiles (n+2)
CONFIG_BT_MAX_CONN=6
CONFIG_BT_MAX_PAIRED=6

CONFIG_ZMK_SPLIT_BLE_CENTRAL_BATTERY_LEVEL_PROXY=y
CONFIG_ZMK_SPLIT_BLE_CENTRAL_BATTERY_LEVEL_FETCHING=y

# zmk studio相关配置
CONFIG_ZMK_STUDIO=y
CONFIG_ZMK_STUDIO_LOCKING=n
CONFIG_ZMK_STUDIO_LOCK_ON_DISCONNECT=n
```

## app/boards/jzf/cornix/cornix_ph_left_defconfig
```kconfig
# e73 config

CONFIG_ADC_NRFX_SAADC=y

# Enable MPU
CONFIG_ARM_MPU=y

CONFIG_PINCTRL=y

# enable GPIO
CONFIG_GPIO=y

CONFIG_USE_DT_CODE_PARTITION=y
CONFIG_BUILD_OUTPUT_UF2=y

CONFIG_MPU_ALLOW_FLASH_WRITE=y
CONFIG_NVS=y
CONFIG_SETTINGS_NVS=y
CONFIG_FLASH=y
CONFIG_FLASH_PAGE_LAYOUT=y
CONFIG_FLASH_MAP=y
CONFIG_CLOCK_CONTROL_NRF=y
CONFIG_CLOCK_CONTROL_NRF_K32SRC_RC=y

# e73 config end

CONFIG_ZMK_SPLIT=y


CONFIG_ZMK_STUDIO=n


# RGB
CONFIG_SPI=n

CONFIG_EC11=y
CONFIG_EC11_TRIGGER_GLOBAL_THREAD=y

# vim: set ft=kconfig:
```

## app/boards/jzf/cornix/cornix_right_defconfig
```kconfig
# SPDX-License-Identifier: MIT

CONFIG_ADC_NRFX_SAADC=y

# Enable MPU
CONFIG_ARM_MPU=y

# Use pinctrl
CONFIG_PINCTRL=y

# enable GPIO
CONFIG_GPIO=y

CONFIG_USE_DT_CODE_PARTITION=y
CONFIG_BUILD_OUTPUT_UF2=y

CONFIG_MPU_ALLOW_FLASH_WRITE=y
CONFIG_NVS=y
CONFIG_SETTINGS_NVS=y
CONFIG_FLASH=y
CONFIG_FLASH_PAGE_LAYOUT=y
CONFIG_FLASH_MAP=y
CONFIG_CLOCK_CONTROL_NRF=y
CONFIG_CLOCK_CONTROL_NRF_K32SRC_RC=y

CONFIG_ZMK_SPLIT=y
CONFIG_ZMK_STUDIO=n

# CONFIG_ZMK_BLE=y

# never output usb
# CONFIG_ZMK_USB=n
# CONFIG_INPUT=y

# RGB
CONFIG_SPI=n
# CONFIG_ZMK_EXT_POWER=n

CONFIG_EC11=y
CONFIG_EC11_TRIGGER_GLOBAL_THREAD=y

# vim: set ft=kconfig:
```

## app/boards/kbdfans/tofu65/Kconfig.defconfig
```kconfig
# Copyright (c) 2023 The ZMK Contributors
# SPDX-License-Identifier: MIT

if BOARD_TOFU65

config ZMK_KEYBOARD_NAME
    default "kbdfans tofu65"

config RP2_FLASH_W25Q080
    default y

endif # BOARD_TOFU65
```

## app/boards/kbdfans/tofu65/Kconfig.tofu65
```kconfig
# Copyright (c) 2023 The ZMK Contributors
# SPDX-License-Identifier: Apache-2.0

config BOARD_TOFU65
    select SOC_RP2040
    select ZMK_BOARD_COMPAT
    imply RETAINED_MEM
    imply RETENTION
    imply RETENTION_BOOT_MODE
```

## app/boards/kbdfans/tofu65/board.yml
```yaml
board:
  name: tofu65
  full_name: Tofu 65
  vendor: kbdfans
  socs:
    - name: rp2040
      variants:
        - name: zmk
```

## app/boards/keebio/bdn9/Kconfig.bdn9
```kconfig
# Copyright (c) 2020 Pete Johanson
# SPDX-License-Identifier: Apache-2.0

config BOARD_BDN9
    select SOC_STM32F072XB
```

## app/boards/keebio/bdn9/Kconfig.defconfig
```kconfig
# keeb.io BDN9 board configuration

# Copyright (c) 2020 The ZMK Contributors
# SPDX-License-Identifier: MIT

if BOARD_BDN9

config BOARD
    default "bdn9_rev2"

config ZMK_KEYBOARD_NAME
    default "BDN9 Rev2"

config ZMK_RGB_UNDERGLOW
    select SPI
    select WS2812_STRIP

endif # BOARD_BDN9
```

## app/boards/keebio/bdn9/board.yml
```yaml
board:
  name: bdn9
  vendor: keebio
  socs:
    - name: stm32f072xb
  revision:
    format: major.minor.patch
    default: 2.0.0
    revisions:
      - name: 2.0.0
```

## app/boards/keycapsss/puchi_ble/Kconfig.defconfig
```kconfig
# Copyright (c) 2022 The ZMK Contributors
# SPDX-License-Identifier: MIT

if BOARD_PUCHI_BLE

if USB_DEVICE_STACK

config USB_NRFX
    default y

endif # USB_DEVICE_STACK

endif # BOARD_PUCHI_BLE
```

## app/boards/keycapsss/puchi_ble/board.yml
```yaml
board:
  extend: puchi_ble
  variants:
    - name: zmk
      qualifier: nrf52840
```

## app/boards/kinesis/adv360pro/Kconfig.adv360pro_left
```kconfig
#
# Copyright (c) 2023 The ZMK Contributors
# SPDX-License-Identifier: MIT
#

config BOARD_ADV360PRO_LEFT
    select SOC_NRF52840_QIAA
    imply RETAINED_MEM
    imply RETENTION
    imply RETENTION_BOOT_MODE
```

## app/boards/kinesis/adv360pro/Kconfig.adv360pro_right
```kconfig
#
# Copyright (c) 2023 The ZMK Contributors
# SPDX-License-Identifier: MIT
#

config BOARD_ADV360PRO_RIGHT
    select SOC_NRF52840_QIAA
    select ZMK_BOARD_COMPAT
    imply RETAINED_MEM
    imply RETENTION
    imply RETENTION_BOOT_MODE
```

## app/boards/kinesis/adv360pro/Kconfig.defconfig
```kconfig
#
# Copyright (c) 2023 The ZMK Contributors
# SPDX-License-Identifier: MIT
#

if BOARD_ADV360PRO_LEFT

config ZMK_KEYBOARD_NAME
    default "Adv360 Pro"

config ZMK_SPLIT_ROLE_CENTRAL
    default y

endif # BOARD_ADV360PRO_LEFT

if BOARD_ADV360PRO_RIGHT

config ZMK_KEYBOARD_NAME
    default "Adv360 Pro rt"

endif # BOARD_ADV360PRO_RIGHT


if BOARD_ADV360PRO_LEFT || BOARD_ADV360PRO_RIGHT

config BOARD
    default "adv360pro"

config ZMK_SPLIT
    default y

config SPI
    bool
    default y

config BT_CTLR
    default BT

if USB

config USB_NRFX
    default y

config USB_DEVICE_STACK
    default y

endif # USB

config ZMK_BATTERY_VOLTAGE_DIVIDER
    default y

config SPI
    default y

endif # BOARD_ADV360PRO_LEFT || BOARD_ADV360PRO_RIGHT
```

## app/boards/kinesis/adv360pro/board.yml
```yaml
boards:
  - name: adv360pro_left
    vendor: kinesis
    socs:
      - name: nrf52840
        variants:
          - name: zmk
  - name: adv360pro_right
    vendor: kinesis
    socs:
      - name: nrf52840
        variants:
          - name: zmk
```

## app/boards/lowprokb/corneish_zen/Kconfig.corneish_zen_left
```kconfig
#
# Copyright (c) 2022 Darryl deHaan
# SPDX-License-Identifier: MIT
#

config BOARD_CORNEISH_ZEN_LEFT
    select SOC_NRF52840_QIAA
    imply RETAINED_MEM
    imply RETENTION
    imply RETENTION_BOOT_MODE
```

## app/boards/lowprokb/corneish_zen/Kconfig.corneish_zen_right
```kconfig
#
# Copyright (c) 2022 Darryl deHaan
# SPDX-License-Identifier: MIT
#

config BOARD_CORNEISH_ZEN_RIGHT
    select SOC_NRF52840_QIAA
```

## app/boards/lowprokb/corneish_zen/board.yml
```yaml
boards:
  - name: corneish_zen_left
    vendor: lowprokb
    socs:
      - name: nrf52840
        variants:
          - name: zmk
    revision:
      format: major.minor.patch
      default: 2.0.0
      exact: false
      revisions:
        - name: 2.0.0
        - name: 1.0.0
  - name: corneish_zen_right
    vendor: lowprokb
    socs:
      - name: nrf52840
        variants:
          - name: zmk
    revision:
      format: major.minor.patch
      default: 2.0.0
      exact: false
      revisions:
        - name: 2.0.0
        - name: 1.0.0
```

## app/boards/makerdiary/nrf52840_m2/Kconfig.defconfig
```kconfig
# Copyright (c) 2020 The ZMK Contributors
# SPDX-License-Identifier: MIT

if BOARD_NRF52840_M2

if USB_DEVICE_STACK

config USB_NRFX
    default y

endif # USB_DEVICE_STACK

config BT_CTLR
    default BT

if ZMK_BACKLIGHT

config PWM
    default y

config LED_PWM
    default y

endif # ZMK_BACKLIGHT

endif # BOARD_NRF52840_M2
```

## app/boards/makerdiary/nrf52840_m2/Kconfig.nrf52840_m2
```kconfig
# Copyright (c) 2020 The ZMK Contributors
# SPDX-License-Identifier: Apache-2.0

config BOARD_NRF52840_M2
    select SOC_NRF52840_QIAA
    imply RETAINED_MEM if BOARD_NRF52840_M2_NRF52840_ZMK
    imply RETENTION if BOARD_NRF52840_M2_NRF52840_ZMK
    imply RETENTION_BOOT_MODE if BOARD_NRF52840_M2_NRF52840_ZMK
```

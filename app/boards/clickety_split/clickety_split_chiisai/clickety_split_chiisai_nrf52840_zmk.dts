/*
 * Copyright (c) 2025 Clickety Split Ltd.
 * SPDX-License-Identifier: MIT
 */

/dts-v1/;

#include <../boards/clickety_split/clickety_split_chiisai/clickety_split_chiisai.dts>
#include <common/nordic/nrf52840_uf2_boot_mode.dtsi>

/ {
    chosen {
        zmk,battery = &vbatt;
    };

    EXT_POWER {
        compatible = "zmk,ext-power-generic";
        control-gpios = <&gpio0 6 GPIO_ACTIVE_HIGH>;
        init-delay-ms = <50>;
    };

    vbatt: vbatt {
        compatible = "zmk,battery-nrf-vddh";
    };
};

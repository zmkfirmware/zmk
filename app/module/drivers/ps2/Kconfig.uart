## app/module/dts/bindings/input/zmk,input-mouse-ps2.yaml
```yaml
description: PS2 mouse configuration

compatible: "zmk,input-mouse-ps2"

properties:
  ps2-device:
    type: phandle
    required: true
    description: |
      The ps2 device the mouse should use.

  rst-gpios:
    type: phandle-array
    required: false
    description: GPIO to which the RST pin of the device is connected and on which the Power-On-Reset will be performed.

  sampling-rate:
    type: int
    description: Adjusts the sensitivity setting on trackpoint devices. The allowed values are 10, 20, 40, 60, 80, 100, 200 and the default is 100.
    enum:
      - 10
      - 20
      - 40
      - 60
      - 80
      - 100
      - 200

  scroll-mode:
    type: boolean
    description: Enables scroll wheel on mouse devices supporting the Intellimouse extension.

  disable-clicking:
    type: boolean
    description: Disables clicking. Useful when using a PS2 driver that is prone to erros in transmissions to reduce accidental clicks.

  tp-press-to-select:
    type: boolean
    description: Enables mouse clicking by pressing hard on the trackpoint. Not all trackpoints support this feature.

  tp-press-to-select-threshold:
    type: int
    description: Adjusts how sensitive the press-to-select feature is. The range is 0 - 255 and the default is 8. You can also adjust this setting at runtime without recompiling using the &mms behavior. If this setting is enabled, then the runtime behavior won't be saved into the runtime settings.

  tp-sensitivity:
    type: int
    description: Adjusts the sensitivity setting on trackpoint devices. The range is 0 - 255 and the default is 128. You can also adjust this setting at runtime without recompiling using the &mms behavior. If this setting is enabled, then the runtime behavior won't be saved into the runtime settings.

  tp-neg-inertia:
    type: int
    description: Adjusts the negative inertia setting on trackpoint devices. The range is 0 - 255 and the default is 6. You can also adjust this setting at runtime without recompiling using the &mms behavior. If this setting is enabled, then the runtime behavior won't be saved into the runtime settings.

  tp-val6-upper-speed:
    type: int
    description: Adjusts the negative value0 upper plateau speed setting on trackpoint devices. The range is 0 - 255 and the default is 97. You can also adjust this setting at runtime without recompiling using the &mms behavior. If this setting is enabled, then the runtime behavior won't be saved into the runtime settings.

  tp-x-invert:
    type: boolean
    description: Enables x axis inversion on the trackpoint. Only works with some trackpoint devices, but is properly considered by the trackpoint's acceleration features (which may or may not have an impact). Alternatively consider achieving the same effect using the `zmk,input-configs` feature.

  tp-y-invert:
    type: boolean
    description: Enables y axis inversion on the trackpoint. Only works with some trackpoint devices, but is properly considered by the trackpoint's acceleration features (which may or may not have an impact). Alternatively consider achieving the same effect using the `zmk,input-configs` feature.

  tp-xy-swap:
    type: boolean
    description: Swaps the x and y axis on the trackpoint. Only works with some trackpoint devices, but may properly considered by the trackpoint's acceleration features (which may or may not have an impact). Alternatively consider achieving the same effect using the `zmk,input-configs` feature.

  layer-toggle:
    type: int
    required: false
    description: The layer that should be toggled when the mouse is moved.
```

## app/module/dts/bindings/kscan/zmk,kscan-595a.yaml
```yaml
# Copyright (c) 2024 The ZMK Contributors
# SPDX-License-Identifier: MIT

description: |
  ZMK kscan driver for 74HC595A shift register based key matrices.
  Uses GPIO bit-banging for shift register control.
  Compatible with luo_nice60 board interface.

compatible: "zmk,kscan-595a"

include: kscan.yaml

properties:
  hc595a-ser-gpios:
    type: phandle-array
    required: true
    description: GPIO pin for 74HC595A serial data input (SER/DS)

  hc595a-sck-gpios:
    type: phandle-array
    required: true
    description: GPIO pin for 74HC595A shift clock (SRCLK/SHCP)

  key-sense-gpios:
    type: phandle-array
    required: true
    description: GPIO pin to read key state (directly connected to all keys)

  hc595a-count:
    type: int
    required: true
    description: Number of 74HC595A shift registers in the chain
```

## app/module/dts/bindings/kscan/zmk,kscan-gpio-charlieplex.yaml
```yaml
# Copyright (c) 2023 The ZMK Contributors
# SPDX-License-Identifier: MIT

description: GPIO keyboard charlieplex matrix controller

compatible: "zmk,kscan-gpio-charlieplex"

include: kscan.yaml

properties:
  gpios:
    type: phandle-array
    required: true
  interrupt-gpios:
    type: phandle-array
  debounce-press-ms:
    type: int
    default: 5
    description: Debounce time for key press in milliseconds. Use 0 for eager debouncing.
  debounce-release-ms:
    type: int
    default: 5
    description: Debounce time for key release in milliseconds.
  debounce-scan-period-ms:
    type: int
    default: 1
    description: Time between reads in milliseconds when any key is pressed.
  poll-period-ms:
    type: int
    default: 1
    description: Time between reads in milliseconds
```

## app/module/dts/bindings/kscan/zmk,kscan-gpio-demux.yaml
```yaml
# Copyright (c) 2020, The ZMK Contributors
# SPDX-License-Identifier: MIT

description: GPIO keyboard demux controller

compatible: "zmk,kscan-gpio-demux"

include: kscan.yaml

properties:
  input-gpios:
    type: phandle-array
    required: true
  output-gpios:
    type: phandle-array
    required: true
  debounce-period:
    type: int
    default: 5
  polling-interval-msec:
    type: int
    default: 25
```

## app/module/dts/bindings/kscan/zmk,kscan-gpio-direct.yaml
```yaml
# Copyright (c) 2020, Pete Johanson
# SPDX-License-Identifier: MIT

description: Direct GPIO keyboard KSCAN controller

compatible: "zmk,kscan-gpio-direct"

include: kscan.yaml

properties:
  input-gpios:
    type: phandle-array
    required: true
  debounce-period:
    type: int
    required: false
    deprecated: true
    description: Deprecated. Use debounce-press-ms and debounce-release-ms instead.
  debounce-press-ms:
    type: int
    default: 5
    description: Debounce time for key press in milliseconds. Use 0 for eager debouncing.
  debounce-release-ms:
    type: int
    default: 5
    description: Debounce time for key release in milliseconds.
  debounce-scan-period-ms:
    type: int
    default: 1
    description: Time between reads in milliseconds when any key is pressed.
  poll-period-ms:
    type: int
    default: 10
    description: Time between reads in milliseconds when no key is pressed and ZMK_KSCAN_DIRECT_POLLING is enabled.
  toggle-mode:
    type: boolean
    description: Enable toggle-switch mode.
```

## app/module/dts/bindings/kscan/zmk,kscan-gpio-matrix.yaml
```yaml
# Copyright (c) 2020, Pete Johanson
# SPDX-License-Identifier: MIT

description: GPIO keyboard matrix controller

compatible: "zmk,kscan-gpio-matrix"

include: kscan.yaml

properties:
  row-gpios:
    type: phandle-array
    required: true
  col-gpios:
    type: phandle-array
    required: true
  debounce-period:
    type: int
    required: false
    deprecated: true
    description: Deprecated. Use debounce-press-ms and debounce-release-ms instead.
  debounce-press-ms:
    type: int
    default: 5
    description: Debounce time for key press in milliseconds. Use 0 for eager debouncing.
  debounce-release-ms:
    type: int
    default: 5
    description: Debounce time for key release in milliseconds.
  debounce-scan-period-ms:
    type: int
    default: 1
    description: Time between reads in milliseconds when any key is pressed.
  poll-period-ms:
    type: int
    default: 10
    description: Time between reads in milliseconds when no key is pressed and ZMK_KSCAN_MATRIX_POLLING is enabled.
  diode-direction:
    type: string
    default: row2col
    enum:
      - row2col
      - col2row
```

## app/module/dts/bindings/led/zmk,led-map.yaml
```yaml
description: LED map for per-key RGB and underglow

compatible: "zmk,led-map"

properties:
  led-strip:
    type: phandle
    required: true
  caps-lock-led-index:
    type: int
  bt-status-led-index:
    type: int
  layer-status-led-index:
    type: int
```

## app/module/dts/bindings/led_strip/issi,is31fl3743a.yaml
```yaml
description: |
  Driver for the IS31FL3743A LED matrix driver

compatible: "issi,issi_is31fl3743a"

include: i2c-device.yaml
```

## app/module/dts/bindings/ps2/gpio-ps2.yaml
```yaml
# Copyright (c) 2019, Intel Corporation
# SPDX-License-Identifier: Apache-2.0

description: GPIO PS2

compatible: "gpio-ps2"

include: base.yaml

properties:
    scl-gpios:
      type: phandle-array
      required: true
      description: GPIO to which the SCL pin of the I2C bus is connected.
    sda-gpios:
      type: phandle-array
      required: true
      description: GPIO to which the SDA pin of the I2C bus is connected.
```

## app/module/dts/bindings/ps2/uart-ps2.yaml
```yaml
# Copyright (c) 2019, Intel Corporation
# SPDX-License-Identifier: Apache-2.0

description: GPIO PS2

compatible: "uart-ps2"

include: base.yaml

properties:
    scl-gpios:
      type: phandle-array
      required: true
      description: GPIO to which the SCL pin is connected.
    sda-gpios:
      type: phandle-array
      required: true
      description: GPIO to which the SDA pin is connected.
```

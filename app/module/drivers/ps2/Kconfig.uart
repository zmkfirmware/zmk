## app/module/drivers/ps2/Kconfig.uart
```kconfig
# Copyright (c) 2017 Linaro Ltd.
# SPDX-License-Identifier: Apache-2.0

DT_COMPAT_PS2_UART := uart-ps2

config PS2_UART
	bool "GPIO bit banging PS/2 support through UART"
	default $(dt_compat_enabled,$(DT_COMPAT_PS2_UART))
	select SERIAL
	select UART_ASYNC_API
	select UART_USE_RUNTIME_CONFIGURE
	help
	  Enable software driven (bit banging) PS/2 support using UART on GPIO pins

if PS2_UART

config PS2_UART_WRITE_MODE_BLOCKING
	bool "Don't use interrupts for writing data and instead block using timers."
	default n

config PS2_UART_ENABLE_PS2_RESEND_CALLBACK
	bool "Notify the PS2 device driver (mouse driver) when the received data is invalid and a resend is requested from the peripheral. This can help the higher level PS2 device driver handle transmission errors with less side-effects, but it requires a forked zephyr. With the ps2-uart driver this option is not really necessary, but is very useful for the ps2-gpio driver."
	default n
	select ZMK_INPUT_MOUSE_PS2_ENABLE_PS2_RESEND_CALLBACK

# PM_DEVICE is needed, because we use GPIO bitbanging for writing. And to
# release the data PIN that is used by the UART device, we use pinctrl to
# switch to the sleep state. But the sleep state is only included if PM_DEVICE
# is enabled.
config PM_DEVICE
	default y

# PS/2 events must be processed within 30-50us. Therefore we shift the
# BT_CTLR_LLL_PRIO from 0 to 1 and BT_CTLR_ULL_* priorities from 1 to 2.
# We then set the gpio priority to 0.
#
# The following also has to be added to the device tree to set GPIOTE to the
# highest priority:
# &gpiote {
# 	interrupts = < 0x6 0 >;
# };
#
# On top of that all other interrupts have to be set to priority 3 to prevent
# them from delaying the BT interrupts.
#
# Overrides can be generated using the following script in infused-kim's zmk
# fork:
# app/scripts/gen_interrupt_priority_overrides.py
#
# Make sure to do it on a zephyr.dts where the interrupts have not been
# adjusted yet (i.e. a config that doesn't have the the following options
# enabled).
#
# If you are building using a toolchain you can find the zephyr.dts in the
# build directory, which by default is: `app/build/zephyr/zephyr.dts`
#
# If you are building using the github actions, copy the output of the build
# step `xxxx_right - nice_nano_v2 Devicetree file` into a file and run the
# script on it.
#
# This will increase the probability that the PS/2 interrupts are triggered in
# time.

config BT_CTLR_ADVANCED_FEATURES
	default y

config BT_CTLR_LLL_PRIO
	default 1

config BT_CTLR_ULL_HIGH_PRIO
	default 2

config BT_CTLR_ULL_LOW_PRIO
	default 2

endif # PS2_UART
```

## app/module/drivers/sensor/Kconfig
```kconfig
# Copyright (c) 2020 The ZMK Contributors
# SPDX-License-Identifier: MIT

if SENSOR

rsource "battery/Kconfig"
rsource "ec11/Kconfig"
rsource "max17048/Kconfig"

rsource "encoder_mock/Kconfig"

endif # SENSOR
```

## app/module/drivers/sensor/ec11/Kconfig
```kconfig
# Copyright (c) 2020 The ZMK Contributors
# SPDX-License-Identifier: MIT

menuconfig EC11
    bool "EC11 Incremental Encoder Sensor"
    default y
    depends on DT_HAS_ALPS_EC11_ENABLED
    depends on GPIO
    help
      Enable driver for EC11 incremental encoder sensors.

if EC11

choice
    prompt "Trigger mode"
    default EC11_TRIGGER_NONE
    help
      Specify the type of triggering to be used by the driver.

config EC11_TRIGGER_NONE
    bool "No trigger"

config EC11_TRIGGER_GLOBAL_THREAD
    bool "Use global thread"
    depends on GPIO
    select EC11_TRIGGER

config EC11_TRIGGER_OWN_THREAD
    bool "Use own thread"
    depends on GPIO
    select EC11_TRIGGER

endchoice

config EC11_TRIGGER
    bool

config EC11_THREAD_PRIORITY
    int "Thread priority"
    depends on EC11_TRIGGER_OWN_THREAD
    default 10
    help
      Priority of thread used by the driver to handle interrupts.

config EC11_THREAD_STACK_SIZE
    int "Thread stack size"
    depends on EC11_TRIGGER_OWN_THREAD
    default 1024
    help
      Stack size of thread used by the driver to handle interrupts.

endif # EC11
```

## app/module/drivers/sensor/encoder_mock/Kconfig
```kconfig
# Copyright (c) 2024 The ZMK Contributors
# SPDX-License-Identifier: MIT

config ZMK_SENSOR_ENCODER_MOCK
    bool "Mock Encoder Sensor"
    default y
    depends on DT_HAS_ZMK_SENSOR_ENCODER_MOCK_ENABLED
```

## app/module/drivers/sensor/joystick/Kconfig
```kconfig
# Copyright (c) 2020-2022 The ZMK Contributors
# SPDX-License-Identifier: MIT

menuconfig JOYSTICK
    bool "Joystick Sensor"
    help
      Enable driver for Joystick sensor

if JOYSTICK

config JOYSTICK_THB
    bool "THB001 joystick sensor"
    select ADC
    help
        Enable joystick driver for THB001 sensor from C-K switches

if JOYSTICK_THB

choice
    prompt "Trigger mode"
    default JOYSTICK_THB_TRIGGER_NONE
    help
      Type of trigger mode used by the driver.

config JOYSTICK_THB_TRIGGER_NONE
    bool "No trigger"

config JOYSTICK_THB_TRIGGER_SYSTEM_QUEUE
    bool "Use system queue for triggering"
    select JOYSTICK_THB_TRIGGER

config JOYSTICK_THB_TRIGGER_DEDICATED_QUEUE
    bool "Use a dedicated queue for triggering"
    select JOYSTICK_THB_TRIGGER

endchoice

config JOYSTICK_THB_TRIGGER
    bool

config THB_WORKQUEUE_PRIORITY
    int "Workqueue priority"
    depends on JOYSTICK_THB_TRIGGER_DEDICATED_QUEUE
    default 10
    help
      Priority of thread used by the workqueue

config THB_WORKQUEUE_STACK_SIZE
    int "Workqueue stack size"
    depends on JOYSTICK_THB_TRIGGER_DEDICATED_QUEUE
    default 1024
    help
      Stack size of thread used by the workqueue

endif # JOYSTICK_THB
endif # JOYSTICK
```

## app/module/drivers/sensor/max17048/Kconfig
```kconfig
# Copyright (c) 2022 The ZMK Contributors
# SPDX-License-Identifier: MIT

menuconfig ZMK_MAX17048
    bool "MAX17048/9 I2C-based Fuel Gauge"
    default y
    depends on DT_HAS_ZMK_MAXIM_MAX17048_ENABLED && I2C
    select ZMK_BATTERY
    help
      Enable driver for MAX17048/9 I2C-based Fuel Gauge. Supports measuring
      battery voltage and state-of-charge.

if ZMK_MAX17048

config SENSOR_MAX17048_INIT_PRIORITY
    int "Init priority"
    default 75
    help
      Device driver initialization priority.

endif #MAX17048
```

## app/module/dts/bindings/behaviors/zmk,behavior-led-map.yaml
```yaml
# Copyright (c) 2024 The ZMK Contributors
# SPDX-License-Identifier: MIT

description: Per-key LED Map Behavior

compatible: "zmk,behavior-led-map"

include: two_param.yaml
```

## app/module/dts/bindings/display/gooddisplay,il0323.yaml
```yaml
# Copyright (c) 2020, Phytec Messtechnik GmbH, Peter Johanson
# SPDX-License-Identifier: Apache-2.0

description: IL0323 EPD display controller

compatible: "gooddisplay,il0323"

include: spi-device.yaml

properties:
  height:
    type: int
    required: true
    description: Height in pixel of the panel driven by the controller

  width:
    type: int
    required: true
    description: Width in pixel of the panel driven by the controller

  reset-gpios:
    type: phandle-array
    required: true
    description: RESET pin.

      The RESET pin of GD7965 is active low.
      If connected directly the MCU pin should be configured
      as active low.

  dc-gpios:
    type: phandle-array
    required: true
    description: DC pin.

      The DC pin of GD7965 is active low (transmission command byte).
      If connected directly the MCU pin should be configured
      as active low.

  busy-gpios:
    type: phandle-array
    required: true
    description: BUSY pin.

      The BUSY pin of GD7965 is active low.
      If connected directly the MCU pin should be configured
      as active low.

  pwr:
    type: uint8-array
    required: true
    description: Power Setting (PWR) values

  cdi:
    type: int
    required: true
    description: VCOM and data interval value

  tcon:
    type: int
    required: true
    description: TCON setting value
```

## app/module/dts/bindings/display/jdi,lpm009m360a.yaml
```yaml
# Copyright (c) 2023 Taisheng WANG <wstrn66@gmail.com>
# SPDX-License-Identifier: Apache-2.0

description: LPM009M360A display controller

compatible: "jdi,lpm009m360a"

include: [spi-device.yaml, display-controller.yaml]

properties:
  extcomin_gpios:
    type: phandle-array
    description: COM Inversion Polarity Input pin.

  disp_gpios:
    type: phandle-array
    required: true
    description: Display ON/OFF Switching signal pin.

  color_mode:
    type: uint8-array
    default: [0x04]
```

## app/module/dts/bindings/gpio/zmk,gpio-595.yaml
```yaml
#
# Copyright (c) 2022 The ZMK Contributors
#
# SPDX-License-Identifier: MIT
#

description: >
  This is a representation of the 595 Shift Register.

compatible: "zmk,gpio-595"

include: [gpio-controller.yaml, spi-device.yaml]

properties:
  "#gpio-cells":
    const: 2

  ngpios:
    type: int
    required: true
    enum:
      - 8
      - 16
      - 24
      - 32
      - 40
      - 48
      - 56
      - 64
    description: Number of gpios supported (up to 8 daisy-chained shift registers)

gpio-cells:
  - pin
  - flags
```

## app/module/dts/bindings/gpio/zmk,gpio-demux.yaml
```yaml
#
# Copyright (c) 2026 The ZMK Contributors
#
# SPDX-License-Identifier: MIT
#

description: >
  This is a representation of a GPIO demultiplexer/demux

compatible: "zmk,gpio-demux"

include: [gpio-controller.yaml]

properties:
  select-gpios:
    type: phandle-array
    required: true

  en-gpios:
    type: phandle-array
  
  "#gpio-cells":
    const: 2

gpio-cells:
  - pin
  - flags
```

## app/module/dts/bindings/input/azoteq,iqs5xx-common.yaml
```yaml
properties:
  rdy-gpios:
    type: phandle-array
    required: true
    description: "Data Ready pin for the Azoteq IQS5xx trackpad"
  
  reset-gpios:
    type: phandle-array
    description: "Reset pin for the Azoteq IQS5xx trackpad"

  one-finger-tap:
    type: boolean
    description: "Register single finger tap gestures and report them as a left click"

  press-and-hold:
    type: boolean
    description: "Register press and hold gestures and report them as a left click until released"
  
  press-and-hold-time:
    type: int
    description: "Time in ms (in addition to the tap time) it takes to register a press and hold gesture"
    default: 250

  two-finger-tap:
    type: boolean
    description: "Register two finger tap gestures and report them as a right click"
  
  scroll:
    type: boolean
    description: "Register and report scroll gestures, both vertical and horizontal scroll is supported"

  natural-scroll-x:
    type: boolean
    description: "Whether content should track finger movement when scrolling on the x axis."

  natural-scroll-y:
    type: boolean
    description: "Whether content should track finger movement when scrolling on the y axis."

  switch-xy:
    type: boolean
    description: "Flip x and y axes"
  
  flip-x:
    type: boolean
    description: "Invert the direction of the x axis"

  flip-y:
    type: boolean
    description: "Invert the direction of the y axis"

  bottom-beta:
    type: int
    description: |
      Amount of filtering applied at slow speeds.
      0: Most filtering, smoother, but laggier.
      255: Least filtering, least smooth, more responsive.
    default: 5
  
  stationary-threshold:
    type: int
    description: |
      How far a finger must move (in pixels) to not be considered stationary.
    default: 5
```

## app/module/dts/bindings/input/azoteq,iqs5xx-i2c.yaml
```yaml
description: |
  Sensor driver for Azoteq IQS5XX trackpads, using the I2C interface

compatible: "azoteq,iqs5xx"

include: ["i2c-device.yaml", "azoteq,iqs5xx-common.yaml"]
```

## app/module/dts/bindings/input/cirque,pinnacle-common.yaml
```yaml
properties:
  dr-gpios:
    type: phandle-array
    description: Data ready pin for the trackpad
  rotate-90:
    type: boolean
  sleep:
    type: boolean
  no-taps:
    type: boolean
  sensitivity:
    type: string
    enum:
      - 1x
      - 2x
      - 3x
      - 4x
    description: ADC attenuation (sensitivity) setting.
```

## app/module/dts/bindings/input/zmk,input-mock.yaml
```yaml
# Copyright (c) 2024 The ZMK Contributors
# SPDX-License-Identifier: MIT

description: |
  Allows defining a mock input driver that simulates periodic input events.

compatible: "zmk,input-mock"

properties:
  event-startup-delay:
    type: int
    default: 0
    description: Milliseconds to delay before starting generating the events
  event-period:
    type: int
    description: Milliseconds between each generated event
  events:
    type: array
    description: List of tuples of (type, code, value, sync)
  exit-after:
    type: boolean
```

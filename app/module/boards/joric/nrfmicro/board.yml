## app/module/boards/joric/nrfmicro/board.yml
```yaml
board:
  name: nrfmicro
  vendor: joric
  socs:
    - name: nrf52840
      variants:
        - name: flipped
    - name: nrf52833
  revision:
    format: major.minor.patch
    default: 1.3.0
    revisions:
      - name: 1.3.0
      - name: 1.1.0
```

## app/module/boards/joric/nrfmicro/nrfmicro_nrf52840_1_3_0_defconfig
```kconfig
# SPDX-License-Identifier: MIT

# Enable MPU
CONFIG_ARM_MPU=y

CONFIG_PINCTRL=y

# enable GPIO
CONFIG_GPIO=y

CONFIG_USE_DT_CODE_PARTITION=y
CONFIG_BUILD_OUTPUT_UF2=y
```

## app/module/boards/jpconstantineau/bluemicro840/board.yml
```yaml
board:
  name: bluemicro840
  vendor: jpconstantineau
  socs:
    - name: nrf52840
```

## app/module/boards/keycapsss/puchi_ble/Kconfig.defconfig
```kconfig
# Copyright (c) 2026 The ZMK Contributors
# SPDX-License-Identifier: MIT

if BOARD_PUCHI_BLE

config BOARD
    default "puchi_ble"

if USB_DEVICE_STACK

config USB_NRFX
    default y

endif # USB_DEVICE_STACK

endif # BOARD_PUCHI_BLE
```

## app/module/boards/makerdiary/nrf52840_m2/Kconfig.defconfig
```kconfig
# Copyright (c) 2020 The ZMK Contributors
# SPDX-License-Identifier: MIT

if BOARD_NRF52840_M2

if USB_DEVICE_STACK

config USB_NRFX
    default y

endif # USB_DEVICE_STACK

endif # BOARD_NRF52840_M2
```

## app/module/boards/makerdiary/nrf52840_m2/board.yml
```yaml
board:
  name: nrf52840_m2
  full_name: MakerDiary nrf52840 M.2
  vendor: makerdiary
  socs:
    - name: nrf52840
```

## app/module/boards/makerdiary/nrf52840_m2/nrf52840_m2_defconfig
```kconfig
# Copyright (c) 2026 The ZMK Contributors
# SPDX-License-Identifier: MIT

# Enable MPU
CONFIG_ARM_MPU=y

# enable GPIO
CONFIG_GPIO=y

CONFIG_USE_DT_CODE_PARTITION=y
CONFIG_BUILD_OUTPUT_UF2=y
```

## app/module/boards/mechwild/pillbug/Kconfig.defconfig
```kconfig
# Copyright (c) 2022 The ZMK Contributors
# SPDX-License-Identifier: MIT

if BOARD_PILLBUG

if USB_DEVICE_STACK

config USB_NRFX
    default y

endif # USB_DEVICE_STACK

config BT_CTLR
    default BT

endif # BOARD_PILLBUG
```

## app/module/boards/mechwild/pillbug/Kconfig.pillbug
```kconfig
# Copyright (c) 2022 The ZMK Contributors
# SPDX-License-Identifier: Apache-2.0

config BOARD_PILLBUG
    select SOC_NRF52840_QIAA
    imply RETAINED_MEM
    imply RETENTION
    imply RETENTION_BOOT_MODE
```

## app/module/boards/nicekeyboards/nice_nano/Kconfig.nice_nano
```kconfig
# Copyright (c) 2026 The ZMK Contributors
# SPDX-License-Identifier: Apache-2.0

config BOARD_NICE_NANO
    select SOC_NRF52840_QIAA
```

## app/module/boards/qmk/proton_c/board.yml
```yaml
board:
  name: proton_c
  full_name: Proton-C
  vendor: qmk
  socs:
    - name: stm32f303xc
```

## app/module/boards/zhiayang/mikoto/Kconfig.mikoto
```kconfig
# Copyright (c) 2026 The ZMK Contributors
# SPDX-License-Identifier: Apache-2.0

config BOARD_MIKOTO
    select SOC_NRF52840_QIAA
```

## app/module/boards/zhiayang/mikoto/board.yml
```yaml
board:
  name: mikoto
  vendor: zhiayang
  revision:
    format: major.minor.patch
    default: 5.20.0
    exact: false
    revisions:
      - name: 5.20.0
      - name: 6.1.0
      - name: 6.3.0
      - name: 7.2.0
  socs:
    - name: nrf52840
```

## app/module/drivers/Kconfig
```kconfig
# Copyright (c) 2020 The ZMK Contributors
# SPDX-License-Identifier: MIT

rsource "gpio/Kconfig"
rsource "sensor/Kconfig"
rsource "display/Kconfig"
rsource "input/Kconfig"
```

## app/module/drivers/display/Kconfig
```kconfig
# Copyright (c) 2021 The ZMK Contributors
# SPDX-License-Identifier: MIT

if DISPLAY

rsource "Kconfig.il0323"
rsource "Kconfig.lpm009m360a"

endif # DISPLAY
```

## app/module/drivers/display/Kconfig.lpm009m360a
```kconfig
# LPM009M360A display driver configuration options

config LPM009M360A
    bool "LPM009M360A display driver"
    default n
    select SPI
    help
        Enable driver for LPM009M360A display driver.
```

## app/module/drivers/gpio/Kconfig
```kconfig
if GPIO

rsource "Kconfig.demux"
rsource "Kconfig.max7318"
rsource "Kconfig.595"

endif # GPIO
```

## app/module/drivers/gpio/Kconfig.595
```kconfig
# 595 GPIO configuration options

# Copyright (c) 2022 The ZMK Contributors
# SPDX-License-Identifier: MIT

DT_COMPAT_ZMK_GPIO_595 := zmk,gpio-595

menuconfig GPIO_595
    bool "595 Shift Register SPI driver"
    default $(dt_compat_enabled,$(DT_COMPAT_ZMK_GPIO_595))
    depends on SPI
    select HAS_DTS_GPIO
    help
      Enable driver for 595 shift register chip using SPI.

if GPIO_595

config GPIO_595_INIT_PRIORITY
    int "Init priority"
    default 75
    help
      Device driver initialization priority.

endif #GPIO_595
```

## app/module/drivers/gpio/Kconfig.demux
```kconfig
# Demux GPIO configuration options

# Copyright (c) 2026 The ZMK Contributors
# SPDX-License-Identifier: MIT

menuconfig GPIO_DEMUX
    bool "GPIO Demux Driver"
    default y
    depends on DT_HAS_ZMK_GPIO_DEMUX_ENABLED
    select HAS_DTS_GPIO
    help
      Enable driver for demux GPIO outputs.

if GPIO_DEMUX

config GPIO_DEMUX_INIT_PRIORITY
    int "Init priority"
    default 75
    help
      Device driver initialization priority.

endif #GPIO_DEMUX
```

## app/module/drivers/gpio/Kconfig.max7318
```kconfig
# MAX7318 GPIO configuration options

# Copyright (c) 2022 The ZMK Contributors
# SPDX-License-Identifier: MIT

DT_COMPAT_MAXIM_MAX7318 := maxim,max7318

menuconfig GPIO_MAX7318
    bool "MAX7318 I2C-based GPIO chip"
    default $(dt_compat_enabled,$(DT_COMPAT_MAXIM_MAX7318))
    depends on I2C
    select HAS_DTS_GPIO
    help
      Enable driver for MAX7318 I2C-based GPIO chip.

if GPIO_MAX7318

config GPIO_MAX7318_INIT_PRIORITY
    int "Init priority"
    default 75
    help
      Device driver initialization priority.

endif #GPIO_MAX7318
```

## app/module/drivers/led_strip/Kconfig.is31fl3743a
```kconfig
# Copyright (c) 2020 The ZMK Contributors
# SPDX-License-Identifier: MIT

config IS31FL3743A
    bool "IS31FL3743A LED matrix driver"
    depends on I2C
    depends on LED_STRIP
    help
        Enable an IS31FL3743A LED matrix driver.

            The IS31FL3743A is a general purpose 18xn(n=1-11) LED matrix
            programmed via 1MHz I2C compatible interface. Each LED can be
            dimmed individually with 8-bit PWM data and 8-bit DC scaling data
            which allows 256 steps of linear PWM dimming and 256 steps of DC
            current adjustable levels.
```

## app/module/drivers/ps2/Kconfig
```kconfig
# Copyright (c) 2023 The ZMK Contributors
# SPDX-License-Identifier: MIT

if PS2

rsource "Kconfig.gpio"
rsource "Kconfig.uart"

endif # PS2
```

## app/module/drivers/ps2/Kconfig.gpio
```kconfig
# Copyright (c) 2017 Linaro Ltd.
# SPDX-License-Identifier: Apache-2.0

DT_COMPAT_PS2_GPIO := gpio-ps2

config PS2_GPIO
	bool "GPIO bit banging PS/2 support"
	default $(dt_compat_enabled,$(DT_COMPAT_PS2_GPIO))
	help
	  Enable software driven (bit banging) PS/2 support using GPIO pins

if PS2_GPIO

config PS2_GPIO_ENABLE_PS2_RESEND_CALLBACK
	bool "Notify the PS2 device driver (mouse driver) when the received data is invalid and a resend is requested from the peripheral. This can help the higher level PS2 device driver handle transmission errors with less side-effects, but it requires a forked zephyr. With the ps2-uart driver this option is not really necessary, but is very useful for the ps2-gpio driver."
	default n
	select ZMK_INPUT_MOUSE_PS2_ENABLE_PS2_RESEND_CALLBACK

# PS/2 events must be processed within 30-50us. Therefore we shift the
# BT_CTLR_LLL_PRIO from 0 to 1 and BT_CTLR_ULL_* priorities from 1 to 2.
# We then set the gpio priority to 0.
#
# The following also has to be added to the device tree to set GPIOTE to the
# highest priority:
# &gpiote {
# 	interrupts = < 0x6 0 >;
# };
#
# On top of that all other interrupts have to be set to priority 3 to prevent
# them from delaying the BT interrupts.
#
# Overrides can be generated using the following script in infused-kim's zmk
# fork:
# app/scripts/gen_interrupt_priority_overrides.py
#
# Make sure to do it on a zephyr.dts where the interrupts have not been
# adjusted yet (i.e. a config that doesn't have the the following options
# enabled).
#
# If you are building using a toolchain you can find the zephyr.dts in the
# build directory, which by default is: `app/build/zephyr/zephyr.dts`
#
# If you are building using the github actions, copy the output of the build
# step `xxxx_right - nice_nano_v2 Devicetree file` into a file and run the
# script on it.
#
# This will increase the probability that the PS/2 interrupts are triggered in
# time.

config BT_CTLR_ADVANCED_FEATURES
	default y

config BT_CTLR_LLL_PRIO
	default 1

config BT_CTLR_ULL_HIGH_PRIO
	default 2

config BT_CTLR_ULL_LOW_PRIO
	default 2

config PS2_GPIO_INTERRUPT_LOG_ENABLED
	bool "Enable extensive interrupt logging."
	default n

endif # PS2_GPIO
```

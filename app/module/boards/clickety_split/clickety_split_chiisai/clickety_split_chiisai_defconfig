## app/module/drivers/input/Kconfig
```kconfig
if INPUT

config INPUT_SPARKFUN_BLACKBERRY_TRACKBALLER
    bool "SparkFun BlackBerry Trackballer"
    default y
    depends on DT_HAS_SPARKFUN_BLACKBERRY_TRACKBALLER_ENABLED
    depends on GPIO
    help
      Enable the GPIO input driver for the SparkFun BlackBerry Trackballer
      Breakout. The driver reports relative X/Y movement and the integrated
      push button through the Zephyr input subsystem.

config ZMK_INPUT_MOCK
    bool "Input Mock"
    default y
    depends on DT_HAS_ZMK_INPUT_MOCK_ENABLED

endif
```

## app/module/drivers/led/Kconfig
```kconfig
if LED

config ZMK_LED_COMPOSITE
    bool "ZMK LED Composite"
    default y
    depends on DT_HAS_ZMK_LED_COMPOSITE_ENABLED
    select LED_STRIP

config ZMK_LED_MOCK
    bool "ZMK LED Mock"
    default y
    depends on DT_HAS_ZMK_LED_MOCK_ENABLED

config ZMK_IS31FL3737
    bool "ZMK IS31FL3737 LED driver"
    default y
    depends on DT_HAS_ZMK_IS31FL3737_ENABLED
    select I2C

endif # LED
```

## app/module/drivers/led_strip/Kconfig
```kconfig
config ZMK_LED_STRIP_MOCK
    bool "ZMK LED Strip Mock"
    default y
    depends on LED_STRIP
    depends on DT_HAS_ZMK_LED_STRIP_MOCK_ENABLED
```

## app/module/dts/bindings/input/sparkfun,blackberry-trackballer.yaml
```yaml
# Copyright (c) 2026 The ZMK Contributors
# SPDX-License-Identifier: MIT

description: SparkFun BlackBerry Trackballer Breakout

compatible: "sparkfun,blackberry-trackballer"

include: base.yaml

properties:
  left-gpios:
    type: phandle-array
    required: true
    description: GPIO connected to the active-high LFT movement output.

  right-gpios:
    type: phandle-array
    required: true
    description: GPIO connected to the active-high RHT movement output.

  up-gpios:
    type: phandle-array
    required: true
    description: GPIO connected to the active-high UP movement output.

  down-gpios:
    type: phandle-array
    required: true
    description: GPIO connected to the active-high DWN movement output.

  button-gpios:
    type: phandle-array
    required: true
    description: GPIO connected to the trackball push button, normally active low.

  zephyr,axis-x:
    type: int
    required: true
    description: Zephyr relative input code used for horizontal movement.

  zephyr,axis-y:
    type: int
    required: true
    description: Zephyr relative input code used for vertical movement.

  button-code:
    type: int
    default: 256
    description: Zephyr input key code emitted by the push button. Defaults to INPUT_BTN_0.

  report-period-ms:
    type: int
    default: 8
    description: |
      Time in milliseconds used to batch accumulated X/Y movement reports
      and as the frame period when interpolation-frames is greater than one.

  interpolation-frames:
    type: int
    default: 1
    description: |
      Maximum number of report frames used to distribute accumulated whole
      movement. One disables interpolation and preserves the original
      single-report behavior. Valid values are 1 through 255.

  debounce-interval-ms:
    type: int
    default: 5
    description: Push-button debounce interval in milliseconds.

  minimum-pulse-interval-us:
    type: int
    default: 0
    description: |
      Minimum interval in microseconds between accepted pulses from the same
      movement GPIO. Pulses arriving sooner are ignored as glitches. A value
      of zero disables movement pulse filtering.

  acceleration-start-hz:
    type: int
    default: 20
    description: Pulse rate at or below which minimum-step is used.

  acceleration-max-hz:
    type: int
    default: 120
    description: Pulse rate at or above which maximum-step is used.

  acceleration-exponent:
    type: int
    default: 2
    description: |
      Exponent applied to the normalized pulse rate between the acceleration
      thresholds. One selects a linear curve, two selects a quadratic curve,
      and higher values make low-speed movement grow more slowly before
      accelerating more strongly near acceleration-max-hz. Valid values are
      1 through 4.

  minimum-step:
    type: int
    default: 1
    description: Relative movement generated by a slow pulse.

  maximum-step:
    type: int
    default: 8
    description: Relative movement generated by a fast pulse.
```

## app/module/dts/bindings/led/zmk,led-composite.yaml
```yaml
# Copyright (c) 2026 The ZMK Contributors
# SPDX-License-Identifier: MIT

description: |
  Virtual LED controller that composes multiple matrix and LED strip backends
  into one flattened RGB channel space.

  Child ranges must start at 0 and be declared in ascending contiguous order
  with no overlaps or holes.

  Each child must define exactly one of:
  - led-device: a Zephyr LED device with write_channels, set_brightness,
    or on/off support
  - led-strip-device: a Zephyr LED strip device

  Strip children may optionally reference a shared ext-power-device.

compatible: "zmk,led-composite"

include: ["led-controller.yaml"]

child-binding:
  description: Child LED backend mapped into the flattened channel space

  properties:
    led-device:
      type: phandle
      required: false
      description: |
        Matrix-style LED device. Devices with write_channels receive the
        flattened channels directly. Scalar set_brightness or on/off devices
        consume three RGB channels per physical child LED and use the maximum
        component as brightness.

    led-strip-device:
      type: phandle
      required: false
      description: |
        LED strip backend that receives forwarded writes in the flattened RGB
        channel space.

    channel-offset:
      type: int
      required: true
      description: Starting offset in the flattened output channel space.

    channel-count:
      type: int
      required: true
      description: |
        Number of writable RGB channels exposed by this child backend. Strip
        children must use a multiple of 3. Scalar led-device children must set
        this to three times the number of enabled child LEDs on that device.

    ext-power-device:
      type: phandle
      required: false
      description: |
        Optional shared external power controller used by strip children.
```

## app/module/dts/bindings/led/zmk,led-mock.yaml
```yaml
# Copyright (c) 2026 The ZMK Contributors
# SPDX-License-Identifier: MIT

description: Test LED controller with selectable Zephyr LED API capabilities

compatible: "zmk,led-mock"

include: ["led-controller.yaml"]

properties:
  mode:
    type: string
    required: true
    enum: ["binary", "brightness", "color", "channels", "none"]
    description: |
      Selects which Zephyr LED callbacks this test device exposes.
      The "none" mode intentionally exposes no callbacks for validation tests.

  channel-count:
    type: int
    required: false
    description: Number of writable channels when mode is "channels".

  managed-power-kind:
    type: string
    required: false
    enum: ["none", "is31fl3733", "is31fl3737"]
    description: |
      Optional test-only managed power personality used by zmk,led-composite
      power-path tests.

  sdb-gpios:
    type: phandle-array
    required: false
    description: Optional mock SDB GPIO for composite hard-power tests.

child-binding:
  properties:
    index:
      required: true
    color-mapping:
      required: true
```

## app/module/dts/bindings/led/zmk,led-strip-mock.yaml
```yaml
# Copyright (c) 2026 The ZMK Contributors
# SPDX-License-Identifier: MIT

description: Test LED strip device with optional update_channels support

compatible: "zmk,led-strip-mock"

include: ["base.yaml"]

properties:
  chain-length:
    type: int
    required: true
    description: Number of RGB pixels exposed by this mock strip.

  support-update-channels:
    type: boolean
    required: false
    description: Expose led_strip_update_channels in addition to update_rgb.
```

## app/module/dts/bindings/test-behaviors/zmk,behavior-gpio-emul-input.yaml
```yaml
# Copyright (c) 2026 The ZMK Contributors
# SPDX-License-Identifier: MIT

description: GPIO Emulator Input Test Behavior

compatible: "zmk,behavior-gpio-emul-input"

include: zero_param.yaml

properties:
  gpios:
    type: phandle-array
    required: true
```

## app/module/dts/bindings/test-behaviors/zmk,behavior-inject-input-speed-setting.yaml
```yaml
# Copyright (c) 2026 The ZMK Contributors
# SPDX-License-Identifier: MIT

description: Input speed profile settings injector behavior

compatible: "zmk,behavior-inject-input-speed-setting"

include: one_param.yaml

properties:
  processor:
    type: phandle
    required: true
    description: Speed profile processor whose settings entry is injected.
```

## app/module/dts/bindings/test-behaviors/zmk,behavior-pm-device-action.yaml
```yaml
# Copyright (c) 2026 The ZMK Contributors
# SPDX-License-Identifier: MIT

description: PM Device Action Test Behavior

compatible: "zmk,behavior-pm-device-action"

include: one_param.yaml

properties:
  device:
    type: phandle
    required: true
```

## app/module/dts/bindings/test-behaviors/zmk,behavior_inject_led_matrix_settings_v4.yaml
```yaml
# Copyright (c) 2026 The ZMK Contributors
# SPDX-License-Identifier: MIT

description: LED Matrix v4 Settings Injector Behavior

compatible: "zmk,behavior-inject-led-matrix-settings-v4"

include: zero_param.yaml
```

## app/module/dts/bindings/test-behaviors/zmk,behavior_raise_activity_state.yaml
```yaml
# Copyright (c) 2026 The ZMK Contributors
# SPDX-License-Identifier: MIT

description: Activity State Event Injector Behavior

compatible: "zmk,behavior-raise-activity-state"

include: one_param.yaml
```

## app/module/dts/bindings/test-behaviors/zmk,behavior_raise_battery_state.yaml
```yaml
# Copyright (c) 2026 The ZMK Contributors
# SPDX-License-Identifier: MIT

description: Battery State Event Injector Behavior

compatible: "zmk,behavior-raise-battery-state"

include: one_param.yaml
```

## app/module/dts/bindings/test-behaviors/zmk,behavior_raise_ble_connected_state.yaml
```yaml
description: Raise a test BLE connected/disconnected state transition

compatible: "zmk,behavior-raise-ble-connected-state"

include: one_param.yaml
```

## app/module/dts/bindings/test-behaviors/zmk,behavior_raise_ble_open_state.yaml
```yaml
description: Raise a test BLE open/settled state transition

compatible: "zmk,behavior-raise-ble-open-state"

include: one_param.yaml
```

## app/module/dts/bindings/test-behaviors/zmk,behavior_raise_hid_indicators.yaml
```yaml
# Copyright (c) 2026 The ZMK Contributors
# SPDX-License-Identifier: MIT

description: HID Indicators Event Injector Behavior

compatible: "zmk,behavior-raise-hid-indicators"

include: one_param.yaml
```

## app/module/dts/bindings/test-behaviors/zmk,behavior_raise_usb_conn_state.yaml
```yaml
# Copyright (c) 2026 The ZMK Contributors
# SPDX-License-Identifier: MIT

description: USB Connection State Event Injector Behavior

compatible: "zmk,behavior-raise-usb-conn-state"

include: one_param.yaml
```

## app/module/dts/bindings/zmk,ext-power-mock.yaml
```yaml
# Copyright (c) 2026 The ZMK Contributors
# SPDX-License-Identifier: MIT

description: Test external power controller that logs enable/disable transitions

compatible: "zmk,ext-power-mock"

include: ["base.yaml"]
```

## app/src/pointing/Kconfig
```kconfig
# Copyright (c) 2024 The ZMK Contributors
# SPDX-License-Identifier: MIT

menu "Pointing Options"

# Deprecated old config, kept for backwards compat
config ZMK_MOUSE
    bool "(Deprecated) Mouse Support"

config ZMK_POINTING
    bool "Pointing Device Support"
    default y if ZMK_MOUSE
    select INPUT
    select INPUT_THREAD_PRIORITY_OVERRIDE

if ZMK_POINTING

# Needed for anyone using gpio-keys for things like soft-off setup.
config INPUT_GPIO_KEYS
    default n

config INPUT_THREAD_STACK_SIZE
    default 1024 if ZMK_SPLIT && !ZMK_SPLIT_ROLE_CENTRAL

if !ZMK_SPLIT || ZMK_SPLIT_ROLE_CENTRAL

config ZMK_POINTING_SMOOTH_SCROLLING
    bool "Smooth Scrolling"
    help
      Enable smooth scrolling, with hosts that support HID Resolution Multipliers.

      Note that macOS is not such a host: IOHIDFamily never writes the
      Resolution Multiplier feature report, so the multipliers stay at their
      default and this option has no effect there. Use
      ZMK_POINTING_SCROLL_RESOLUTION for macOS.

config ZMK_POINTING_SCROLL_RESOLUTION
    int "Scroll resolution, in counts per inch"
    default 0
    help
      The physical resolution of the scroll axes, declared to the host in the
      HID report descriptor. 0 declares nothing, which is the historical
      behaviour.

      Hosts use this to tell a fine grained scroll stream from a notched
      wheel. When nothing is declared they assume a notched wheel: macOS
      assumes 9 counts per inch, keeps its high resolution scroll path off,
      and feeds its acceleration curve a velocity scaled by
      resolution/report_rate, so a device emitting hundreds of counts per inch
      is treated as moving far faster than it is. Scrolling then comes out
      coarse and accelerates away, however fine the stream is.

      Set this to the number of counts the device really emits per inch of
      travel, measured after the input processors. A 1600 CPI sensor feeding
      &zip_xy_to_scroll_mapper directly emits 1600; with "&zip_xy_scaler 1 10"
      ahead of it, 160. Larger values scroll more slowly, so this doubles as a
      speed control that needs no reflashing of the scaler.

      This describes the stream as emitted with the finest resolution
      multiplier, which is what ZMK defaults to. A host that asks for a coarser
      one through ZMK_POINTING_SMOOTH_SCROLLING is expected to account for the
      multiplier it chose.

      Must be either 0 or between 11 and 655350; the descriptor cannot express
      a resolution below 11. macOS ignores anything up to 18, which is twice
      its own default, so use 19 or more for it to take effect there. Values
      are rounded to what the descriptor can express, which is exact up to
      about 800 and within a fraction of a percent above it.

config ZMK_INPUT_LISTENER
    bool "Input listener for processing input events in the system"
    default y
    depends on DT_HAS_ZMK_INPUT_LISTENER_ENABLED


config ZMK_INPUT_PROCESSOR_TEMP_LAYER
    bool "Temporary Layer Input Processor"
    default y
    depends on DT_HAS_ZMK_INPUT_PROCESSOR_TEMP_LAYER_ENABLED

config ZMK_INPUT_PROCESSOR_TEMP_LAYER_MAX_ACTION_EVENTS
    int "Temporary Layer Input Processor Max Action Events"
    default 4
    depends on ZMK_INPUT_PROCESSOR_TEMP_LAYER

endif

config ZMK_INPUT_PROCESSOR_TRANSFORM
    bool "Transform Input Processor"
    default y
    depends on DT_HAS_ZMK_INPUT_PROCESSOR_TRANSFORM_ENABLED

config ZMK_INPUT_PROCESSOR_SCALER
    bool "Scaling Input Processor"
    default y
    depends on DT_HAS_ZMK_INPUT_PROCESSOR_SCALER_ENABLED

config ZMK_INPUT_PROCESSOR_CODE_MAPPER
    bool "Code Mapper Input Processor"
    default y
    depends on DT_HAS_ZMK_INPUT_PROCESSOR_CODE_MAPPER_ENABLED

config ZMK_INPUT_PROCESSOR_BEHAVIORS
    bool "Behaviors Input Processor"
    default y
    depends on DT_HAS_ZMK_INPUT_PROCESSOR_BEHAVIORS_ENABLED

config ZMK_INPUT_SPLIT
    bool "Split input support"
    default y
    depends on DT_HAS_ZMK_INPUT_SPLIT_ENABLED && ZMK_SPLIT

if ZMK_INPUT_SPLIT

config ZMK_INPUT_SPLIT_INIT_PRIORITY
    int "Input Split initialization priority"
    default INPUT_INIT_PRIORITY


config ZMK_INPUT_SPLIT_MAX_TRACKED_KEYS
    int "Input Split max tracked keys to release on peripheral disconnect"
    default 5

endif # ZMK_INPUT_SPLIT

endif # ZMK_POINTING

endmenu # Mouse Options
```

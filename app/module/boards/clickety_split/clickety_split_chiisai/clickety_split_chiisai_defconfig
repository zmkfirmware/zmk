## app/src/split/Kconfig
```kconfig
# Copyright (c) 2022 The ZMK Contributors
# SPDX-License-Identifier: MIT

menuconfig ZMK_SPLIT
    bool "Split keyboard support"

if ZMK_SPLIT

config ZMK_SPLIT_ROLE_CENTRAL
    bool "Split central device"

config ZMK_SPLIT_BLE
    bool "BLE Split"
    default y
    depends on ZMK_BLE
    select BT_USER_PHY_UPDATE
    select BT_AUTO_PHY_UPDATE

config ZMK_SPLIT_WIRED
    bool "Wired Split"
    default y
    depends on DT_HAS_ZMK_WIRED_SPLIT_ENABLED
    select SERIAL
    select RING_BUFFER
    select CRC

config ZMK_SPLIT_PERIPHERAL_HID_INDICATORS
    bool "Peripheral HID Indicators"
    depends on ZMK_HID_INDICATORS
    help
      Enable propagating the HID (LED) Indicator state to the split peripheral(s).

config ZMK_SPLIT_PERIPHERAL_ENDPOINTS
    bool "Peripheral Endpoint State"
    help
      Enable propagating the selected endpoint and the preferred transport to the split
      peripheral(s), so that peripheral side consumers such as indicator LEDs can tell
      whether the keyboard is connected and to what. Enable it on both halves.

endif # ZMK_SPLIT

rsource "bluetooth/Kconfig"
rsource "wired/Kconfig"
```

## app/tests/keymap/zero-length/testcase.yaml
```yaml
tests:
  zmk.keymap.zero_length:
    platform_allow:
      - native_sim
    tags:
      - zmk
      - keymap
```

## app/tests/split-central/position-state/testcase.yaml
```yaml
tests:
  zmk.split.central.position_state:
    platform_allow:
      - native_sim/native/64
    integration_platforms:
      - native_sim/native/64
    tags:
      - split
      - bluetooth
```

## app/tests/studio/gatt-rpc-rx/testcase.yaml
```yaml
tests:
  zmk.studio.gatt_rpc_rx:
    platform_allow:
      - native_sim
    tags:
      - zmk
      - studio
```

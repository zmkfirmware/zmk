## app/module/dts/bindings/sensor/alps,ec11.yaml
```yaml
description: |
  Sensor driver for the Alps EC11 rotary encoder

compatible: "alps,ec11"

properties:
  label:
    type: string
    required: false
    deprecated: true
  a-gpios:
    type: phandle-array
    required: true
    description: A pin for the encoder
  b-gpios:
    type: phandle-array
    required: true
    description: A pin for the encoder
  resolution:
    type: int
    description: Number of pulses per tick
    deprecated: true
    required: false
  steps:
    type: int
    description: Number of pulses in one full rotation
    required: false
  # positive-values:
  #   type: array
  #   description: List of `uint8_t` values that should be considered as positive rotations
  #   required: false
  #   default: [1, 7, 14, 8]
  # negative-values:
  #   type: array
  #   description: List of `uint8_t` values that should be considered as negative rotations
  #   required: false
  #   default: [2, 4, 13, 11]
  # consistent:
  #   type: int
  #   description: AAAA
  #   required: false
  #   default: 0
  debounce-ms:
    type: int
    default: 5
    description: Debounce time in milliseconds.
  debounce-scan-period-ms:
    type: int
    default: 1
    description: Time between reads in milliseconds when the encoder state is changed.
  model:
    type: string
    required: false
    default: ec11
```

## app/module/dts/bindings/sensor/ck,thb.yaml
```yaml
description: |
  Sensor driver for the C-K THB001 joystick

compatible: "ck,thb"

include: base.yaml

properties:
    io-channels:
      required: true
      description: |
        Channels available with this divider configuration.

    io-channel-names:
      required: true
      description: |
        Channels names, use "X-AXIS" and "Y-AXIS" accordingly

    min-mv:
      type: int
      required: false
      description: |
        Minimum voltage output on the potentiometer

        If absent, a default 0 value will be used

    max-mv:
      type: int
      required: true
      description: |
        Maximum voltage output on the potentiometer

        max-mv - min-mv will be the full range of potentiometer output
```

## app/module/dts/bindings/sensor/zmk,battery-mock.yaml
```yaml
# Copyright (c) 2025 The ZMK Contributors
# SPDX-License-Identifier: MIT

description: Mock battery SoC monitoring, reporting changing values

compatible: "zmk,battery-mock"
```

## app/module/dts/bindings/sensor/zmk,battery-nrf-vddh.yaml
```yaml
# Copyright (c) 2021 The ZMK Contributors
# SPDX-License-Identifier: MIT

description: Battery SoC monitoring using nRF VDDH

compatible: "zmk,battery-nrf-vddh"

properties:
  chg-gpios:
    required: false
    type: phandle-array
    description: "A GPIO pin to report charging state to"
```

## app/module/dts/bindings/sensor/zmk,battery-voltage-divider.yaml
```yaml
# Copyright (c) 2020 The ZMK Contributors
# SPDX-License-Identifier: MIT

description: Battery SoC monitoring using voltage divider

compatible: "zmk,battery-voltage-divider"

include: voltage-divider.yaml

properties:
  oversampling:
      type: int
      required: false
      description: Oversampling value for ADC
```

## app/module/dts/bindings/sensor/zmk,maxim-max17048.yml
```yaml
#
# Copyright (c) 2022 The ZMK Contributors
#
# SPDX-License-Identifier: MIT
#

description: >
  This is a representation of the Maxim max17048 I2C Fuel Gauge.

compatible: "zmk,maxim-max17048"

include: [i2c-device.yaml]
```

## app/module/dts/bindings/sensor/zmk,sensor-encoder-mock.yaml
```yaml
# Copyright (c) 2024 The ZMK Contributors
# SPDX-License-Identifier: MIT

description: |
  Allows defining a mock sensor driver that simulates periodic encoder rotation events.

compatible: "zmk,sensor-encoder-mock"

properties:
  event-startup-delay:
    type: int
    default: 0
    description: Milliseconds to delay before starting generating the events
  event-period:
    type: int
    description: Milliseconds between each generated event
  events:
    type: array
    description: List of angle events to generate
  exit-after:
    type: boolean
```

## app/module/dts/bindings/test-behaviors/zmk,behavior_add_layer.yaml
```yaml
# Copyright (c) 2025 The ZMK Contributors
# SPDX-License-Identifier: MIT

description: Layer Adder Behavior

compatible: "zmk,behavior-add-layer"

include: zero_param.yaml
```

## app/module/dts/bindings/test-behaviors/zmk,behavior_move_layer.yaml
```yaml
# Copyright (c) 2025 The ZMK Contributors
# SPDX-License-Identifier: MIT

description: Layer Mover Behavior

compatible: "zmk,behavior-move-layer"

include: two_param.yaml
```

## app/module/dts/bindings/test-behaviors/zmk,behavior_remove_layer.yaml
```yaml
# Copyright (c) 2025 The ZMK Contributors
# SPDX-License-Identifier: MIT

description: Layer Remover Behavior

compatible: "zmk,behavior-remove-layer"

include: one_param.yaml
```

## app/module/dts/bindings/test-behaviors/zmk,behavior_set_layer_binding_at_idx.yaml
```yaml
# Copyright (c) 2025 The ZMK Contributors
# SPDX-License-Identifier: MIT

description: Layer Binding Setter Behavior

compatible: "zmk,behavior-set-layer-binding-at-idx"

include: two_param.yaml

properties:
  bindings:
    type: phandle-array
    required: true
```

## app/module/test-behaviors/Kconfig
```kconfig
config ZMK_TEST_BEHAVIORS
    bool "Include behaviors used for testing purposes"
```

## app/module/tests/drivers/gpio/gpio_demux/testcase.yaml
```yaml
common:
  tags:
    - drivers
    - gpio
  depends_on: gpio

tests:
  drivers.gpio.demux:
    platform_allow:
      - native_sim
      - native_sim/native/64
```

## app/src/boot/Kconfig
```kconfig
config ZMK_DBL_TAP_BOOTLOADER
    bool "Double Tap To Enter Bootloader"
    depends on RETENTION_BOOT_MODE

if ZMK_DBL_TAP_BOOTLOADER

config ZMK_DBL_TAP_BOOTLOADER_TIMEOUT_MS
    int "Double Tap Timeout (ms)"

config ZMK_DBL_TAP_BOOTLOADER_INIT_PRIORITY
    int "Double Tap Init Priority"

endif

config ZMK_BOOTMODE_TO_MAGIC_VALUE_MAPPER
    bool "Magic Value Mapper"
    default y
    depends on DT_HAS_ZMK_BOOTMODE_TO_MAGIC_MAPPER_ENABLED

if ZMK_BOOTMODE_TO_MAGIC_VALUE_MAPPER

choice ZMK_BOOTMODE_MAGIC_VALUE_BOOTLOADER_TYPE
    prompt "Magic Value Bootloader Type"

config ZMK_BOOTMODE_MAGIC_VALUE_BOOTLOADER_TYPE_UNKNOWN
    bool "Unknown"

config ZMK_BOOTMODE_MAGIC_VALUE_BOOTLOADER_TYPE_TINYUF2
    bool "tinyuf2"

config ZMK_BOOTMODE_MAGIC_VALUE_BOOTLOADER_TYPE_ADAFRUIT_BOSSA
    bool "Adafruit BOSSA"

config ZMK_BOOTMODE_MAGIC_VALUE_BOOTLOADER_TYPE_ADAFRUIT_NRF52
    bool "Adafruit nRF52"

endchoice

config ZMK_BOOTMODE_BOOTLOADER_MAGIC_VALUE
    hex

endif
```

## app/src/boot/Kconfig.defaults
```kconfig
config ZMK_DBL_TAP_BOOTLOADER
    default y if STM32_BOOTLOADER || RPI_PICO_ROM_BOOTLOADER
    depends on RETENTION_BOOT_MODE

if ZMK_DBL_TAP_BOOTLOADER

config ZMK_DBL_TAP_BOOTLOADER_TIMEOUT_MS
    default 500

config ZMK_DBL_TAP_BOOTLOADER_INIT_PRIORITY
    default 20

endif

if ZMK_BOOTMODE_TO_MAGIC_VALUE_MAPPER

choice ZMK_BOOTMODE_MAGIC_VALUE_BOOTLOADER_TYPE
    default ZMK_BOOTMODE_MAGIC_VALUE_BOOTLOADER_TYPE_ADAFRUIT_NRF52 if SOC_NRF52840

endchoice

config ZMK_BOOTMODE_BOOTLOADER_MAGIC_VALUE
    default 0xf01669ef if ZMK_BOOTMODE_MAGIC_VALUE_BOOTLOADER_TYPE_TINYUF2 || ZMK_BOOTMODE_MAGIC_VALUE_BOOTLOADER_TYPE_ADAFRUIT_BOSSA || BOOTLOADER_BOSSA_ADAFRUIT_UF2
    default 0x57 if ZMK_BOOTMODE_MAGIC_VALUE_BOOTLOADER_TYPE_ADAFRUIT_NRF52

endif
```

## app/src/display/Kconfig
```kconfig
# Copyright (c) 2020 The ZMK Contributors
# SPDX-License-Identifier: MIT

menuconfig ZMK_DISPLAY
    bool "Enable ZMK Display"
    select DISPLAY
    select LVGL
    imply LV_CONF_MINIMAL

if ZMK_DISPLAY

config ZMK_DISPLAY_BLANK_ON_IDLE
    bool "Blank display on idle"
    default y if SSD1306

config ZMK_DISPLAY_TICK_PERIOD_MS
    int "Period (in ms) between display task execution"
    default 10

if LV_USE_THEME_MONO

config ZMK_DISPLAY_INVERT
    bool "Invert display colors"

endif

choice LV_TXT_ENC
    default LV_TXT_ENC_UTF8

endchoice

config LV_MEM_CUSTOM
    default y

 config LV_Z_MEM_POOL_SIZE
     default 4096 if ZMK_DISPLAY_STATUS_SCREEN_BUILT_IN

choice ZMK_DISPLAY_STATUS_SCREEN
    prompt "Default status screen for displays"

config ZMK_DISPLAY_STATUS_SCREEN_BUILT_IN
    bool "Built in status screen"
    select LV_OBJ_LABEL
    imply LV_USE_THEME_MONO if LV_Z_BITS_PER_PIXEL=1
    imply ZMK_WIDGET_LAYER_STATUS
    imply ZMK_WIDGET_BATTERY_STATUS
    imply ZMK_WIDGET_OUTPUT_STATUS
    imply ZMK_WIDGET_PERIPHERAL_STATUS
    imply ZMK_WIDGET_INDICATORS_STATUS

config ZMK_DISPLAY_STATUS_SCREEN_CUSTOM
    bool "Custom status screen"

endchoice

choice ZMK_DISPLAY_WORK_QUEUE
    prompt "Work queue selection for UI updates"

config ZMK_DISPLAY_WORK_QUEUE_SYSTEM
    bool "Use default system work queue for UI updates"

config ZMK_DISPLAY_WORK_QUEUE_DEDICATED
    bool "Use dedicated work queue for UI updates"

endchoice

if ZMK_DISPLAY_WORK_QUEUE_DEDICATED

config ZMK_DISPLAY_DEDICATED_THREAD_STACK_SIZE
    int "Stack size for dedicated UI thread/queue"
    default 2048

config ZMK_DISPLAY_DEDICATED_THREAD_PRIORITY
    int "Thread priority for dedicated UI thread/queue"
    default 5

endif # ZMK_DISPLAY_WORK_QUEUE_DEDICATED

if ZMK_DISPLAY_STATUS_SCREEN_BUILT_IN

config LV_FONT_MONTSERRAT_16
    default y

choice LV_FONT_DEFAULT
    default LV_FONT_DEFAULT_MONTSERRAT_16

endchoice

config LV_FONT_MONTSERRAT_12
    default y

endif # ZMK_DISPLAY_STATUS_SCREEN_BUILT_IN

choice ZMK_LV_FONT_DEFAULT_SMALL
    prompt "Select theme default small font"
    default ZMK_LV_FONT_DEFAULT_SMALL_MONTSERRAT_12
    help
        Select theme default small font

    config ZMK_LV_FONT_DEFAULT_SMALL_MONTSERRAT_8
        bool "Montserrat 8"
        select LV_FONT_MONTSERRAT_8
    config ZMK_LV_FONT_DEFAULT_SMALL_MONTSERRAT_12
        bool "Montserrat 12"
        select LV_FONT_MONTSERRAT_12
    config ZMK_LV_FONT_DEFAULT_SMALL_MONTSERRAT_14
        bool "Montserrat 14"
        select LV_FONT_MONTSERRAT_14
    config ZMK_LV_FONT_DEFAULT_SMALL_MONTSERRAT_16
        bool "Montserrat 16"
        select LV_FONT_MONTSERRAT_16
    config ZMK_LV_FONT_DEFAULT_SMALL_MONTSERRAT_18
        bool "Montserrat 18"
        select LV_FONT_MONTSERRAT_18
    config ZMK_LV_FONT_DEFAULT_SMALL_MONTSERRAT_20
        bool "Montserrat 20"
        select LV_FONT_MONTSERRAT_20
    config ZMK_LV_FONT_DEFAULT_SMALL_MONTSERRAT_22
        bool "Montserrat 22"
        select LV_FONT_MONTSERRAT_22
    config ZMK_LV_FONT_DEFAULT_SMALL_MONTSERRAT_24
        bool "Montserrat 24"
        select LV_FONT_MONTSERRAT_24
    config ZMK_LV_FONT_DEFAULT_SMALL_MONTSERRAT_26
        bool "Montserrat 26"
        select LV_FONT_MONTSERRAT_26
    config ZMK_LV_FONT_DEFAULT_SMALL_MONTSERRAT_28
        bool "Montserrat 28"
        select LV_FONT_MONTSERRAT_28
    config ZMK_LV_FONT_DEFAULT_SMALL_MONTSERRAT_30
        bool "Montserrat 30"
        select LV_FONT_MONTSERRAT_30
    config ZMK_LV_FONT_DEFAULT_SMALL_MONTSERRAT_32
        bool "Montserrat 32"
        select LV_FONT_MONTSERRAT_32
    config ZMK_LV_FONT_DEFAULT_SMALL_MONTSERRAT_34
        bool "Montserrat 34"
        select LV_FONT_MONTSERRAT_34
    config ZMK_LV_FONT_DEFAULT_SMALL_MONTSERRAT_36
        bool "Montserrat 36"
        select LV_FONT_MONTSERRAT_36
    config ZMK_LV_FONT_DEFAULT_SMALL_MONTSERRAT_38
        bool "Montserrat 38"
        select LV_FONT_MONTSERRAT_38
    config ZMK_LV_FONT_DEFAULT_SMALL_MONTSERRAT_40
        bool "Montserrat 40"
        select LV_FONT_MONTSERRAT_40
    config ZMK_LV_FONT_DEFAULT_SMALL_MONTSERRAT_42
        bool "Montserrat 42"
        select LV_FONT_MONTSERRAT_42
    config ZMK_LV_FONT_DEFAULT_SMALL_MONTSERRAT_44
        bool "Montserrat 44"
        select LV_FONT_MONTSERRAT_44
    config ZMK_LV_FONT_DEFAULT_SMALL_MONTSERRAT_46
        bool "Montserrat 46"
        select LV_FONT_MONTSERRAT_46
    config ZMK_LV_FONT_DEFAULT_SMALL_MONTSERRAT_48
        bool "Montserrat 48"
        select LV_FONT_MONTSERRAT_48
    config ZMK_LV_FONT_DEFAULT_SMALL_MONTSERRAT_12_SUBPX
        bool "Montserrat 12 sub-pixel"
        select LV_FONT_MONTSERRAT_12_SUBPX
    config ZMK_LV_FONT_DEFAULT_SMALL_MONTSERRAT_28_COMPRESSED
        bool "Montserrat 28 compressed"
        select LV_FONT_MONTSERRAT_28_COMPRESSED
    config ZMK_LV_FONT_DEFAULT_SMALL_DEJAVU_16_PERSIAN_HEBREW
        bool "Dejavu 16 Persian, Hebrew, Arabic letters"
        select LV_FONT_DEJAVU_16_PERSIAN_HEBREW
    config ZMK_LV_FONT_DEFAULT_SMALL_SIMSUN_16_CJK
        bool "Simsun 16 CJK"
        select LV_FONT_SIMSUN_16_CJK
    config ZMK_LV_FONT_DEFAULT_SMALL_UNSCII_8
        bool "UNSCII 8 (Perfect monospace font)"
        select LV_FONT_UNSCII_8
    config ZMK_LV_FONT_DEFAULT_SMALL_UNSCII_16
        bool "UNSCII 16 (Perfect monospace font)"
        select LV_FONT_UNSCII_16
endchoice

rsource "widgets/Kconfig"

endif
```

## app/src/display/Kconfig.defaults
```kconfig
# Copyright (c) 2024 The ZMK Contributors
# SPDX-License-Identifier: MIT

if ZMK_DISPLAY

if ZMK_DISPLAY_WORK_QUEUE_DEDICATED

config ZMK_DISPLAY_DEDICATED_THREAD_STACK_SIZE
    default 2048

config ZMK_DISPLAY_DEDICATED_THREAD_PRIORITY
    default 5

endif # ZMK_DISPLAY_WORK_QUEUE_DEDICATED

endif # ZMK_DISPLAY
```

## app/src/display/widgets/Kconfig
```kconfig
# Copyright (c) 2020 The ZMK Contributors
# SPDX-License-Identifier: MIT

menu "ZMK Display Widgets"

config ZMK_WIDGET_LAYER_STATUS
    bool "Widget for highest, active layer using small icons"
    depends on !ZMK_SPLIT || ZMK_SPLIT_ROLE_CENTRAL
    select LV_USE_LABEL

config ZMK_WIDGET_BATTERY_STATUS
    bool "Widget for battery charge information, using small icons"
    depends on BT
    select LV_USE_LABEL

if ZMK_WIDGET_BATTERY_STATUS

config ZMK_WIDGET_BATTERY_STATUS_SHOW_PERCENTAGE
    bool "Show battery level percentage in text"

endif

config ZMK_WIDGET_OUTPUT_STATUS
    bool "Widget for keyboard output status icons"
    depends on BT && (!ZMK_SPLIT_BLE || ZMK_SPLIT_ROLE_CENTRAL)
    select LV_USE_LABEL

config ZMK_WIDGET_PERIPHERAL_STATUS
    bool "Widget for split peripheral status icons"
    depends on BT && ZMK_SPLIT_BLE && !ZMK_SPLIT_ROLE_CENTRAL
    select LV_USE_LABEL

config ZMK_WIDGET_WPM_STATUS
    bool "Widget for displaying typed words per minute"
    depends on !ZMK_SPLIT || ZMK_SPLIT_ROLE_CENTRAL
    select LV_USE_LABEL
    select ZMK_WPM

endmenu
```

## app/src/drivers/sensors/en11/Kconfig
```kconfig
# EN11 incremental encoder sensor configuration options

# Copyright (c) 2020 Peter Johanson
# SPDX-License-Identifier: MIT

menuconfig EN11
	bool "EN11 Incremental Encoder Sensor"
	depends on GPIO
	help
	  Enable driver for EN11 incremental encoder sensors.

if EN11

choice
	prompt "Trigger mode"
	default EN11_TRIGGER_NONE
	help
	  Specify the type of triggering to be used by the driver.

config EN11_TRIGGER_NONE
	bool "No trigger"

config EN11_TRIGGER_GLOBAL_THREAD
	bool "Use global thread"
	depends on GPIO
	select EN11_TRIGGER

config EN11_TRIGGER_OWN_THREAD
	bool "Use own thread"
	depends on GPIO
	select EN11_TRIGGER

endchoice

config EN11_TRIGGER
	bool

config EN11_THREAD_PRIORITY
	int "Thread priority"
	depends on EN11_TRIGGER_OWN_THREAD
	default 10
	help
	  Priority of thread used by the driver to handle interrupts.

config EN11_THREAD_STACK_SIZE
	int "Thread stack size"
	depends on EN11_TRIGGER_OWN_THREAD
	default 1024
	help
	  Stack size of thread used by the driver to handle interrupts.

endif # EN11
```

## app/src/indicators/Kconfig
```kconfig
# Copyright (c) 2026 The ZMK Contributors
# SPDX-License-Identifier: MIT

rsource "Kconfig.indicator_leds"
```

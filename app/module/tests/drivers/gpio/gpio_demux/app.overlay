/ {
	dut: gpio_demux {
		compatible = "zmk,gpio-demux";

		gpio-controller;
		#gpio-cells = <2>;
		select-gpios = <&gpio0 0 GPIO_ACTIVE_HIGH>, <&gpio0 1 GPIO_ACTIVE_HIGH>,<&gpio0 2 GPIO_ACTIVE_HIGH>;
		en-gpios = <&gpio0 3 GPIO_ACTIVE_HIGH>;
	};
};

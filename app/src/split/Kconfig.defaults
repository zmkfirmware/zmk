## app/src/split/Kconfig.defaults
```kconfig
# Copyright (c) 2024 The ZMK Contributors
# SPDX-License-Identifier: MIT
config ZMK_SPLIT_PERIPHERAL_MAX_BONDS
    default 4

config ZMK_SPLIT_PERIPHERAL_ADV_ROTATION_INTERVAL
    default 5
    
rsource "bluetooth/Kconfig.defaults"
rsource "wired/Kconfig.defaults"
```

## app/src/split/bluetooth/Kconfig
```kconfig
# Copyright (c) 2022 The ZMK Contributors
# SPDX-License-Identifier: MIT

if ZMK_SPLIT && ZMK_SPLIT_BLE

menu "BLE Transport"

# Added for backwards compatibility. New shields/board should set `ZMK_SPLIT_ROLE_CENTRAL` only.
config ZMK_SPLIT_BLE_ROLE_CENTRAL
    bool
    select ZMK_SPLIT_ROLE_CENTRAL

config ZMK_SPLIT_ROLE_CENTRAL
    select BT_CENTRAL
    select BT_GATT_CLIENT
    select BT_GATT_AUTO_DISCOVER_CCC
    select BT_SCAN_WITH_IDENTITY

# Bump this value needed for concurrent GATT discovery of splits
config BT_L2CAP_TX_BUF_COUNT
    default 5 if ZMK_SPLIT_ROLE_CENTRAL

if ZMK_SPLIT_ROLE_CENTRAL

config ZMK_SPLIT_BLE_CENTRAL_PERIPHERALS
    int "Number of peripherals that will connect to the central."
    default 1

menuconfig ZMK_SPLIT_BLE_CENTRAL_BATTERY_LEVEL_FETCHING
    bool "Fetch Peripheral Battery Level Info"
    help
      Adds internal support for fetching the battery levels from peripherals
      and generating events in the ZMK eventing system.

if ZMK_SPLIT_BLE_CENTRAL_BATTERY_LEVEL_FETCHING

config ZMK_SPLIT_BLE_CENTRAL_BATTERY_LEVEL_QUEUE_SIZE
    int "Max number of battery level events to queue when received from peripherals"
    default ZMK_SPLIT_BLE_CENTRAL_PERIPHERALS

config ZMK_SPLIT_BLE_CENTRAL_BATTERY_LEVEL_PROXY
    bool "Proxy Peripheral Battery Level Info"
    help
      Adds support for reporting the battery levels of connected split
      peripherals through an additional Battery Level service.

endif

config ZMK_SPLIT_BLE_CENTRAL_POSITION_QUEUE_SIZE
    int "Max number of key position state events to queue when received from peripherals"
    default 5

config ZMK_SPLIT_BLE_CENTRAL_SPLIT_RUN_STACK_SIZE
    int "BLE split central write thread stack size"
    default 512

config ZMK_SPLIT_BLE_CENTRAL_SPLIT_RUN_QUEUE_SIZE
    int "Max number of behavior run events to queue to send to the peripheral(s)"
    default 5

config ZMK_SPLIT_BLE_CENTRAL_DATA_XFER_STACK_SIZE
    int "BLE split central to peripheral thread stack size"
    default 512

config ZMK_SPLIT_BLE_CENTRAL_DATA_XFER_QUEUE_SIZE
    int "Max number of data transfer requests to queue to send to the peripheral(s)"
    default 5

config ZMK_SPLIT_BLE_PREF_INT
    int "Connection interval to use for split central/peripheral connection"
    default 6

config ZMK_SPLIT_BLE_PREF_LATENCY
    int "Latency to use for split central/peripheral connection"
    default 30

config ZMK_SPLIT_BLE_PREF_TIMEOUT
    int "Supervision timeout to use for split central/peripheral connection"
    default 400

endif # ZMK_SPLIT_ROLE_CENTRAL

if !ZMK_SPLIT_ROLE_CENTRAL

config ZMK_SPLIT_BLE_PERIPHERAL_STACK_SIZE
    int "BLE split peripheral notify thread stack size"
    default 650

config ZMK_SPLIT_BLE_PERIPHERAL_PRIORITY
    int "BLE split peripheral notify thread priority"
    default 5

config ZMK_SPLIT_BLE_PERIPHERAL_POSITION_QUEUE_SIZE
    int "Max number of key position state events to queue to send to the central"
    default 10

config BT_MAX_PAIRED
    default 1

config BT_MAX_CONN
    default 1

# Allow central to specify connection parameters.
config BT_GAP_AUTO_UPDATE_CONN_PARAMS
    default n

#!ZMK_SPLIT_ROLE_CENTRAL
endif

endmenu

#ZMK_SPLIT_BLE
endif


if ZMK_BLE

if ZMK_SPLIT_BLE && ZMK_SPLIT_ROLE_CENTRAL

config BT_MAX_CONN
    default 6

config BT_MAX_PAIRED
    default 6

#ZMK_SPLIT_BLE && ZMK_SPLIT_ROLE_CENTRAL
endif

if !ZMK_SPLIT_BLE

config BT_MAX_CONN
    default 5

config BT_MAX_PAIRED
    default 5

#!ZMK_SPLIT_BLE
endif

#ZMK_BLE
endif
```

## app/src/split/bluetooth/Kconfig.defaults
```kconfig
# Copyright (c) 2024 The ZMK Contributors
# SPDX-License-Identifier: MIT

if ZMK_BLE

if ZMK_SPLIT_BLE

config ZMK_SPLIT_BLE_PRIORITY
    default 1

if ZMK_SPLIT_ROLE_CENTRAL

config ZMK_SPLIT_BLE_CENTRAL_PERIPHERALS
    default 1

config BT_MAX_CONN
    default 6

config BT_MAX_PAIRED
    default 6

#ZMK_SPLIT_BLE && ZMK_SPLIT_ROLE_CENTRAL
endif

endif

if !ZMK_SPLIT_BLE

config BT_MAX_CONN
    default 5

config BT_MAX_PAIRED
    default 5

#!ZMK_SPLIT_BLE
endif

#ZMK_BLE
endif
```

## app/src/split/serial/Kconfig
```kconfig
if ZMK_SPLIT && ZMK_SPLIT_SERIAL

menu "Serial Transport"

config ZMK_SPLIT_SERIAL_UART
    bool "Serial over UART"
    select CRC
    default y

config ZMK_SPLIT_SERIAL_UART_POLL
    bool "Serial over UART Polling API"
    default DT_HAS_RASPBERRYPI_PICO_UART_PIO_ENABLED || BOARD_NATIVE_SIM

config ZMK_SPLIT_SERIAL_CDC_ACM
    bool "Serial over USB CDC ACM"
    default n

endmenu

endif
```

## app/src/split/wired/Kconfig
```kconfig
# Copyright (c) 2025 The ZMK Contributors
# SPDX-License-Identifier: MIT

if ZMK_SPLIT_WIRED

config ZMK_SPLIT_WIRED_PRIORITY
    int "Wired transport priority"
    help
        Lower number priorities transports are favored over higher numbers.

choice
    prompt "UART Mode"

config ZMK_SPLIT_WIRED_UART_MODE_ASYNC
    bool "Async (DMA) Mode"
    # For now, don't use async/DMA on nRF52 due to RX bug (fixed
    # in newer Zephyr version?)
    depends on SERIAL_SUPPORT_ASYNC
    select UART_ASYNC_API

config ZMK_SPLIT_WIRED_UART_MODE_INTERRUPT
    bool "Interrupt Mode"
    depends on SERIAL_SUPPORT_INTERRUPT
    select UART_INTERRUPT_DRIVEN

config ZMK_SPLIT_WIRED_UART_MODE_POLLING
    bool "Polling Mode"

endchoice

if ZMK_SPLIT_WIRED_UART_MODE_POLLING

config ZMK_SPLIT_WIRED_POLLING_RX_PERIOD
    int "Ticks between RX polls"

endif

if ZMK_SPLIT_WIRED_UART_MODE_ASYNC

config ZMK_SPLIT_WIRED_ASYNC_RX_TIMEOUT
    int "RX Timeout (in microseconds) before reporting received data"

endif

config ZMK_SPLIT_WIRED_CMD_BUFFER_ITEMS
    int "Number of central commands to buffer for TX/RX"

config ZMK_SPLIT_WIRED_EVENT_BUFFER_ITEMS
    int "Number of peripheral events to buffer for TX/RX"

config ZMK_SPLIT_WIRED_HALF_DUPLEX_RX_TIMEOUT
    int "RX timeout (in ms) when polling peripheral(s) and waiting for any response"

config ZMK_SPLIT_WIRED_HALF_DUPLEX_RX_COMPLETE_TIMEOUT
    int "RX complete timeout (in ticks) when polling peripheral(s) after receiving some response data"

endif
```

## app/src/split/wired/Kconfig.defaults
```kconfig
# Copyright (c) 2025 The ZMK Contributors
# SPDX-License-Identifier: MIT

if ZMK_SPLIT_WIRED

config ZMK_SPLIT_WIRED_PRIORITY
    default 0

config ZMK_SPLIT_WIRED_CMD_BUFFER_ITEMS
    default 4

config ZMK_SPLIT_WIRED_EVENT_BUFFER_ITEMS
    default 16


if ZMK_SPLIT_WIRED_UART_MODE_POLLING

config ZMK_SPLIT_WIRED_POLLING_RX_PERIOD
    default 10

endif


if ZMK_SPLIT_WIRED_UART_MODE_ASYNC

config ZMK_SPLIT_WIRED_ASYNC_RX_TIMEOUT
    default 20

endif

config ZMK_SPLIT_WIRED_HALF_DUPLEX_RX_TIMEOUT
    default 15

config ZMK_SPLIT_WIRED_HALF_DUPLEX_RX_COMPLETE_TIMEOUT
    default 20

endif
```

## app/src/studio/Kconfig
```kconfig
# Copyright (c) 2024 The ZMK Contributors
# SPDX-License-Identifier: MIT

menuconfig ZMK_STUDIO
    bool "Studio Support"
    select ZMK_STUDIO_RPC if !ZMK_SPLIT || ZMK_SPLIT_ROLE_CENTRAL
    select PM_DEVICE # Needed for physical layout switching
    help
      Add firmware support for realtime keymap updates (ZMK Studio)

if ZMK_STUDIO

module = ZMK_STUDIO
module-str = zmk_studio
source "subsys/logging/Kconfig.template.log_config"

menuconfig ZMK_STUDIO_LOCKING
    bool "Lock Support"

if ZMK_STUDIO_LOCKING

config ZMK_STUDIO_LOCK_IDLE_TIMEOUT_SEC
    int "Idle Timeout"
    default 600

config ZMK_STUDIO_LOCK_ON_DISCONNECT
    bool "Lock On Disconnect"
    default y

endif

menuconfig ZMK_STUDIO_RPC
    bool "Remote Procedure Calls (RPC)"
    select NANOPB
    # These two save stack size
    imply NANOPB_NO_ERRMSG
    imply NANOPB_WITHOUT_64BIT
    imply NANOPB_NO_ENCODE_SIZE_CHECK
    imply ZMK_STUDIO_LOCKING if !ARCH_POSIX
    select CBPRINTF_LIBC_SUBSTS if ARCH_POSIX
    select SETTINGS
    select ZMK_BEHAVIOR_METADATA
    select ZMK_BEHAVIOR_LOCAL_IDS
    select RING_BUFFER
    select ZMK_KEYMAP_SETTINGS_STORAGE
    select ZMK_KEYMAP_LAYER_REORDERING
    help
      Add firmware support for studio RPC protocol

if ZMK_STUDIO_RPC

menu "Transports"

DT_CHOSEN_ZMK_STUDIO_RPC_UART := zmk,studio-rpc-uart

config ZMK_STUDIO_TRANSPORT_UART
    bool "Serial"
    select SERIAL
    select RING_BUFFER
    default y if $(dt_chosen_enabled,$(DT_CHOSEN_ZMK_STUDIO_RPC_UART))

config ZMK_STUDIO_TRANSPORT_UART_RX_STACK_SIZE
    int "RX Stack Size"
    depends on !UART_INTERRUPT_DRIVEN
    default 512

config ZMK_STUDIO_TRANSPORT_BLE
    bool "BLE (GATT)"
    select RING_BUFFER
    select BT_USER_DATA_LEN_UPDATE
    depends on ZMK_BLE
    default y

config BT_CONN_TX_MAX
    default 64 if ZMK_STUDIO_TRANSPORT_BLE

config ZMK_STUDIO_TRANSPORT_BLE_PREF_LATENCY
    int "BLE Transport preferred latency"
    default 10
    help
      When the studio UI is connected, a lower latency can be requested in order
      to make the interactions between keyboard and studio faster.

endmenu

config ZMK_STUDIO_RPC_THREAD_STACK_SIZE
    int "RPC Thread Stack Size"
    default 4096

config ZMK_STUDIO_RPC_RX_BUF_SIZE
    int "RX Buffer Size"
    default 30

config ZMK_STUDIO_RPC_TX_BUF_SIZE
    int "TX Buffer Size"
    default 64

endif

endif
```

## app/src/studio/Kconfig.defaults
```kconfig
# Copyright (c) 2024 The ZMK Contributors
# SPDX-License-Identifier: MIT

if ZMK_STUDIO

if ZMK_STUDIO_RPC

config ZMK_STUDIO_TRANSPORT_BLE_PREF_LATENCY
    default 10

config ZMK_STUDIO_RPC_THREAD_STACK_SIZE
    default 4096

config ZMK_STUDIO_RPC_RX_BUF_SIZE
    default 30

config ZMK_STUDIO_RPC_TX_BUF_SIZE
    default 64

endif # ZMK_STUDIO_RPC

endif # ZMK_STUDIO
```

## app/west.yml
```yaml
manifest:
  remotes:
    - name: zephyrproject-rtos
      url-base: https://github.com/zephyrproject-rtos
    - name: zmkfirmware
      url-base: https://github.com/zmkfirmware
    - name: petejohanson
      url-base: https://github.com/petejohanson
  projects:
    - name: zephyr
      remote: petejohanson
      revision: v4.4.1+zmk-fixes
      clone-depth: 1
      import:
        name-blocklist:
          - ci-tools
          - hal_altera
          - hal_cypress
          - hal_infineon
          - hal_microchip
          - hal_nxp
          - hal_openisa
          - hal_xtensa
          - hal_st
          - hal_ti
          - loramac-node
          - mcuboot
          - mcumgr
          - net-tools
          - openthread
          - edtt
          - trusted-firmware-m
#    - name: hal_stm32
#      revision: 4fcc3a3f32abe1c4cb76d9d1cef967728dd03908
#      path: modules/hal/stm32
#      remote: zmkfirmware
#      groups:
#        - hal
    - name: lvgl
      revision: 1cf1b2438380fe157a310a345fb4387ddbc93090
      path: modules/lib/gui/lvgl
      remote: zmkfirmware
    - name: zmk-studio-messages
      revision: 6cb4c283e76209d59c45fbcb218800cd19e9339d
      path: modules/msgs/zmk-studio-messages
      remote: zmkfirmware
  group-filter: [+optional]
  self:
    west-commands: scripts/west-commands.yml
```

## boards/arm/planck/Kconfig.defconfig
```kconfig
# Planck keyboard configuration

# Copyright (c) 2017 I-SENSE group of ICCS
# SPDX-License-Identifier: Apache-2.0

if BOARD_PLANCK_REV6

config BOARD
	default "planck_rev6"

config UART_1
	default y
	depends on UART_CONSOLE

if I2C

config I2C_1
	default y

config I2C_2
	default y

endif # I2C

if SPI

config SPI_1
	default y

config SPI_2
	default y

endif # SPI

config CAN_1
	default y
	depends on CAN

endif # BOARD_PLANCK_REV6
```

## boards/shields/petejohanson_handwire/Kconfig.defconfig
```kconfig
if SHIELD_PETEJOHANSON_HANDWIRE

config ZMK_KEYBOARD_NAME
	default "Pete's Handwire Breadboard"

config ZMK_BLE
	default y

config ZMK_ACTION_MOD_TAP
	default y

endif
```

## boards/shields/petejohanson_handwire/Kconfig.shield
```kconfig
# Copyright (c) 2019 Linaro Limited
# SPDX-License-Identifier: Apache-2.0

config SHIELD_PETEJOHANSON_HANDWIRE
	prompt "Pete Johanson Handwire"
	def_bool $(shields_list_contains,petejohanson_handwire)
```

## config/boards/shields/charybdis/Kconfig.defconfig
```kconfig
if SHIELD_CHARYBDIS_RIGHT

config ZMK_KEYBOARD_NAME
	default "Charybdis"

config ZMK_SPLIT_BLE_ROLE_CENTRAL
	default y

endif

if SHIELD_CHARYBDIS_LEFT || SHIELD_CHARYBDIS_RIGHT

config ZMK_SPLIT
	default y
	
endif
```

## config/boards/shields/charybdis/Kconfig.shield
```kconfig
config SHIELD_CHARYBDIS_LEFT
	def_bool $(shields_list_contains,charybdis_left)

config SHIELD_CHARYBDIS_RIGHT
	def_bool $(shields_list_contains,charybdis_right)
```

## config/west.yml
```yaml
manifest:
  remotes:
    - name: zmkfirmware
      url-base: https://github.com/zmkfirmware
    - name: badjeff
      url-base: https://github.com/badjeff
  projects:
    - name: zmk
      remote: zmkfirmware
      revision: main
      import: app/west.yml
    - name: zmk-pmw3610-driver
      remote: badjeff
      revision: main
  self:
    path: config
```

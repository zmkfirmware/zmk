## app/drivers/led/is31fl3733/Kconfig
```kconfig
# Copyright (c) 2020 Cameron Banna

config IS31FL3733
	bool "IS31FL3733 LED driver"
	depends on I2C
	help
	  Enable LED driver for IS31FL3733.

		The IS31FL3733 is a general purpose 12 by 16 LED
		matrix driver with 1/12 cycle rate. The device can be
		programmed via an I2C compatible interface. Each
		LED can be dimmed individually with 8-bit PWM data
		which allowing 256 steps of linear dimming

config LED_INIT_PRIORITY
	int "LED initialization priority"
	default 90
	help
	  System initialization priority for LED drivers.
	  
```

## app/drivers/led_strip/Kconfig
```kconfig
# Copyright (c) 2020 The ZMK Contributors
# SPDX-License-Identifier: MIT

rsource "is31fl3741/Kconfig"
```

## app/drivers/led_strip/Kconfig.ckled2001
```kconfig
# Copyright (c) 2022 The ZMK Contributors
# SPDX-License-Identifier: MIT

DT_COMPAT_ZMK_CKLED2001 := zmk,ckled2001

config CKLED2001
	bool "CKLED2001 compatible LED strip controller driver"
	default $(dt_compat_enabled,$(DT_COMPAT_ZMK_CKLED2001))
	depends on I2C
	depends on LED_STRIP
	help
	  Enable driver for CKLED2001 compatible LED strip controller.
```

## app/drivers/led_strip/Kconfig.composite
```kconfig
# Copyright (c) 2022 The ZMK Contributors
# SPDX-License-Identifier: MIT

DT_COMPAT_ZMK_LED_STRIP_COMPOSITE := zmk,led-strip-composite

config LED_STRIP_COMPOSITE
	bool
	default $(dt_compat_enabled,$(DT_COMPAT_ZMK_LED_STRIP_COMPOSITE))
	depends on LED_STRIP
```

## app/drivers/led_strip/is31fl3741/Kconfig
```kconfig
# Copyright (c) 2020 The ZMK Contributors
# SPDX-License-Identifier: MIT

config IS31FL3741
	bool "IS31FL3741 LED Matrix driver"
	depends on I2C
	depends on LED_STRIP
	help
		Enable an IS31FL3741 LED Matrix driver.

			The IS31FL3741 is a general purpose 39x9 LED Matrix programmed
			via an I2C compatible interface. Each LED can be dimmed
			individually with 8-bit PWM data and 8-bit scaling data which
			allows 256 steps of linear PWM dimming and 256 steps of DC current
			adjustable level.
```

## app/drivers/led_strip/is31fl3743a/Kconfig
```kconfig
# Copyright (c) 2020 The ZMK Contributors
# SPDX-License-Identifier: MIT

config IS31FL3743A
	bool "IS31FL3743A LED Matrix driver"
	depends on I2C
	help
		Enable an IS31FL3743A LED Matrix driver.

			The IS31FL3743A is a general purpose 18xn(n=1-11) LED Matrix
			programmed via 1MHz I2C compatible interface. Each LED can be
			dimmed individually with 8-bit PWM data and 8-bit DC scaling data
			which allows 256 steps of linear PWM dimming and 256 steps of DC
			current adjustable levels.

config LED_STRIP_INIT_PRIORITY
	int "LED strip initialization priority"
	default 90
	help
		System initialization priority for LED strip drivers.
```

## app/drivers/sensor/Kconfig
```kconfig
# Copyright (c) 2020 The ZMK Contributors
# SPDX-License-Identifier: MIT

rsource "battery/Kconfig"
rsource "ec11/Kconfig"
rsource "trackball_pim447/Kconfig"
```

## app/drivers/sensor/battery/Kconfig
```kconfig
# Copyright (c) 2020-2021 The ZMK Contributors
# SPDX-License-Identifier: MIT

DT_COMPAT_ZMK_BATTERY_NRF_VDDH := zmk,battery-nrf-vddh
DT_COMPAT_ZMK_BATTERY_VOLTAGE_DIVIDER := zmk,battery-voltage-divider

config ZMK_BATTERY
    bool "ZMK battery monitoring"
    help
        Enable battery monitoring

config ZMK_BATTERY_NRF_VDDH
    bool
    default $(dt_compat_enabled,$(DT_COMPAT_ZMK_BATTERY_NRF_VDDH))
    select ADC
    select ZMK_BATTERY
    depends on SENSOR
    help
        Enable ZMK nRF VDDH voltage driver for battery monitoring.

config ZMK_BATTERY_VOLTAGE_DIVIDER
    bool
    default $(dt_compat_enabled,$(DT_COMPAT_ZMK_BATTERY_VOLTAGE_DIVIDER))
    select ADC
    select ZMK_BATTERY
    depends on SENSOR
    help
        Enable ZMK battery voltage divider driver for battery monitoring.
```

## app/drivers/sensor/battery_voltage_divider/Kconfig
```kconfig
# Copyright (c) 2020 The ZMK Contributors
# SPDX-License-Identifier: MIT

config ZMK_BATTERY_VOLTAGE_DIVIDER
	bool "ZMK battery voltage divider"
	select ADC
	help
		Enable ZMK battery voltage divider driver for battery monitoring.
```

## app/drivers/sensor/cirque_trackpad/Kconfig
```kconfig
# Copyright (c) 2022 The ZMK Contributors
# SPDX-License-Identifier: MIT

menuconfig PINNACLE
	bool "PINNACLE Incremental Encoder Sensor"
	depends on GPIO
	depends on SPI
	help
	  Enable driver for Cirque Pinnacle trackpads

if PINNACLE

choice
	prompt "Trigger mode"
	default PINNACLE_TRIGGER_NONE
	help
	  Specify the type of triggering to be used by the driver.

config PINNACLE_TRIGGER_NONE
	bool "No trigger"

config PINNACLE_TRIGGER_GLOBAL_THREAD
	bool "Use global thread"
	depends on GPIO
	select PINNACLE_TRIGGER

config PINNACLE_TRIGGER_OWN_THREAD
	bool "Use own thread"
	depends on GPIO
	select PINNACLE_TRIGGER

endchoice

config PINNACLE_TRIGGER
	bool

config PINNACLE_THREAD_PRIORITY
	int "Thread priority"
	depends on PINNACLE_TRIGGER_OWN_THREAD
	default 10
	help
	  Priority of thread used by the driver to handle interrupts.

config PINNACLE_THREAD_STACK_SIZE
	int "Thread stack size"
	depends on PINNACLE_TRIGGER_OWN_THREAD
	default 1024
	help
	  Stack size of thread used by the driver to handle interrupts.

endif # PINNACLE
```

## app/drivers/sensor/joystick/Kconfig
```kconfig
# Copyright (c) 2020 The ZMK Contributors
# SPDX-License-Identifier: MIT

menuconfig JOYSTICK
	bool "JOYSTICK Analogue Sensor"
	select ADC
	help
	  Enable driver for Joystick analogue sensors.
```

## app/drivers/sensor/ma730/Kconfig
```kconfig
config MA730
	bool "MA730 Angular position sensor"
	depends on SPI
	help
	  Enable angular encoder sensor

		The MA730 is a 16-bit contactless magnetic encoder, communicating over spi
```

## app/drivers/sensor/max17048/Kconfig
```kconfig
# Copyright (c) 2022 The ZMK Contributors
# SPDX-License-Identifier: MIT

config MAX17048
	bool "MAX17048 Fuel Gauge"
	depends on I2C
	help
	  Enable I2C-based driver for MAX17048/9 Fuel Gauge. Supports measuring
	  battery voltage and state-of-charge.
```

## app/drivers/sensor/pmw3389/Kconfig
```kconfig
config PMW3389
	bool "PMW3389 Mouse Sensor"
	depends on SPI
	help
	  Enable mouse sensor

		The PMW3389 is a 16-bit optical mouse sensor

if PMW3389

choice
	prompt "Trigger mode"
	default PMW3389_TRIGGER_NONE
	help
	  Specify the type of triggering to be used by the driver.

config PMW3389_TRIGGER_NONE
	bool "No trigger"

config PMW3389_TRIGGER_GLOBAL_THREAD
	bool "Use global thread"
	depends on GPIO
	select PMW3389_TRIGGER

config PMW3389_TRIGGER_OWN_THREAD
	bool "Use own thread"
	depends on GPIO
	select PMW3389_TRIGGER

endchoice

config PMW3389_TRIGGER
	bool

config PMW3389_THREAD_PRIORITY
	int "Thread priority"
	depends on PMW3389_TRIGGER_OWN_THREAD
	default 10
	help
	  Priority of thread used by the driver to handle interrupts.

config PMW3389_THREAD_STACK_SIZE
	int "Thread stack size"
	depends on PMW3389_TRIGGER_OWN_THREAD
	default 1024
	help
	  Stack size of thread used by the driver to handle interrupts.

endif # PMW3389
```

## app/drivers/sensor/pmw33xx/Kconfig
```kconfig
# Copyright (c) 2022 The ZMK Contributors
# SPDX-License-Identifier: MIT
config PMW33XX
	bool "PMW33XX Mouse Sensor"
	depends on SPI
	help
	  Enable mouse sensor

		The PMW33XX is a 16-bit optical mouse sensor

if PMW33XX
choice
	prompt "Sensor"
	default PMW33XX_3360

	config PMW33XX_3360
		bool "Enable PMW3360"

	config PMW33XX_3389
		bool "Enable PMW3389"
		help
		  PMW3389 requires an external srom included in `pmw3389_srom.h` which we cannot currently include in zmk
endchoice

config PMW33XX_3389_SROM_INCLUDE_DIR
	string "PMW3389 SROM Include Dir"
	default "."
	help
		directory where the header with the pmw3389 srom file is located

choice
	prompt "Trigger mode"
	default PMW33XX_TRIGGER_NONE
	help
	  Specify the type of triggering to be used by the driver.

config PMW33XX_TRIGGER_NONE
	bool "No trigger"

config PMW33XX_TRIGGER_GLOBAL_THREAD
	bool "Use global thread"
	depends on GPIO
	select PMW33XX_TRIGGER

config PMW33XX_TRIGGER_OWN_THREAD
	bool "Use own thread"
	depends on GPIO
	select PMW33XX_TRIGGER

endchoice

config PMW33XX_TRIGGER
	bool

config PMW33XX_THREAD_PRIORITY
	int "Thread priority"
	depends on PMW33XX_TRIGGER_OWN_THREAD
	default 10
	help
	  Priority of thread used by the driver to handle interrupts.

config PMW33XX_THREAD_STACK_SIZE
	int "Thread stack size"
	depends on PMW33XX_TRIGGER_OWN_THREAD
	default 1024
	help
	  Stack size of thread used by the driver to handle interrupts.

endif # PMW33XX
```

## app/drivers/sensor/trackball_pim447/Kconfig
```kconfig
# Copyright (c) 2021 The ZMK Contributors
# SPDX-License-Identifier: MIT

config ZMK_TRACKBALL_PIM447
	bool "ZMK PIM447 trackball"
	depends on I2C
	help
	  Enable I2C-based driver for Pimoroni PIM447 trackball.
```

## app/drivers/zephyr/Kconfig
```kconfig
config ZMK_KSCAN_GPIO_DRIVER
	bool "Enable GPIO kscan driver to simulate key presses"
	default y
	select GPIO

if ZMK_KSCAN_GPIO_DRIVER

config ZMK_KSCAN_MATRIX_POLLING
	bool "Poll for key event triggers instead of using interrupts on matrix boards."
	default n

config ZMK_KSCAN_DIRECT_POLLING
	bool "Poll for key event triggers instead of using interrupts on direct wired boards."
    default n

endif

config ZMK_KSCAN_INIT_PRIORITY
	int "Keyboard scan driver init priority"
	default 40
	help
	  Keyboard scan device driver initialization priority.

menuconfig EC11
	bool "EC11 Incremental Encoder Sensor"
	depends on GPIO
	help
	  Enable driver for EC11 incremental encoder sensors.

if EC11

choice
	prompt "Trigger mode"
	default EC11_TRIGGER_NONE
	help
	  Specify the type of triggering to be used by the driver.

config EC11_TRIGGER_NONE
	bool "No trigger"

config EC11_TRIGGER_GLOBAL_THREAD
	bool "Use global thread"
	depends on GPIO
	select EC11_TRIGGER

config EC11_TRIGGER_OWN_THREAD
	bool "Use own thread"
	depends on GPIO
	select EC11_TRIGGER

endchoice

config EC11_TRIGGER
	bool

config EC11_THREAD_PRIORITY
	int "Thread priority"
	depends on EC11_TRIGGER_OWN_THREAD
	default 10
	help
	  Priority of thread used by the driver to handle interrupts.

config EC11_THREAD_STACK_SIZE
	int "Thread stack size"
	depends on EC11_TRIGGER_OWN_THREAD
	default 1024
	help
	  Stack size of thread used by the driver to handle interrupts.

endif # EC11
```

## app/drivers/zephyr/dts/bindings/alps,ec11.yaml
```yaml
description: |
  Sensor driver for the Alps EC11 rotary encoder

compatible: "alps,ec11"

properties:
  label:
    type: string
    required: true
  a-gpios:
    type: phandle-array
    required: true
    description: A pin for the encoder
  b-gpios:
    type: phandle-array
    required: true
    description: A pin for the encoder
  resolution:
    type: int
    description: Number of pulses per tick
    required: false
```

## app/drivers/zephyr/dts/bindings/alps,en11.yaml
```yaml
description: |
  Sensor driver for the Alps en11 rotary encoder

compatible: "alps,en11"

properties:
  label:
    type: string
    required: true
  a-gpios:
    type: phandle-array
    required: true
    description: A pin for the encoder
  b-gpios:
    type: phandle-array
    required: true
    description: A pin for the encoder
```

## app/drivers/zephyr/dts/bindings/gpio/maxim,max7318.yaml
```yaml
#
# Copyright (c) 2022 The ZMK Contributors
#
# SPDX-License-Identifier: MIT
#

description: >
    This is a representation of the Maxim MAX7318 I2C Gpio Expander.

compatible: "maxim,max7318"

include: [gpio-controller.yaml, i2c-device.yaml]

properties:
    label:
      required: true

    "#gpio-cells":
      const: 2

    ngpios:
      type: int
      required: true
      const: 16
      description: Number of gpios supported

gpio-cells:
  - pin
  - flags
```

## app/drivers/zephyr/dts/bindings/gpio/microchip,mcp23017.yaml
```yaml
#
# Copyright (c) 2020 Geanix ApS
#
# SPDX-License-Identifier: Apache-2.0
#

description: >
    This is a representation of the Microchip MCP23017 I2C Gpio Expander.

compatible: "microchip,mcp23017"

include: [gpio-controller.yaml, i2c-device.yaml]

properties:
    label:
      required: true

    "#gpio-cells":
      const: 2

    ngpios:
      type: int
      required: true
      const: 16
      description: Number of gpios supported

gpio-cells:
  - pin
  - flags
```

## app/drivers/zephyr/dts/bindings/gpio/zmk,gpio-165.yaml
```yaml
#
# Copyright (c) 2022 The ZMK Contributors
#
# SPDX-License-Identifier: MIT
#

description: >
  This is a representation of the 165 Parrallel-in Shift Register.

compatible: "zmk,gpio-165"

include: [gpio-controller.yaml, spi-device.yaml]

properties:
  "#gpio-cells":
    const: 2

  ngpios:
    type: int
    required: true
    enum:
      - 8
      - 16
      - 24
      - 32
    description: Number of gpios supported

  load-gpios:
    type: phandle-array
    description: GPIO to which the /PL a.k.a. SH/LD pin is connected

gpio-cells:
  - pin
  - flags
```

## app/drivers/zephyr/dts/bindings/gpio/zmk,gpio-595.yaml
```yaml
#
# Copyright (c) 2022 The ZMK Contributors
#
# SPDX-License-Identifier: MIT
#

description: >
  This is a representation of the 595 Shift Register.

compatible: "zmk,gpio-595"

include: [gpio-controller.yaml, spi-device.yaml]

properties:
  "#gpio-cells":
    const: 2

  ngpios:
    type: int
    required: true
    enum:
      - 8
      - 16
      - 24
      - 32
    description: Number of gpios supported

gpio-cells:
  - pin
  - flags
```

## app/drivers/zephyr/dts/bindings/kscan/zmk,kscan-gpio-matrix.yaml
```yaml
# Copyright (c) 2020, Pete Johanson
# SPDX-License-Identifier: MIT

description: GPIO keyboard matrix controller

compatible: "zmk,kscan-gpio-matrix"

include: kscan.yaml

properties:
  row-gpios:
    type: phandle-array
    required: true
  col-gpios:
    type: phandle-array
    required: true
  debounce-period:
    type: int
    default: 5
    description: Debounce time in milliseconds
  poll-period-ms:
    type: int
    default: 10
    description: Time between reads in milliseconds when polling is enabled
  diode-direction:
    type: string
    default: row2col
    enum:
      - row2col
      - col2row
```

## app/drivers/zephyr/dts/bindings/kscan/zmk,kscan-gpio-round-robin-matrix.yaml
```yaml
# Copyright (c) 2022 The ZMK Contributors
# SPDX-License-Identifier: MIT

description: GPIO keyboard improved square matrix controller

compatible: "zmk,kscan-gpio-round-robin-matrix"

include: kscan.yaml

properties:
  input-gpios:
    type: phandle-array
    required: true
  output-gpios:
    type: phandle-array
    required: true
  debounce-press-ms:
    type: int
    default: 5
    description: Debounce time for key press in milliseconds. Use 0 for eager debouncing.
  debounce-release-ms:
    type: int
    default: 5
    description: Debounce time for key release in milliseconds.
  poll-period-ms:
    type: int
    default: 1
    description: Time between reads in milliseconds
```

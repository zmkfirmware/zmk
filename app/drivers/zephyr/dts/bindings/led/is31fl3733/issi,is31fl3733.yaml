## app/drivers/zephyr/dts/bindings/led/is31fl3733/issi,is31fl3733.yaml
```yaml
description: |
  Driver for the is31fl3733 LED driver

compatible: "issi,is31fl3733"

include: i2c-device.yaml
```

## app/drivers/zephyr/dts/bindings/led_strip/zmk,ckled2001.yaml
```yaml
# Copyright (c) 2022 The ZMK Contributors
# SPDX-License-Identifier: MIT

description: CKLED2001 LED strip controller

compatible: "zmk,ckled2001"

include: [i2c-device.yaml]

properties:
  label:
    type: string
    required: true

  chain-length:
    type: int
    required: true

  scan-phase-channels:
    type: int
    default: 12
    enum:
      - 1
      - 2
      - 3
      - 4
      - 5
      - 6
      - 7
      - 8
      - 9
      - 10
      - 11
      - 12

  map:
    type: array
    required: true
```

## app/drivers/zephyr/dts/bindings/led_strip/zmk,led-strip-composite.yaml
```yaml
# Copyright (c) 2022 The ZMK Contributors
# SPDX-License-Identifier: MIT

description: Composing multiple LED strip devices into one virtual device

compatible: "zmk,led-strip-composite"

properties:
  label:
    type: string
    required: true

  chain-length:
    type: int
    required: true

child-binding:
  description: "Details of an included led_strip devices"
  properties:
    led-strip:
      type: phandle
      required: true
```

## app/drivers/zephyr/dts/bindings/sensor/cirque,pinnacle-common.yaml
```yaml
properties:
  dr-gpios:
    type: phandle-array
    description: Data ready pin for the trackpad
  rotate-90:
    type: boolean
  sleep:
    type: boolean
  no-taps:
    type: boolean
```

## app/drivers/zephyr/dts/bindings/sensor/cirque,pinnacle-i2c.yaml
```yaml
description: |
  Sensor driver for the Cirque Pinnacle trackpad ASICs, using the I2C interface

compatible: "cirque,pinnacle"

include: ["i2c-device.yaml", "cirque,pinnacle-common.yaml"]
```

## app/drivers/zephyr/dts/bindings/sensor/cirque,pinnacle-spi.yaml
```yaml
description: |
  Sensor driver for the Cirque Pinnacle trackpad ASICs, using the SPI interface

compatible: "cirque,pinnacle"

include: ["spi-device.yaml", "cirque,pinnacle-common.yaml"]
```

## app/drivers/zephyr/dts/bindings/sensor/cirque,pinnacle.yaml
```yaml
description: |
  Sensor driver for the Cirque Pinnacle trackpad ASICs

compatible: "cirque,pinnacle"

include: base.yaml

on-bus: spi

properties:
  spi-max-frequency:
    type: int
    required: true
    description: |
      Maximum SPI clock speed supported by the device, in Hz.
  dr-gpios:
    type: phandle-array
    required: true
    description: Data ready pin for the trackpad
  invert-x:
    type: boolean
  invert-y:
    type: boolean
  sleep:
    type: boolean
  no-taps:
    type: boolean
```

## app/drivers/zephyr/dts/bindings/sensor/joystick.yaml
```yaml
description: |
  Sensor driver for analog joysticks

compatible: "joystick"

properties:
  label:
    type: string
    required: true
  io-channels:
    type: phandle-array
    required: true
    description: Analog pins for decoder
  resolution:
    type: int
    required: false
    description: Affects how much movement is required for inc_dec keypresses
  frequency:
    type: int
    required: false
    description: How often to poll per second
  min_on:
    type: int
    required: false
    description: If the sensor is above this, then it is treated as on
  reverse:
    type: boolean
    required: false
    description: If true, then negative values are down/right    
```

## app/drivers/zephyr/dts/bindings/sensor/pimoroni,trackball_pim447.yaml
```yaml
# Copyright (c) 2021 The ZMK Contributors
# SPDX-License-Identifier: MIT

description: Trackball PIM447

compatible: "pimoroni,trackball_pim447"

properties:
  label:
    type: string
    required: true

  reg:
    type: int
    required: true

  move-factor:
    type: int
    required: false
    default: 1

  invert-move-x:
    type: boolean
    required: false

  invert-move-y:
    type: boolean
    required: false

  button:
    type: int
    required: false
    default: 0

  swap-axes:
    type: boolean
    required: false

  scroll-divisor:
    type: int
    required: false
    default: 2

  invert-scroll-x:
    type: boolean
    required: false

  invert-scroll-y:
    type: boolean
    required: false

  mode:
    type: int
    required: false
    default: 1
    enum:
      - 1
      - 2
```

## app/drivers/zephyr/dts/bindings/sensor/pixart,pmw3389.yaml
```yaml
description: |
  Sensor driver for the pixart PMW3389 optical mouse sensor
compatible: "pixart,pmw3389"

include: spi-device.yaml

properties:
  label:
    type: string
    required: true
  motswk-gpios:
    type: phandle-array
    required: false
    description: interrupt pin for motion
  reset-gpios:
    type: phandle-array
    required: false
    description: A pin for the encoder
  resolution:
    type: int
    description: mouse resolution
    required: false
```

## app/drivers/zephyr/dts/bindings/sensor/pixart,pmw33xx.yaml
```yaml
description: |
  Sensor driver for the pixart PMW33XX optical mouse sensor supports 3360 built in, and 3389 with external srom
compatible: "pixart,pmw33xx"

include: spi-device.yaml

properties:
  label:
    type: string
    required: true
  cs-gpios:
    type: phandle-array
    required: true
    description: chip select pin for the sensor
  motswk-gpios:
    type: phandle-array
    required: false
    description: interrupt pin for motion
  cpi:
    type: int
    description: mouse cpi
    required: false
  disable-rest:
    type: boolean
    description: disables mouse rest mode, will decrease battery life
    required: false
```

## app/drivers/zephyr/dts/bindings/sensor/zmk,battery-voltage-divider.yaml
```yaml
# Copyright (c) 2020 The ZMK Contributors
# SPDX-License-Identifier: MIT

description: Battery SoC monitoring using voltage divider

compatible: "zmk,battery-voltage-divider"

include: voltage-divider.yaml

properties:
  label:
    required: true
    type: string
```

## app/drivers/zephyr/dts/bindings/zmk,kscan-gpio-direct.yaml
```yaml
# Copyright (c) 2020, Pete Johanson
# SPDX-License-Identifier: MIT

description: Direct GPIO keyboard KSCAN controller

compatible: "zmk,kscan-gpio-direct"

include: kscan.yaml

properties:
  input-gpios:
    type: phandle-array
    required: true
  debounce-period:
    type: int
    default: 5
```

## app/dts/bindings/animations/animation_base.yaml
```yaml
# Copyright (c) 2020, The ZMK Contributors
# SPDX-License-Identifier: MIT

properties:
  pixels:
    type: array
    required: true
    description: |
      Pixel positions to which the animation should apply.

  blending-mode:
    type: string
    enum:
      - "normal"
      - "multiply"
      - "lighten"
      - "darken"
      - "screen"
      - "subtract"
    default: "normal"
    description: |
      Blending mode for the animation to use during render.
```

## app/dts/bindings/animations/zmk,animation-compose.yaml
```yaml
# Copyright (c) 2020, The ZMK Contributors
# SPDX-License-Identifier: MIT

description: |
  Higher-order animation which allows for composing other animation
  drivers and using different blending modes.

compatible: "zmk,animation-compose"

properties:
  animations:
    type: phandles
    required: true
    description: |
      Animations to be combined.
```

## app/dts/bindings/animations/zmk,animation-control.yaml
```yaml
# Copyright (c) 2020, The ZMK Contributors
# SPDX-License-Identifier: MIT

description: |
  Higher-order animation which allows for controlling animation drivers
  placed underneath it by turning them on and off, cycling though them,
  or changing the brightness.

compatible: "zmk,animation-control"

properties:
  animations:
    type: phandles
    required: true
    description: |
      Animations to be combined.

  brightness-steps:
    type: int
    required: false
    default: 5
    description: |
      How many brightness steps should be supported.
```

## app/dts/bindings/animations/zmk,animation-ripple.yaml
```yaml
# Copyright (c) 2020, The ZMK Contributors
# SPDX-License-Identifier: MIT

description: |
  Animated 'ripples' trigered by key presses.

compatible: "zmk,animation-ripple"

include: animation_base.yaml

properties:
  label:
    type: string
    required: true

  duration:
    type: int
    required: false
    default: 1000
    description: |
      Approximate ripple travel time in milliseconds.

  color:
    type: int
    required: true
    description: |
      Ripple color.

  buffer-size:
    type: int
    default: 10
    description: |
      This will limit how many keystroke events the animation is able to track
      at the same time. Depending on how fast you type and the animation duration
      you might need to increase this number.

  ripple-width:
    type: int
    default: 25
    description: |
      This setting determines the thickness of the ripple 'ring'.
      Think of it as antialiasing. The further apart the pixels are, or if they're
      spaced irregularly, the larger this number should be. Otherwise the animation
      will look uneven or LEDs might not light up at all.
      The effect is especially pronounced when lowering the effect duration or running
      low FPS.
```

## app/dts/bindings/animations/zmk,animation-solid.yaml
```yaml
# Copyright (c) 2020, The ZMK Contributors
# SPDX-License-Identifier: MIT

description: |
  Animation for displaying solid colors across the entire area

compatible: "zmk,animation-solid"

include: animation_base.yaml

properties:
  label:
    type: string
    required: true

  duration:
    type: int
    required: false
    default: 5
    description: |
      Animation duration in seconds.
      This is the time it takes for the animation to complete a full cycle and return to the original color.
      Ignored if only a single color is given.

  colors:
    type: array
    required: true
    description: |
      The colors to cycle through during the animation.
```

## app/dts/bindings/behaviors/behavior-metadata.yaml
```yaml
# Copyright (c) 2024 The ZMK Contributors
# SPDX-License-Identifier: MIT

properties:
  display-name:
    type: string
```

## app/dts/bindings/behaviors/binding_params.yaml
```yaml
# Copyright (c) 2024 The ZMK Contributors
# SPDX-License-Identifier: MIT

properties:
  binding-params:
    type: array
```

## app/dts/bindings/behaviors/macro_base.yaml
```yaml
# Copyright (c) 2022 The ZMK Contributors
# SPDX-License-Identifier: MIT

properties:
  bindings:
    type: phandle-array
    required: true
  wait-ms:
    type: int
    description: The default time to wait (in milliseconds) before triggering the next behavior in the macro bindings list.
  tap-ms:
    type: int
    description: The default time to wait (in milliseconds) between the press and release events on a tapped macro behavior binding
  timeout-ms:
    type: int
    description: The time to wait (in milliseconds) before starting the macro for the first time.
    default: 0
  period-ms:
    type: int
    description: The time to wait (in milliseconds) before repeating the macro.
    default: 0
```

## app/dts/bindings/behaviors/mod_morph_base.yaml
```yaml
# Copyright (c) 2024 The ZMK Contributors
# SPDX-License-Identifier: MIT

properties:
  bindings:
    type: phandle-array
    required: true
  mods:
    type: int
    required: true
  keep-mods:
    type: int
    required: false
```

## app/dts/bindings/behaviors/one_param.yaml
```yaml
# Copyright (c) 2020 The ZMK Contributors
# SPDX-License-Identifier: MIT

include: behavior-metadata.yaml

properties:
  label:
    type: string
    required: false
    deprecated: true
  "#binding-cells":
    type: int
    required: true
    const: 1

binding-cells:
  - param1
```

## app/dts/bindings/behaviors/tap_dance_base.yaml
```yaml
# Copyright (c) 2024 The ZMK Contributors
# SPDX-License-Identifier: MIT

properties:
  bindings:
    type: phandle-array
    required: true
  tapping-term-ms:
    type: int
    default: 200
```

## app/dts/bindings/behaviors/turbo_base.yaml
```yaml
# Copyright (c) 2025 The ZMK Contributors
# SPDX-License-Identifier: MIT

properties:
  bindings:
    type: phandle-array
    required: true
  wait-ms:
    type: int
    default: 200
  tap-ms:
    type: int
    default: 5
  toggle-term-ms:
    type: int
    default: -1
```

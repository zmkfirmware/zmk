#include <dt-bindings/zmk/keys.h>
#include <behaviors.dtsi>
#include <dt-bindings/zmk/kscan_mock.h>
#include "../behavior_keymap.dtsi"

&kscan {
	events = <
        //ZMK_MOCK_PRESS(  0,1,10)
		//ZMK_MOCK_RELEASE(0,1,10)

		ZMK_MOCK_PRESS(  1,2,10)
		ZMK_MOCK_PRESS(  1,3,10)
		ZMK_MOCK_PRESS(  1,7,10)
        ZMK_MOCK_RELEASE(1,7,10)
		ZMK_MOCK_RELEASE(1,2,10)
		ZMK_MOCK_RELEASE(1,3,10)
	>;
};

#include <dt-bindings/zmk/input_matrix_mock.h>

#include "shared.dtsi"

&matrix {
    events = <>;

    /delete-property/ exit-after;
};

&mock_encoder {
    status = "okay";

    event-startup-delay = <2000>;
    event-period = <2000>;
    events = <18 (-18)>;
};

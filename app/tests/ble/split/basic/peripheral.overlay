
#include <dt-bindings/zmk/input_matrix_mock.h>


&matrix {
    events =
    <ZMK_MOCK_RELEASE(0,0,5000)
    ZMK_MOCK_PRESS(0,0,5000)
    ZMK_MOCK_RELEASE(0,0,200)
    ZMK_MOCK_PRESS(0,1,10)
    ZMK_MOCK_RELEASE(0,1,2000)>;
};

/*
 * Copyright (c) 2022 The ZMK Contributors
 *
 * SPDX-License-Identifier: MIT
 */

#include <dt-bindings/zmk/keys.h>
#include <behaviors.dtsi>
#include <dt-bindings/zmk/kscan_mock.h>
#include "../behavior_keymap.dtsi"

&kscan {
    events = <
        ZMK_MOCK_PRESS(0,0,10) ZMK_MOCK_RELEASE(0,0,20)
        ZMK_MOCK_PRESS(0,3,30) ZMK_MOCK_RELEASE(0,3,40)
        ZMK_MOCK_PRESS(0,2,50) ZMK_MOCK_RELEASE(0,2,60)
        ZMK_MOCK_PRESS(0,1,70) ZMK_MOCK_RELEASE(0,1,80)
    >;
};

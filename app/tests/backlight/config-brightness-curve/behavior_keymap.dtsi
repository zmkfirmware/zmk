#include "../behavior_keymap.dtsi"

&kscan {
    events = <
        /* BL_DEC */
        ZMK_MOCK_PRESS(0,1,10)
        ZMK_MOCK_RELEASE(0,1,10)
        /* BL_DEC */
        ZMK_MOCK_PRESS(0,1,10)
        ZMK_MOCK_RELEASE(0,1,10)
        /* BL_DEC */
        ZMK_MOCK_PRESS(0,1,10)
        ZMK_MOCK_RELEASE(0,1,10)
        /* BL_DEC */
        ZMK_MOCK_PRESS(0,1,10)
        ZMK_MOCK_RELEASE(0,1,10)
        /* BL_DEC */
        ZMK_MOCK_PRESS(0,1,10)
        ZMK_MOCK_RELEASE(0,1,10)
        /* BL_DEC */
        ZMK_MOCK_PRESS(0,1,10)
        ZMK_MOCK_RELEASE(0,1,10)
        /* BL_DEC */
        ZMK_MOCK_PRESS(0,1,10)
        ZMK_MOCK_RELEASE(0,1,10)
        /* BL_DEC */
        ZMK_MOCK_PRESS(0,1,10)
        ZMK_MOCK_RELEASE(0,1,10)
        /* BL_DEC */
        ZMK_MOCK_PRESS(0,1,10)
        ZMK_MOCK_RELEASE(0,1,10)
        /* BL_DEC */
        ZMK_MOCK_PRESS(0,1,10)
        ZMK_MOCK_RELEASE(0,1,10)
    >;
};

#include <dt-bindings/zmk/keys.h>
#include <behaviors.dtsi>
#include <dt-bindings/zmk/kscan_mock.h>
#include "../behavior_keymap.dtsi"

// Test removing layer 1
&kscan {
    events = <
    // remove layer 1
    ZMK_MOCK_PRESS(1,0,10)
    ZMK_MOCK_RELEASE(1,0,10)
    // toggle layer 1 on
    ZMK_MOCK_PRESS(0,1,10)
    ZMK_MOCK_RELEASE(0,1,10)
    // press position 0,0 - should output A (layer 0) because layer 1 was removed
    ZMK_MOCK_PRESS(0,0,10)
    ZMK_MOCK_RELEASE(0,0,10)
    // toggle layer 2 on
    ZMK_MOCK_PRESS(1,1,10)
    ZMK_MOCK_RELEASE(1,1,10)
    // press position 0,0 - should output C (layer 2)
    ZMK_MOCK_PRESS(0,0,10)
    ZMK_MOCK_RELEASE(0,0,10)
    >;
};

#include <dt-bindings/zmk/keys.h>
#include <behaviors.dtsi>
#include <dt-bindings/zmk/kscan_mock.h>
#include "../behavior_keymap.dtsi"

&kscan {
    events = <
        /* press non-exclude key (pos 3), then quickly press ht_a (pos 0) */
        /* quick-tap deferred because exclude list is configured */
        /* then press exclude key (pos 2, in ht_a exclude list) in combo */
        /* expect: quick-tap bypassed, normal tap-unless-interrupted decision: hold on other-key-down */
        ZMK_MOCK_PRESS(1,1,10)
        ZMK_MOCK_RELEASE(1,1,10)
        ZMK_MOCK_PRESS(0,0,10)
        ZMK_MOCK_PRESS(1,0,10)
        ZMK_MOCK_RELEASE(1,0,10)
        ZMK_MOCK_RELEASE(0,0,10)
        /* press non-exclude key (pos 3), then quickly press ht_a (pos 0) */
        /* quick-tap deferred */
        /* then press non-exclude key (pos 3) in combo */
        /* expect: deferred quick-tap fires, ht_a resolves as tap */
        ZMK_MOCK_PRESS(1,1,10)
        ZMK_MOCK_RELEASE(1,1,10)
        ZMK_MOCK_PRESS(0,0,10)
        ZMK_MOCK_PRESS(1,1,400)
        ZMK_MOCK_RELEASE(1,1,10)
        ZMK_MOCK_RELEASE(0,0,10)
    >;
};

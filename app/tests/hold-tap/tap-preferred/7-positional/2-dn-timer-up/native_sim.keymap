#include <dt-bindings/zmk/keys.h>
#include <behaviors.dtsi>
#include <dt-bindings/zmk/input_matrix_mock.h>
#include "../behavior_keymap.dtsi"

&matrix {
    events = <
        ZMK_MOCK_PRESS(0,0,500)
        ZMK_MOCK_RELEASE(0,0,10)
    >;
};
#include <dt-bindings/zmk/keys.h>
#include <behaviors.dtsi>
#include <dt-bindings/zmk/kscan_mock.h>
#include "../behavior_keymap.dtsi"

&kscan {
	events = <
		ZMK_MOCK_PRESS(0,0,100) /* cht pressed */
		ZMK_MOCK_PRESS(1,0,100) /* disabled other key pressed */
		ZMK_MOCK_RELEASE(1,0,100) /* disabled other key released */
		ZMK_MOCK_PRESS(0,1,100) /* enabled other key pressed */
		ZMK_MOCK_RELEASE(0,1,100) /* enabled other key released */
		ZMK_MOCK_RELEASE(0,0,10) /* cht released */
		/* timer fires */ 
	>;
};

/*
 * Copyright (c) 2024 The ZMK Contributors
 *
 * SPDX-License-Identifier: MIT
 */

/ {
    chosen {
        zephyr,console = &snippet_zmk_usb_logging_uart;
        zephyr,shell-uart = &snippet_zmk_usb_logging_uart;
    };
};

&zephyr_udc0 {
    snippet_zmk_usb_logging_uart: snippet_zmk_usb_logging_uart {
        compatible = "zephyr,cdc-acm-uart";
    };
};

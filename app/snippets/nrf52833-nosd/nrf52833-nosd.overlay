/*
 * Copyright (c) 2024 The ZMK Contributors
 *
 * SPDX-License-Identifier: MIT
 */

/delete-node/ &sd_partition;
/delete-node/ &code_partition;

&flash0 {
    partitions {
        sd_partition: partition@0 {
            reg = <0x0 DT_SIZE_K(4)>;
        };
        code_partition: partition@1000 {
            reg = <DT_SIZE_K(4) DT_SIZE_K(428)>;
        };
        /*
         * 32KB storage partition at 0x6c000 is unchanged
         */
    };
};

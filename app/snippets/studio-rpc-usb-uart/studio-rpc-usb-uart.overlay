/*
 * Copyright (c) 2024 The ZMK Contributors
 *
 * SPDX-License-Identifier: MIT
 */

/ {
    chosen {
        zmk,studio-rpc-uart = &snippet_studio_rpc_usb_uart;
    };
};

&zephyr_udc0 {
    snippet_studio_rpc_usb_uart: snippet_studio_rpc_usb_uart {
        compatible = "zephyr,cdc-acm-uart";
    };
};


/*
 * Copyright (c) 2024 The ZMK Contributors
 *
 * SPDX-License-Identifier: MIT
 */

/ {
    key_physical_attrs: key_physical_attrs {
        compatible = "zmk,key-physical-attrs";

        #key-cells = <7>;
    };
};
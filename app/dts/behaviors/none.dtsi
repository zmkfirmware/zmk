/*
 * Copyright (c) 2020 The ZMK Contributors
 *
 * SPDX-License-Identifier: MIT
 */

#include <dt-bindings/zmk/behaviors.h>

/ {
    behaviors {
#if ZMK_BEHAVIOR_OMIT(NONE)
        /omit-if-no-ref/
#endif
        none: none {
            compatible = "zmk,behavior-none";
            #binding-cells = <0>;
            display-name = "None";
        };
    };
};

/*
 * Copyright (c) 2020 The ZMK Contributors
 *
 * SPDX-License-Identifier: MIT
 */

/ {
    behaviors {
        // Behavior can be invoked on peripherals, so name must be <= 8 characters
        // and cannot be /omit-if-no-ref/
        rgb_ug: rgb_ug {
            compatible = "zmk,behavior-rgb-underglow";
            #binding-cells = <2>;
        };
    };
};

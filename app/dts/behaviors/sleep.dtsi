/*
 * Copyright (c) 2020 The ZMK Contributors
 *
 * SPDX-License-Identifier: MIT
 */

/ {
	behaviors {
		/omit-if-no-ref/ sleep: behavior_sleep {
			compatible = "zmk,behavior-sleep";
			label = "SLEEP";
			#binding-cells = <0>;
		};
	};
};

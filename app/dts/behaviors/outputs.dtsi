/*
 * Copyright (c) 2020 The ZMK Contributors
 *
 * SPDX-License-Identifier: MIT
 */

#include <dt-bindings/zmk/behaviors.h>

/ {
    behaviors {
#if ZMK_BEHAVIOR_OMIT(OUT)
        /omit-if-no-ref/
#endif
        out: outputs {
            compatible = "zmk,behavior-outputs";
            #binding-cells = <1>;
            display-name = "Output Selection";
        };
    };
};

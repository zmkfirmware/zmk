/*
 * Copyright (c) 2024 The ZMK Contributors
 *
 * SPDX-License-Identifier: MIT
 */

#include <dt-bindings/zmk/behaviors.h>
#include <dt-bindings/zmk/keys.h>
#include <dt-bindings/zmk/hid_usage.h>
#include <dt-bindings/zmk/hid_usage_pages.h>

/ {
    behaviors {
#if ZMK_BEHAVIOR_OMIT(SNAP_TAP)
        /omit-if-no-ref/
#endif
        // Universal snap tap behavior: &st <key> <opposing_key>
        // Example: &st A D (A key with D as opposing key)
        st: snap_tap {
            compatible = "zmk,behavior-snap-tap";
            #binding-cells = <2>;
            display-name = "Snap Tap";
        };
        
    };
}; 
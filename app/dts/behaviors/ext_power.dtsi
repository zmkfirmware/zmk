/*
 * Copyright (c) 2020 The ZMK Contributors
 *
 * SPDX-License-Identifier: MIT
 */

/ {
    behaviors {
        // Behavior can be invoked on peripherals, so name must be <= 8 characters
        // and cannot be /omit-if-no-ref/
        ext_power: extpower {
            compatible = "zmk,behavior-ext-power";
            #binding-cells = <1>;
        };
    };
};

/*
 * Copyright (c) 2020 The ZMK Contributors
 *
 * SPDX-License-Identifier: MIT
 */

#include <dt-bindings/zmk/behaviors.h>

/ {
    behaviors {
#if ZMK_BEHAVIOR_OMIT(TO)
        /omit-if-no-ref/
#endif
        to: to_layer {
            compatible = "zmk,behavior-to-layer";
            #binding-cells = <1>;
            display-name = "To Layer";
        };
    };
};

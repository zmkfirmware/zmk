/ {
	behaviors {
		ht: behavior_homerow_mod {
			compatible = "zmk,behavior-hold-tap";
			label = "HOMEROW_MOD";
			#binding-cells = <2>;
			flavor = "balanced";
			tapping_term_ms = <200>;
			bindings = <&kp>, <&kp>;
		};
	};
};

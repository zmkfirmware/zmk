/*
 * Copyright (c) 2020 The ZMK Contributors
 *
 * SPDX-License-Identifier: MIT
 */

/ {
    behaviors {
#if ZMK_BEHAVIOR_OMIT(INC_DEC_KP)
        /omit-if-no-ref/
#endif
        /* DEPRECATED: `inc_dec_cp` will be removed in the future */
        inc_dec_cp: inc_dec_kp: enc_key_press {
            compatible = "zmk,behavior-sensor-rotate-var";
            #sensor-binding-cells = <2>;
            bindings = <&kp>, <&kp>;
            display-name = "Sensor Rotate";
        };
    };
};

/*
 * Copyright (c) 2021 The ZMK Contributors
 *
 * SPDX-License-Identifier: MIT
 */

#include <dt-bindings/zmk/behaviors.h>
#include <dt-bindings/zmk/keys.h>

/ {
    behaviors {
#if ZMK_BEHAVIOR_OMIT(KEY_REPEAT)
    /omit-if-no-ref/
#endif
        key_repeat: key_repeat {
            compatible = "zmk,behavior-key-repeat";
            #binding-cells = <0>;
            usage-pages = <HID_USAGE_KEY>;
            display-name = "Key Repeat";
        };
    };
};


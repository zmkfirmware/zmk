/*
 * Copyright (c) 2020 The ZMK Contributors
 *
 * SPDX-License-Identifier: MIT
 */

#include <dt-bindings/zmk/behaviors.h>

/ {
    behaviors {
#if ZMK_BEHAVIOR_OMIT(BT)
        /omit-if-no-ref/
#endif
        bt: bluetooth {
            compatible = "zmk,behavior-bluetooth";
            #binding-cells = <2>;
            display-name = "Bluetooth";
        };
    };
};

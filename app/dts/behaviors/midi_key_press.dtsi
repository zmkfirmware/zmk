/*
 * Copyright (c) 2024 The ZMK Contributors
 *
 * SPDX-License-Identifier: MIT
 */

/ {
    behaviors {
        /omit-if-no-ref/ midi: midi_key_press {
            compatible = "zmk,behavior-midi-key-press";
            #binding-cells = <1>;
        };
    };
};
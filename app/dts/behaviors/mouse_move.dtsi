#include <zephyr/dt-bindings/input/input-event-codes.h>

/ {
    behaviors {
        /omit-if-no-ref/ mmv: mouse_move {
            compatible = "zmk,behavior-input-two-axis";
            #binding-cells = <1>;
            x-input-code = <INPUT_REL_X>;
            y-input-code = <INPUT_REL_Y>;
            time-to-max-speed-ms = <300>;
            acceleration-exponent = <1>;
        };
    };

    mmv_input_listener {
        compatible = "zmk,input-listener";
        device = <&mmv>;
    };
};

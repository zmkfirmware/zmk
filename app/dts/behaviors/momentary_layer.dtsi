/*
 * Copyright (c) 2020 The ZMK Contributors
 *
 * SPDX-License-Identifier: MIT
 */

#include <dt-bindings/zmk/behaviors.h>

/ {
    behaviors {
#if ZMK_BEHAVIOR_OMIT(MO)
        /omit-if-no-ref/
#endif
        mo: momentary_layer {
            compatible = "zmk,behavior-momentary-layer";
            #binding-cells = <1>;
            display-name = "Momentary Layer";
        };
    };
};

/*
 * Copyright (c) 2024 The ZMK Contributors
 *
 * SPDX-License-Identifier: MIT
 */

#include <dt-bindings/zmk/behaviors.h>
#include <dt-bindings/zmk/keys.h>

/ {
    behaviors {
#if ZMK_BEHAVIOR_OMIT(MODMORPH)
        /omit-if-no-ref/
#endif
        mm: mod_morph_kp {
            compatible = "zmk,behavior-mod-morph-param";
            #binding-cells = <2>;
            bindings = <&kp PLACEHOLDER>, <&kp PLACEHOLDER>;
            display-name = "Mod-Morph";
            mods = <(MOD_LGUI|MOD_LSFT|MOD_RGUI|MOD_RSFT)>;
            binding-params = <BINDING_PARAM(1,0) BINDING_PARAM(2,0)>;
        };
    };
};
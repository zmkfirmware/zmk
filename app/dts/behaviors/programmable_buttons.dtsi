/*
 * Copyright (c) 2020 The ZMK Contributors
 *
 * SPDX-License-Identifier: MIT
 */

/ {
    behaviors {
        /omit-if-no-ref/ pb: programmable_buttons {
            compatible = "zmk,behavior-programmable-buttons";
            #binding-cells = <1>;
        };
    };
};

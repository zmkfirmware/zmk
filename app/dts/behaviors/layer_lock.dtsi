/*
 * Copyright (c) 2025 The ZMK Contributors
 *
 * SPDX-License-Identifier: MIT
 */

#include <dt-bindings/zmk/behaviors.h>

/ {
    behaviors {
        /omit-if-no-ref/ llck: layer_lock {
            compatible = "zmk,behavior-layer-lock";
            #binding-cells = <0>;
        };
    };
};


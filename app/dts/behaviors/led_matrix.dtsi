/*
 * Copyright (c) 2026 The ZMK Contributors
 *
 * SPDX-License-Identifier: MIT
 */

#include <dt-bindings/zmk/behaviors.h>

/ {
    behaviors {
#if ZMK_BEHAVIOR_OMIT(LM)
        /omit-if-no-ref/
#endif
        // Behavior can be invoked on peripherals, so name must be <= 8 characters.
        lm: led_mtx {
            compatible = "zmk,behavior-led-matrix";
            #binding-cells = <2>;
            display-name = "LED Matrix";
        };
    };
};

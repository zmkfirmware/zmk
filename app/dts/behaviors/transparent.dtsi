/*
 * Copyright (c) 2020 The ZMK Contributors
 *
 * SPDX-License-Identifier: MIT
 */

#include <dt-bindings/zmk/behaviors.h>

/ {
    behaviors {
#if ZMK_BEHAVIOR_OMIT(TRANS)
        /omit-if-no-ref/
#endif
        trans: transparent {
            compatible = "zmk,behavior-transparent";
            #binding-cells = <0>;
            display-name = "Transparent";
        };
    };
};

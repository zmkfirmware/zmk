## app/dts/bindings/zmk,input-configs.yaml
```yaml
description: |
  Allows post-processing of input events based on the configuration

compatible: "zmk,input-configs"

child-binding:
  description: "A configuration for a given input device"

  properties:
    device:
      type: phandle
      required: true
    xy-swap:
      type: boolean
    x-invert:
      type: boolean
    y-invert:
      type: boolean
    scale-multiplier:
      type: int
      default: 1
    scale-divisor:
      type: int
      default: 1
```

## app/dts/bindings/zmk,input-listener.yaml
```yaml
# Copyright (c) 2024 The ZMK Contributors
# SPDX-License-Identifier: MIT

description: |
  Listener to subscribe to input events and send HID updates after processing

compatible: "zmk,input-listener"

properties:
  device:
    type: phandle
    required: true
  input-processors:
    type: phandle-array

child-binding:
  description: "Listener overrides for certain layers"

  properties:
    layers:
      type: array
      required: true
    process-next:
      type: boolean
    input-processors:
      type: phandle-array
```

## app/dts/bindings/zmk,input-split.yaml
```yaml
# Copyright (c) 2024 The ZMK Contributors
# SPDX-License-Identifier: MIT

include: [base.yaml]

compatible: "zmk,input-split"

description: Device to wire up an input device for split use.

properties:
  reg:
    required: true

  device:
    type: phandle

  input-processors:
    type: phandle-array
```

## app/dts/bindings/zmk,key-physical-attrs.yaml
```yaml
#
# Copyright (c) 2024 The ZMK Contributors
#
# SPDX-License-Identifier: MIT

description: |
  The physical attributes of a key, including size, location, and rotation

compatible: "zmk,key-physical-attrs"

properties:
  "#key-cells":
    type: int
    required: true
    const: 7

key-cells:
  - width
  - height
  - x
  - y
  - r
  - rx
  - ry
```

## app/dts/bindings/zmk,keymap-sensors.yaml
```yaml
# Copyright (c) 2020 The ZMK Contributors
# SPDX-License-Identifier: MIT

description: |
  Allows defining the collection of sensors bound in the keymap layers

compatible: "zmk,keymap-sensors"

properties:
  sensors:
    type: phandles
    required: false
  triggers-per-rotation:
    type: int
    required: false

child-binding:
  description: Per-sensor configuration settings
  properties:
    triggers-per-rotation:
      type: int
      required: false
```

## app/dts/bindings/zmk,keymap-transform.yaml
```yaml
description: |
  Defines a mapping from keymap logical positions to matrix physical positions

compatible: "zmk,keymap-transform"

properties:
  map:
    type: array
    required: true
```

## app/dts/bindings/zmk,keymap.yaml
```yaml
description: |
  Allows defining a keymap composed of multiple layers

compatible: "zmk,keymap"

child-binding:
  description: "A layer to be used in a keymap"

  properties:
    display-name:
      type: string
      required: false
      description: The name of this layer to show on displays
    bindings:
      type: phandle-array
      required: true
    sensor-bindings:
      type: phandle-array
      required: false

    label:
      type: string
      required: false
      deprecated: true
      description: Deprecated. Use "name" instead.
```

## app/dts/bindings/zmk,kscan-composite.yaml
```yaml
description: |
  Allows composing multiple KSCAN devices into one virtual device

compatible: "zmk,kscan-composite"

properties:
  label:
    type: string
  rows:
    type: int
  columns:
    type: int

child-binding:
  description: "Details of an included KSCAN devices"

  properties:
    label:
      type: string
    kscan:
      type: phandle
    row-offset:
      type: int
      default: 0
    column-offset:
      type: int
      default: 0
```

## app/dts/bindings/zmk,kscan-deghost.yaml
```yaml
description: |
  Allows deghosting a 2-key rollover matrix KSCAN device, resulting int a deghosted virtual device

compatible: "zmk,kscan-deghost"

properties:
  rows:
    type: int
  columns:
    type: int
  kscan:
    type: phandle
    required: true
  transform:
    type: phandle
```

## app/dts/bindings/zmk,kscan-mock.yaml
```yaml
description: |
  Allows defining a mock keyboard scan driver that simulates periodic events.

compatible: "zmk,kscan-mock"

properties:
  label:
    type: string
    required: false
    deprecated: true
  event-period:
    type: int
    description: Milliseconds between each generated event
  events:
    type: array
  rows:
    type: int
  columns:
    type: int
  exit-after:
    type: boolean
  exit-after-ms:
    type: int
    description: Number of milliseconds after which the driver will exit.
    default: 0
```

## app/dts/bindings/zmk,layers.yaml
```yaml
description: |
  Allows defining the various keymap layers for use.

compatible: "zmk,layers"

child-binding:
  description: "A layer to be used in a keymap"

  properties:
    label:
      type: string
      required: true
    bindings:
      type: phandle-array
      required: true
```

## app/dts/bindings/zmk,leader-sequences.yaml
```yaml
# Copyright (c) 2022, The ZMK Contributors
# SPDX-License-Identifier: MIT

description: Leader sequence container

compatible: "zmk,leader-sequences"

child-binding:
  description: "A leader sequence"

  properties:
    bindings:
      type: phandle-array
      required: true
    key-positions:
      type: array
      required: true
    layers:
      type: array
      default: [-1]
    immediate-trigger:
      type: boolean
```

## app/dts/bindings/zmk,matrix-transform.yaml
```yaml
description: |
  Defines a mapping from keymap logical positions to matrix physical positions

compatible: "zmk,matrix-transform"

properties:
  columns:
    type: int
    required: true
  rows:
    type: int
    required: true
  col-offset:
    type: int
    default: 0
  map:
    type: array
    required: true
```

## app/dts/bindings/zmk,multi-layers.yaml
```yaml
# Copyright (c) 2020, The ZMK Contributors
# SPDX-License-Identifier: MIT

description: Multi-layer container

compatible: "zmk,multi-layers"

child-binding:
  description: "A multi-layer configuration"

  properties:
    if-layers:
      type: array
      required: true
    then-layer:
      type: int
      required: true
```

## app/dts/bindings/zmk,physical-layout-position-map.yaml
```yaml
#
# Copyright (c) 2024 The ZMK Contributors
#
# SPDX-License-Identifier: MIT

description: |
  Describes how to correlate equivalent keys between layouts that don't have the exact same X,Y location.

compatible: "zmk,physical-layout-position-map"

properties:
  complete:
    type: boolean
    description: If the mapping complete describes the key mapping, and no position based mapping should be used.

child-binding:
  properties:
    physical-layout:
      type: phandle
      description: The physical layout that corresponds to this mapping entry.
    positions:
      type: array
      description: Array of key positions that match the same array entry in the other sibling nodes.
```

## app/dts/bindings/zmk,physical-layout.yaml
```yaml
#
# Copyright (c) 2024 The ZMK Contributors
#
# SPDX-License-Identifier: MIT

description: |
  Describe the physical layout of a keyboard, including deps like the transform and kscan
  that are needed for that layout to work.

compatible: "zmk,physical-layout"

properties:
  display-name:
    type: string
    required: true
    description: The name of this layout to display in the UI
  transform:
    type: phandle
    required: true
    description: The matrix transform to use along with this layout.
  kscan:
    type: phandle
    description: The kscan to use along with this layout. The `zmk,kscan` chosen will be used as a fallback if this property is omitted.
  keys:
    type: phandle-array
    description: Array of key physical attributes.
```

## app/dts/bindings/zmk,soft-off-wakeup-sources.yaml
```yaml
# Copyright (c) 2023 The ZMK Contributors
# SPDX-License-Identifier: MIT

description: |
  Description of all possible wakeup-sources from a forced
  soft-off state.

compatible: "zmk,soft-off-wakeup-sources"

properties:
  wakeup-sources:
    type: phandles
    required: true
    description: List of wakeup-sources that should be enabled to wake the system from forced soft-off state.
```

## app/dts/bindings/zmk,soft-on-off-gpio.yaml
```yaml
# Copyright (c) 2023 The ZMK Contributors
# SPDX-License-Identifier: MIT

description: |
  Driver for controlling the device's power status
  by listening for activity on a GPIO pin for sleep
  and wake.

compatible: "zmk,soft-on-off-gpio"

properties:
  input-gpios:
    type: phandle-array
    required: true
    description: The GPIO pin that triggers wake/sleep via interrupt
  wakeup-sources:
    type: phandles
    required: true
    description: List of wakeup-sources that need to be deactivated so that only this driver/pin wakes the device.
  output-gpios:
    type: phandle-array
    description: Optional set of pins that should be set active before sleeping.
```

## app/dts/bindings/zmk,underglow-indicators.yaml
```yaml
# Copyright (c) 2020, The ZMK Contributors
# SPDX-License-Identifier: MIT

description: Underglow indicators

compatible: "zmk,underglow-indicators"

properties:
  bat-lhs:
    type: array
  bat-rhs:
    type: array
  num-lock:
    type: int
  caps-lock:
    type: int
  scroll-lock:
    type: int
  layer-state:
    type: array
  ble-profiles:
    type: array
  usb-state:
    type: int
  output-fallback:
    type: int
```

## app/dts/bindings/zmk,underglow-layer.yaml
```yaml
#
# Copyright (c) 2024 The ZMK Contributors
#
# SPDX-License-Identifier: MIT

description: |
  Allows defining a rgbmap composed of multiple layers

compatible: "zmk,underglow-layer"

properties:
  pixel-lookup:
    type: array
    required: true

child-binding:
  description: "A layer to be used in a rgbmap"

  properties:
    bindings:
      type: phandle-array
      required: true
    layer-id:
      type: int
      required: true
```

## app/dts/bindings/zmk,underglow-transform.yaml
```yaml
description: |
  Defines a mapping from physical key positions to underglow pixel indexes, with (-1) values representing a key or space that doesn't have a corresponding LED.

compatible: "zmk,underglow-transform"

properties:
  columns:
    type: int
    required: true
  rows:
    type: int
    required: true
  map:
    type: array
    required: true
```

## app/dts/bindings/zmk,wired-split.yaml
```yaml
# Copyright (c) 2025 The ZMK Contributors
# SPDX-License-Identifier: MIT

description: |
  Complete specification of wired split connection

compatible: "zmk,wired-split"

properties:
  device:
    type: phandle
    required: true
    description: The UART device for wired split communication

  detect-gpios:
    type: phandle-array
    description: |
      If your split includes support for an extra GPIO to detect presence of the split cable, set
      this to the GPIO pin used to detect the connection.

  half-duplex:
    type: boolean
    description: "Experimental: Enable half-duplex protocol mode"

  dir-gpios:
    type: phandle-array
    description: "Experimental: Set the communication direction. Used for RS-422 style comms."
```

## app/module/Kconfig
```kconfig
rsource "drivers/Kconfig"
rsource "lib/Kconfig"
rsource "test-behaviors/Kconfig"
```

## app/module/boards/joric/nrfmicro/Kconfig
```kconfig
config BOARD_NRFMICRO_CHARGER
    bool "Enable battery charger"
    default y
    depends on (BOARD_NRFMICRO && BOARD_REVISION = "1.3.0")
```

## app/module/boards/joric/nrfmicro/Kconfig.nrfmicro
```kconfig
# nrfmicro board configuration

# Copyright (c) 2020 The ZMK Contributors
# SPDX-License-Identifier: MIT

config BOARD_NRFMICRO
    select SOC_NRF52840_QIAA if BOARD_NRFMICRO_NRF52840
    select SOC_NRF52840_QIAA if BOARD_NRFMICRO_NRF52840_FLIPPED
    select SOC_NRF52833_QIAA if BOARD_NRFMICRO_NRF52833
```

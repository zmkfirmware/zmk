## app/dts/bindings/macros/zmk,macro-param-1to1.yaml
```yaml
# Copyright (c) 2023 The ZMK Contributors
# SPDX-License-Identifier: MIT

description: Macro Parameter One Substituted Into Next Binding's First Parameter

compatible: "zmk,macro-param-1to1"

include: zero_param.yaml
```

## app/dts/bindings/macros/zmk,macro-param-1to2.yaml
```yaml
# Copyright (c) 2023 The ZMK Contributors
# SPDX-License-Identifier: MIT

description: Macro Parameter One Substituted Into Next Binding's Second Parameter

compatible: "zmk,macro-param-1to2"

include: zero_param.yaml
```

## app/dts/bindings/macros/zmk,macro-param-2to1.yaml
```yaml
# Copyright (c) 2023 The ZMK Contributors
# SPDX-License-Identifier: MIT

description: Macro Parameter Two Substituted Into Next Binding's First Parameter

compatible: "zmk,macro-param-2to1"

include: zero_param.yaml
```

## app/dts/bindings/macros/zmk,macro-param-2to2.yaml
```yaml
# Copyright (c) 2023 The ZMK Contributors
# SPDX-License-Identifier: MIT

description: Macro Parameter Two Substituted Into Next Binding's Second Parameter

compatible: "zmk,macro-param-2to2"

include: zero_param.yaml
```

## app/dts/bindings/macros/zmk,macro-pause-for-layer.yaml
```yaml
# Copyright (c) 2022 The ZMK Contributors
# SPDX-License-Identifier: MIT

description: Macro Pause Until Layer Change

compatible: "zmk,macro-pause-for-layer"

include: zero_param.yaml
```

## app/dts/bindings/macros/zmk,macro-pause-for-release.yaml
```yaml
# Copyright (c) 2022 The ZMK Contributors
# SPDX-License-Identifier: MIT

description: Macro Pause Until Release Marker

compatible: "zmk,macro-pause-for-release"

include: zero_param.yaml
```

## app/dts/bindings/retained_mem/zmk,bootmode-to-magic-mapper.yaml
```yaml
# Copyright (c) 2024 The ZMK Contributors
# SPDX-License-Identifier: MIT

description: |
  Driver for mapping bootloader boot mode to a magic value

compatible: "zmk,bootmode-to-magic-mapper"

include: base.yaml
```

## app/dts/bindings/turbo/zmk,turbo-param-1to1.yaml
```yaml
# Copyright (c) 2025 The ZMK Contributors
# SPDX-License-Identifier: MIT

description: Turbo Parameter One Substituted Into Next Binding's First Parameter

compatible: "zmk,turbo-param-1to1"

include: zero_param.yaml
```

## app/dts/bindings/turbo/zmk,turbo-param-1to2.yaml
```yaml
# Copyright (c) 2025 The ZMK Contributors
# SPDX-License-Identifier: MIT

description: Turbo Parameter One Substituted Into Next Binding's Second Parameter

compatible: "zmk,turbo-param-1to2"

include: zero_param.yaml
```

## app/dts/bindings/turbo/zmk,turbo-param-2to1.yaml
```yaml
# Copyright (c) 2025 The ZMK Contributors
# SPDX-License-Identifier: MIT

description: Turbo Parameter Two Substituted Into Next Binding's First Parameter

compatible: "zmk,turbo-param-2to1"

include: zero_param.yaml
```

## app/dts/bindings/turbo/zmk,turbo-param-2to2.yaml
```yaml
# Copyright (c) 2025 The ZMK Contributors
# SPDX-License-Identifier: MIT

description: Turbo Parameter Two Substituted Into Next Binding's Second Parameter

compatible: "zmk,turbo-param-2to2"

include: zero_param.yaml
```

## app/dts/bindings/zmk,behavior-key.yaml
```yaml
# Copyright (c) 2023 The ZMK Contributors
# SPDX-License-Identifier: MIT

description: |
  Driver for a dedicated key for invoking a connected behavior.

compatible: "zmk,behavior-key"

include: base.yaml

properties:
  key:
    type: phandle
    required: true
    description: The GPIO key that triggers wake via interrupt
  bindings:
    type: phandle
    required: true
    description: The GPIO key that triggers wake via interrupt
  debounce-press-ms:
    type: int
    default: 5
    description: Debounce time for key press in milliseconds. Use 0 for eager debouncing.
  debounce-release-ms:
    type: int
    default: 5
    description: Debounce time for key release in milliseconds.
  debounce-scan-period-ms:
    type: int
    default: 1
    description: Time between reads in milliseconds when any key is pressed.
```

## app/dts/bindings/zmk,boot-magic-combo.yaml
```yaml
# Copyright (c) 2023, The ZMK Contributors
# SPDX-License-Identifier: MIT

description: |
  Triggers one or more actions if a combination of keys is held while the keyboard boots.
  This is typically used for recovering a keyboard in cases such as &bootloader
  being missing from the keymap or a split peripheral which isn't connected to
  the central, and therefore can't process the keymap.

compatible: "zmk,boot-magic-combo"

properties:
  combo-positions:
    type: array
    required: true
    description: Zero-based indices of the keys which must be simultaneously pressed to trigger the action(s).
  # Boot magic actions:
  jump-to-bootloader:
    type: boolean
    description: Reboots into the bootloader.
  reset-settings:
    type: boolean
    description: Clears settings and reboots.
```

## app/dts/bindings/zmk,boot-magic-key.yaml
```yaml
# Copyright (c) 2023, The ZMK Contributors
# SPDX-License-Identifier: MIT

description: |
  Triggers one or more actions if a specific key is held while the keyboard boots.
  This is typically used for recovering a keyboard in cases such as &bootloader
  being missing from the keymap or a split peripheral which isn't connected to
  the central, and therefore can't process th ekeymap.

compatible: "zmk,boot-magic-key"

properties:
  key-position:
    type: int
    default: 0
    description: Zero-based index of the key which triggers the action(s).
  # Boot magic actions:
  jump-to-bootloader:
    type: boolean
    description: Reboots into the bootloader.
  reset-settings:
    type: boolean
    description: Clears settings and reboots.
```

## app/dts/bindings/zmk,bt-unpair-combo.yaml
```yaml
# Copyright (c) 2020, Pete Johanson
# SPDX-License-Identifier: MIT

description: |
  Defines a set of key positions that will unpair all BT devices if held on startup.

compatible: "zmk,bt-unpair-combo"

properties:
  key-positions:
    type: array
    required: true
```

## app/dts/bindings/zmk,character-map.yaml
```yaml
# Copyright (c) 2023, The ZMK Contributors
# SPDX-License-Identifier: MIT

description: Unicode codepoint to behavior binding mapping

compatible: "zmk,character-map"

properties:
  behavior:
    type: phandle
    required: true
    description: |
      Behavior to use for a code point in the mapping (typically <&kp>).
      The behavior is given one parameter which is the value for the code point
      from the "map" property.

  unicode-behavior:
    type: phandle
    description: |
      Optional behavior to use for a code point not in the mapping.
      The behavior is given one parameter which is the code point.

  map:
    type: array
    required: true
    description: |
      List of <codepoint param> pairs. Each pair maps a codepoint to a parameter
      given to "behavior" to type that code point.
```

## app/dts/bindings/zmk,combo-partial-hold-position.yaml
```yaml
# Copyright (c) 2022 The ZMK Contributors
# SPDX-License-Identifier: MIT

description: Add a partial hold position to a combo

compatible: "zmk,combo-partial-hold-position"

include: one_param.yaml
```

## app/dts/bindings/zmk,combos.yaml
```yaml
# Copyright (c) 2020, The ZMK Contributors
# SPDX-License-Identifier: MIT

description: Combos container

compatible: "zmk,combos"

child-binding:
  description: "A combo"

  properties:
    bindings:
      type: phandle-array
      required: true
    key-positions:
      type: array
      required: true
    timeout-ms:
      type: int
      default: 50
    require-prior-idle-ms:
      type: int
      default: -1
    slow-release:
      type: boolean
    layers:
      type: array
      default: [-1]
```

## app/dts/bindings/zmk,conditional-layers.yaml
```yaml
# Copyright (c) 2021 The ZMK Contributors
# SPDX-License-Identifier: MIT

description: Conditional layers allow layer combinations to trigger additional layers

compatible: "zmk,conditional-layers"

child-binding:
  description: "Single conditional layer that activates then-layer when if-layers are active"

  properties:
    if-layers:
      type: array
      required: true
    then-layer:
      type: int
      required: true
```

## app/dts/bindings/zmk,dev-pm-policy.yaml
```yaml
# Copyright (c) 2020 The ZMK Contributors
# SPDX-License-Identifier: MIT

description: Device Power Management Policy

compatible: "zmk,dev-pm-policy"

properties:
  label:
    type: string
    required: true

  device:
    type: phandle
    required: true
    description: |

      The device or power domain on which the power management policy should be run on.

  auto-off-on-idle:
    type: boolean
    required: false
    description: |

      Automatically turn off a device or power domain when the keyboard is idle.

  usb-auto-toggle:
    type: boolean
    required: false
    description: |

      Automatically turn off a device or power domain when usb is disconnected and turn on when usb is connected.
```

## app/dts/bindings/zmk,ext-power-generic.yaml
```yaml
# Copyright (c) 2020 The ZMK Contributors
# SPDX-License-Identifier: MIT

description: |
  Generic driver for controlling the external power output
  by toggling the control-gpio pin status
  (Only in supported hardware)

compatible: "zmk,ext-power-generic"

properties:
  control-gpios:
    type: phandle-array
    required: true
  label:
    type: string
    required: true
  init-delay-ms:
    type: int
    description: Number of milliseconds to delay after initializing driver
    required: false
```

## app/dts/bindings/zmk,global-bindings.yaml
```yaml
description: |
  Specify the the global behaviors bound to state changes

compatible: "zmk,global-bindings"

properties:
  bindings:
    type: phandles
    required: true
```

## app/dts/bindings/zmk,gpio-key-wakeup-trigger.yaml
```yaml
# Copyright (c) 2023 The ZMK Contributors
# SPDX-License-Identifier: MIT

description: |
  Driver for a dedicated key for waking the device from sleep

compatible: "zmk,gpio-key-wakeup-trigger"

include: base.yaml

properties:
  trigger:
    type: phandle
    required: true
    description: The GPIO key that triggers wake via interrupt
  extra-gpios:
    type: phandle-array
    description: Optional set of pins that should be set active before sleeping.
```

## app/dts/bindings/zmk,gpio-scanned-key-behavior-trigger.yaml
```yaml
# Copyright (c) 2023 The ZMK Contributors
# SPDX-License-Identifier: MIT

description: |
  Driver for a dedicated key triggered by matrix scanning for invoking a connected behavior.

compatible: "zmk,gpio-scanned-key-behavior-trigger"

include: base.yaml

properties:
  key:
    type: phandle
    required: true
    description: The GPIO key that triggers wake via interrupt
  bindings:
    type: phandle
    required: true
    description: The behavior to invoke when the GPIO key is pressed
  debounce-press-ms:
    type: int
    default: 5
    description: Debounce time for key press in milliseconds. Use 0 for eager debouncing.
  debounce-release-ms:
    type: int
    default: 5
    description: Debounce time for key release in milliseconds.
  debounce-scan-period-ms:
    type: int
    default: 1
    description: Time between reads in milliseconds when any key is pressed.
```

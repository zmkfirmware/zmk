## app/dts/bindings/behaviors/zmk,behavior-rgb-underglow.yaml
```yaml
# Copyright (c) 2020 The ZMK Contributors
# SPDX-License-Identifier: MIT

description: RGB Underglow Action

compatible: "zmk,behavior-rgb-underglow"

include: two_param.yaml
```

## app/dts/bindings/behaviors/zmk,behavior-sarcasm.yaml
```yaml
# Copyright (c) 2021 The ZMK Contributors
# SPDX-License-Identifier: MIT

description: SaRcASm BeHaViOr

compatible: "zmk,behavior-sarcasm"

include: zero_param.yaml
```

## app/dts/bindings/behaviors/zmk,behavior-send-string.yaml
```yaml
# Copyright (c) 2023 The ZMK Contributors
# SPDX-License-Identifier: MIT

description: Send String Behavior

compatible: "zmk,behavior-send-string"

include: zero_param.yaml

properties:
  text:
    type: string
    required: true
    description: The text to send.

  wait-ms:
    type: int
    description: The time to wait (in milliseconds) before pressing the next key in the text.

  tap-ms:
    type: int
    description: The time to wait (in milliseconds) between the press and release of each key in the text.

  charmap:
    type: phandle
    description: A zmk,character-map instance to use. If omitted, the zmk,charmap chosen node is used.
```

## app/dts/bindings/behaviors/zmk,behavior-sensor-rotate-key-press.yaml
```yaml
# Copyright (c) 2020 The ZMK Contributors
# SPDX-License-Identifier: MIT

description: Sensor rotate key press/release behavior

compatible: "zmk,behavior-sensor-rotate-key-press"

properties:
  label:
    type: string
    required: true
  "#sensor-binding-cells":
    type: int
    required: true
    const: 2

sensor-binding-cells:
  - param1
  - param2
```

## app/dts/bindings/behaviors/zmk,behavior-sensor-rotate-layer-to.yaml
```yaml
# Copyright (c) 2020 The ZMK Contributors
# SPDX-License-Identifier: MIT

description: Sensor rotate layer to behavior

compatible: "zmk,behavior-sensor-rotate-layer-to"

properties:
  label:
    type: string
    required: true
  "#sensor-binding-cells":
    type: int
    required: true
    const: 2

sensor-binding-cells:
  - param1
  - param2
```

## app/dts/bindings/behaviors/zmk,behavior-sensor-rotate-var.yaml
```yaml
# Copyright (c) 2022 The ZMK Contributors
# SPDX-License-Identifier: MIT

description: Sensor rotate behavior

compatible: "zmk,behavior-sensor-rotate-var"

properties:
  label:
    type: string
    required: false
    deprecated: true
  "#sensor-binding-cells":
    type: int
    required: true
    const: 2
  bindings:
    type: phandles
    required: true
  tap-ms:
    type: int
    default: 5

sensor-binding-cells:
  - param1
  - param2
```

## app/dts/bindings/behaviors/zmk,behavior-sensor-rotate.yaml
```yaml
# Copyright (c) 2022 The ZMK Contributors
# SPDX-License-Identifier: MIT

description: Sensor rotate behavior

compatible: "zmk,behavior-sensor-rotate"

properties:
  label:
    type: string
    required: false
    deprecated: true
  "#sensor-binding-cells":
    type: int
    required: true
    const: 0
  bindings:
    type: phandle-array
    required: true
  tap-ms:
    type: int
    default: 5
```

## app/dts/bindings/behaviors/zmk,behavior-set-sleep.yaml
```yaml
# Copyright (c) 2025 The ZMK Contributors
# SPDX-License-Identifier: MIT

description: Set sleep behavior

compatible: "zmk,behavior-set-sleep"

include: one_param.yaml
```

## app/dts/bindings/behaviors/zmk,behavior-simple-macro.yaml
```yaml
# Copyright (c) 2020 The ZMK Contributors
# SPDX-License-Identifier: MIT

description: Keyboard Reset Behavior

compatible: "zmk,behavior-simple-macro"

include: zero_param.yaml

properties:
  bindings:
    type: phandle-array
    required: true
  mode:
    type: string
    default: "key-down"
    enum:
      - "key-up"
      - "key-down"
      - "hold"
```

## app/dts/bindings/behaviors/zmk,behavior-sleep.yaml
```yaml
# Copyright (c) 2020 The ZMK Contributors
# SPDX-License-Identifier: MIT

description: Sleep Binding Behavior

compatible: "zmk,behavior-sleep"

include: zero_param.yaml
```

## app/dts/bindings/behaviors/zmk,behavior-snap-tap.yaml
```yaml
# Copyright (c) 2024 The ZMK Contributors
# SPDX-License-Identifier: MIT

description: Snap Tap behavior for SOCD (Simultaneous Opposing Cardinal Directions)

compatible: "zmk,behavior-snap-tap"

include: two_param.yaml 
```

## app/dts/bindings/behaviors/zmk,behavior-soft-off.yaml
```yaml
# Copyright (c) 2023 The ZMK Contributors
# SPDX-License-Identifier: MIT

description: Soft-Off Behavior

compatible: "zmk,behavior-soft-off"

include: zero_param.yaml

properties:
  hold-time-ms:
    type: int
    required: false
    description: Number of milliseconds the behavior must be held before releasing will actually trigger a soft-off.
  split-peripheral-off-on-press:
    type: boolean
    description: When built for a split peripheral, turn off on press, not release
```

## app/dts/bindings/behaviors/zmk,behavior-soft-poweroff.yaml
```yaml
# Copyright (c) 2023 The ZMK Contributors
# SPDX-License-Identifier: MIT

description: Keyboard System Soft Off Behavior

compatible: "zmk,behavior-soft-poweroff"

include: zero_param.yaml

properties:
  type:
    type: int
    default: 0
```

## app/dts/bindings/behaviors/zmk,behavior-split-bt.yaml
```yaml
# Copyright (c) 2020, Pete Johanson
# SPDX-License-Identifier: MIT

description: Split Bluetooth Behavior

compatible: "zmk,behavior-split-bt"

include: zero_param.yaml
```

## app/dts/bindings/behaviors/zmk,behavior-sticky-key.yaml
```yaml
# Copyright (c) 2020 The ZMK Contributors
# SPDX-License-Identifier: MIT

description: Sticky key behavior

compatible: "zmk,behavior-sticky-key"

include: one_param.yaml

properties:
  bindings:
    type: phandles
    required: true
  release-after-ms:
    type: int
  quick-release:
    type: boolean
  ignore-modifiers:
    type: boolean
```

## app/dts/bindings/behaviors/zmk,behavior-studio-unlock.yaml
```yaml
# Copyright (c) 2024 The ZMK Contributors
# SPDX-License-Identifier: MIT

description: Studio Unlock Behavior

compatible: "zmk,behavior-studio-unlock"

include: zero_param.yaml
```

## app/dts/bindings/behaviors/zmk,behavior-tap-dance-param.yaml
```yaml
# Copyright (c) 2024 The ZMK Contributors
# SPDX-License-Identifier: MIT

description: Tap Dance Behavior

compatible: "zmk,behavior-tap-dance-param"

include: [two_param.yaml, tap_dance_base.yaml, binding_params.yaml]
```

## app/dts/bindings/behaviors/zmk,behavior-tap-dance.yaml
```yaml
# Copyright (c) 2022 The ZMK Contributors
# SPDX-License-Identifier: MIT

description: Tap Dance Behavior

compatible: "zmk,behavior-tap-dance"

include: [zero_param.yaml, tap_dance_base.yaml]
```

## app/dts/bindings/behaviors/zmk,behavior-tap-hold.yaml
```yaml
# Copyright (c) 2020, Cody McGinnis; Okke Formsma
# SPDX-License-Identifier: MIT

description: Hold or Tap behavior

compatible: "zmk,behavior-tap-hold"

include: zero_param.yaml

properties:
  bindings:
    type: phandle-array
    required: true
  tapping_term_ms:
    type: int 
  flavor:
    type: string
    required: false
    default: "hold-preferred"
    enum:
    - "hold-preferred"
    - "balanced"
    - "tap-preferred"
```

## app/dts/bindings/behaviors/zmk,behavior-to-layer.yaml
```yaml
# Copyright (c) 2020 The ZMK Contributors
# SPDX-License-Identifier: MIT

description: To Layer

compatible: "zmk,behavior-to-layer"

include: one_param.yaml

properties:
  locking:
    type: boolean
    description: Whether to "lock" the layer active, preventing behaviors without the "locking" property from deactivating the layer
```

## app/dts/bindings/behaviors/zmk,behavior-toggle-layer.yaml
```yaml
# Copyright (c) 2020 The ZMK Contributors
# SPDX-License-Identifier: MIT

description: Toggle Layer

compatible: "zmk,behavior-toggle-layer"

include: one_param.yaml

properties:
  toggle-mode:
    type: string
    default: "flip"
    enum:
      - "on"
      - "off"
      - "flip"
  locking:
    type: boolean
    description: Whether to "lock" the layer active, preventing behaviors without the "locking" property from deactivating the layer
```

## app/dts/bindings/behaviors/zmk,behavior-trackball_pim447.yaml
```yaml
# Copyright (c) 2021 The ZMK Contributors
# SPDX-License-Identifier: MIT

description: Trackball PIM447 behavior

compatible: "zmk,behavior-trackball-pim447"

include: zero_param.yaml

properties:
  mode:
    type: int
    required: true
  momentary:
    type: boolean
```

## app/dts/bindings/behaviors/zmk,behavior-transparent.yaml
```yaml
# Copyright (c) 2020 The ZMK Contributors
# SPDX-License-Identifier: MIT

description: Transparent Binding Behavior

compatible: "zmk,behavior-transparent"

include: zero_param.yaml
```

## app/dts/bindings/behaviors/zmk,behavior-tri-state.yaml
```yaml
# Copyright (c) 2022 The ZMK Contributors
# SPDX-License-Identifier: MIT

description: Tri-State Behavior

compatible: "zmk,behavior-tri-state"

include: zero_param.yaml

properties:
  bindings:
    type: phandle-array
    required: true
  ignored-key-positions:
    type: array
    required: false
    default: []
  ignored-layers:
    type: array
    required: false
    default: []
  timeout-ms:
    type: int
    default: -1
  tap-ms:
    type: int
    default: 5
```

## app/dts/bindings/behaviors/zmk,behavior-turbo-key-one-param.yaml
```yaml
# Copyright (c) 2025 The ZMK Contributors
# SPDX-License-Identifier: MIT

description: Turbo key behavior

compatible: "zmk,behavior-turbo-key-one-param"

include: [one_param.yaml, turbo_base.yaml]
```

## app/dts/bindings/behaviors/zmk,behavior-turbo-key-two-param.yaml
```yaml
# Copyright (c) 2025 The ZMK Contributors
# SPDX-License-Identifier: MIT

description: Turbo key behavior

compatible: "zmk,behavior-turbo-key-two-param"

include: [two_param.yaml, turbo_base.yaml]
```

## app/dts/bindings/behaviors/zmk,behavior-turbo-key.yaml
```yaml
# Copyright (c) 2022 The ZMK Contributors
# SPDX-License-Identifier: MIT

description: Turbo key behavior

compatible: "zmk,behavior-turbo-key"

include: [zero_param.yaml, turbo_base.yaml]
```

## app/dts/bindings/behaviors/zmk,behavior-underglow-battery.yaml
```yaml
# Copyright (c) 2024, The ZMK Contributors
# SPDX-License-Identifier: MIT

description: Set underglow color based on battery level

compatible: "zmk,behavior-underglow-battery"

include: two_param.yaml

properties:
  threshold:
    type: int
```

## app/dts/bindings/behaviors/zmk,behavior-underglow-color.yaml
```yaml
# Copyright (c) 2024, The ZMK Contributors
# SPDX-License-Identifier: MIT

description: Set underglow to specified color

compatible: "zmk,behavior-underglow-color"

include: one_param.yaml
```

## app/dts/bindings/behaviors/zmk,behavior-underglow-indicators.yaml
```yaml
# Copyright (c) 2024, The ZMK Contributors
# SPDX-License-Identifier: MIT

description: Set underglow color based on HID indicators

compatible: "zmk,behavior-underglow-indicators"

include: two_param.yaml

properties:
  indicator:
    type: int
    default: 0
```

## app/dts/bindings/behaviors/zmk,behavior-vkey.yaml
```yaml
# Copyright (c) 2024 The ZMK Contributors
# SPDX-License-Identifier: MIT

description: Vendor-defined "original key" (vkey) behavior — emits Report ID 0x20 selector

compatible: "zmk,behavior-vkey"

include: one_param.yaml
```

## app/dts/bindings/gpio/moergo,glove80-ext.yaml
```yaml
# Copyright (C) 2024 The ZMK Contributors
# SPDX-License-Identifier: MIT

description: |
  GPIO pins exposed on the Glove80 internal extension header.

  See https://docs.moergo.com/glove80-user-guide/appendix-more-customizations/

  Both sides of the Glove80 split keyboard expose a set of 6 extra GPIO pins
  for customization, with different underlying nRF52 pins used on each side.
  This nexus node allows referencing the pins generically without being tied
  to a specific left/right side pin assignment.


      - GND                    VEXT  -
      - VDDH                   EXT1  1
      2 EXT2                   EXT3  3
      4 EXT4                   EXT5  5
      6 SWO_EXT6               RESET -
      - SWDCLK                 SWDIO -

compatible: "moergo,glove80-ext"

include: [gpio-nexus.yaml, base.yaml]
```

## app/dts/bindings/indicators/zmk,indicator-leds.yaml
```yaml
# Copyright (c) 2025, The ZMK Contributors
# SPDX-License-Identifier: MIT

description: Display the states of HID indicators using LEDs

compatible: "zmk,indicator-leds"

child-binding:
  properties:
    leds:
      type: phandles
      required: true
      description: One or more LED devices to control

    indicator:
      type: int
      required: true
      description: HID_INDICATOR_* value to indicate (see dt-bindings/zmk/hid_indicators.h)

    active-brightness:
      type: int
      description: LED brightness in percent when the indicator is active
      default: 100

    inactive-brightness:
      type: int
      description: LED brightness in percent when the indicator is not active
      default: 0

    disconnected-brightness:
      type: int
      description: LED brightness in percent when the keyboard is not connected to any device
      default: 0

    on-while-idle:
      type: boolean
      description: Keep LEDs enabled even when the keyboard is idle and on battery power
```

## app/dts/bindings/input_processors/ip_common.yaml
```yaml
# Copyright (c) 2024 The ZMK Contributors
# SPDX-License-Identifier: MIT

properties:
  track-remainders:
    type: boolean
```

## app/dts/bindings/input_processors/ip_one_param.yaml
```yaml
# Copyright (c) 2024 The ZMK Contributors
# SPDX-License-Identifier: MIT

include: ip_common.yaml

properties:
  "#input-processor-cells":
    type: int
    required: true
    const: 1

input-processor-cells:
  - param1
```

## app/dts/bindings/input_processors/ip_two_param.yaml
```yaml
# Copyright (c) 2024 The ZMK Contributors
# SPDX-License-Identifier: MIT

include: ip_common.yaml

properties:
  "#input-processor-cells":
    type: int
    required: true
    const: 2

input-processor-cells:
  - param1
  - param2
```

## app/dts/bindings/input_processors/ip_zero_param.yaml
```yaml
# Copyright (c) 2024 The ZMK Contributors
# SPDX-License-Identifier: MIT

include: ip_common.yaml

properties:
  "#input-processor-cells":
    type: int
    required: true
    const: 0
```

## app/dts/bindings/input_processors/zmk,input-processor-behaviors.yaml
```yaml
# Copyright (c) 2024, The ZMK Contributors
# SPDX-License-Identifier: MIT

description: Input Processor for invoking behaviors on certain events

compatible: "zmk,input-processor-behaviors"

include: ip_zero_param.yaml

properties:
  type:
    type: int
  codes:
    type: array
    required: true
  bindings:
    type: phandle-array
    required: true
```

## app/dts/bindings/input_processors/zmk,input-processor-code-mapper.yaml
```yaml
# Copyright (c) 2024, The ZMK Contributors
# SPDX-License-Identifier: MIT

description: Input Processor for remapping certain input codes to other codes

compatible: "zmk,input-processor-code-mapper"

include: ip_zero_param.yaml

properties:
  type:
    type: int
    required: true
  map:
    type: array
    required: true
```

## app/dts/bindings/input_processors/zmk,input-processor-scaler.yaml
```yaml
# Copyright (c) 2024, The ZMK Contributors
# SPDX-License-Identifier: MIT

description: Input Processor for scaling values

compatible: "zmk,input-processor-scaler"

include: ip_two_param.yaml

properties:
  type:
    type: int
    required: true
  codes:
    type: array
    required: true
```

## app/dts/bindings/input_processors/zmk,input-processor-temp-layer.yaml
```yaml
# Copyright (c) 2024, The ZMK Contributors
# SPDX-License-Identifier: MIT

description: Input Processor for temporarily enabling a layer after input events

compatible: "zmk,input-processor-temp-layer"

include: ip_two_param.yaml

properties:
  require-prior-idle-ms:
    type: int
    required: false
    default: 0
    description: Time in milliseconds that must pass after the last keystroke before the layer can be toggled

  excluded-positions:
    type: array
    required: false
    default: []
    description: Array of key positions that will NOT trigger layer deactivation when pressed
```

## app/dts/bindings/input_processors/zmk,input-processor-transform.yaml
```yaml
# Copyright (c) 2024, The ZMK Contributors
# SPDX-License-Identifier: MIT

description: Input Processor for transforming values in various ways

compatible: "zmk,input-processor-transform"

include: ip_one_param.yaml

properties:
  type:
    type: int
  x-codes:
    type: array
    required: true
  y-codes:
    type: array
    required: true
```

## app/dts/bindings/kscan/zmk,kscan-sideband-behaviors.yaml
```yaml
# Copyright (c) 2023, The ZMK Contributors
# SPDX-License-Identifier: MIT

description: |
  kscan sideband behavior runner. Only basic system behaviors should be used,
  since no keymap processing occurs when using them. Primarily, that means avoiding
  using tap-holds, sticky keys, etc. as sideband behaviors.

compatible: "zmk,kscan-sideband-behaviors"

include: kscan.yaml

properties:
  kscan:
    type: phandle
    required: true

child-binding:
  description: "A sideband behavior tied to a row/column pair"

  properties:
    row:
      type: int
      default: 0
    column:
      type: int
      required: true
    bindings:
      type: phandle-array
      required: true
```

## app/dts/bindings/led_strip/issi,is31fl3741.yaml
```yaml
# Copyright (c) 2020, The ZMK Contributors
# SPDX-License-Identifier: MIT

description: ISSI IS31FL3741 LED Matrix driver

compatible: "issi,is31fl3741"

include: i2c-device.yaml

properties:
  sw-setting:
    type: int
    required: false
    enum:
      - 0x00
      - 0x01
      - 0x02
      - 0x03
      - 0x04
      - 0x05
      - 0x06
      - 0x07
      - 0x08
    default: 0x00
    description: |
      SW setting used to control the matrix size by turning off SWx pins
      as described in the datasheet.

  map:
    type: array
    required: true
    description: |
      Configure how RGB pixels are mapped to individual pixel registers.

  r-ext:
    type: int
    required: true
    description: Rext resistor value in kiloohms.

  led-max-current:
    type: int
    required: true
    description: Maximum allowed LED current in mAh. The maximum allowed by the chip is 38.

  sdb-gpios:
    type: phandle-array
    required: true
    description: |
      GPIO pin for hardware shutdown functionality.

  chain-length:
    type: int
    required: true
    description: |
      How many RGB LEDs are driven by the IC.

  gamma:
    type: array
    required: false
    default: [ 0, 0, 0, 0, 1, 1, 1, 1, 2, 2, 2, 2, 3, 3, 3, 3, 4, 4, 4, 4, 5, 5, 5, 5, 6, 6, 6, 6, 7, 7, 7, 7, 8, 8, 8, 8, 10, 10, 10, 10, 12, 12, 12, 12, 14, 14, 14, 14, 16, 16, 16, 16, 18, 18, 18, 18, 20, 20, 20, 20, 22, 22, 22, 22, 24, 24, 24, 24, 26, 26, 26, 26, 29, 29, 29, 29, 32, 32, 32, 32, 35, 35, 35, 35, 38, 38, 38, 38, 41, 41, 41, 41, 44, 44, 44, 44, 47, 47, 47, 47, 50, 50, 50, 50, 53, 53, 53, 53, 57, 57, 57, 57, 61, 61, 61, 61, 65, 65, 65, 65, 69, 69, 69, 69, 73, 73, 73, 73, 77, 77, 77, 77, 81, 81, 81, 81, 85, 85, 85, 85, 89, 89, 89, 89, 94, 94, 94, 94, 99, 99, 99, 99, 104, 104, 104, 104, 109, 109, 109, 109, 114, 114, 114, 114, 119, 119, 119, 119, 124, 124, 124, 124, 129, 129, 129, 129, 134, 134, 134, 134, 140, 140, 140, 140, 146, 146, 146, 146, 152, 152, 152, 152, 158, 158, 158, 158, 164, 164, 164, 164, 170, 170, 170, 170, 176, 176, 176, 176, 182, 182, 182, 182, 188, 188, 188, 188, 195, 195, 195, 195, 202, 202, 202, 202, 209, 209, 209, 209, 216, 216, 216, 216, 223, 223, 223, 223, 230, 230, 230, 230, 237, 237, 237, 237, 244, 244, 244, 244, 251, 251, 251, 251, 255, 255, 255, 255 ]
    description: |
      Gamma correction lookup values.
      The gamma values make the LED brightness seem more linear to human eyes.
      Default values match the recommendation from the IC datasheet but note this may
      or may not work for your particular LEDs.

  red-scaling:
    type: int
    required: false
    default: 255
    description: |
      Red channel scaling factor on a scale of 0-255.
      This setting adjusts the brightness of red pixels relative to other channels by scaling the amount
      of current flowing through them. 255 being equivalent to the value of led-max-current.

  green-scaling:
    type: int
    required: false
    default: 255
    description: |
      Green channel scaling factor on a scale of 0-255.
      This setting adjusts the brightness of green pixels relative to other channels by scaling the amount
      of current flowing through them. 255 being equivalent to the value of led-max-current.

  blue-scaling:
    type: int
    required: false
    default: 255
    description: |
      Blue channel scaling factor on a scale of 0-255.
      This setting adjusts the brightness of blue pixels relative to other channels by scaling the amount
      of current flowing through them. 255 being equivalent to the value of led-max-current.
```

## app/dts/bindings/led_strip/issi,is31fl3743a.yaml
```yaml
# Copyright (c) 2020, The ZMK Contributors
# SPDX-License-Identifier: MIT

description: ISSI IS31FL3743A LED Matrix driver

compatible: "issi,is31fl3743a"

include: i2c-device.yaml

properties:
  sw-setting:
    type: int
    required: false
    enum:
      - 0x00
      - 0x01
      - 0x02
      - 0x03
      - 0x04
      - 0x05
      - 0x06
      - 0x07
      - 0x08
      - 0x09
      - 0x0a
    default: 0x00
    description: |
      SW setting used to control the matrix size by turning off SWx pins
      as described in the datasheet.

  cs-order:
    type: uint8-array
    required: false
    default: [0x02, 0x01, 0x00, 0x05, 0x04, 0x03, 0x08, 0x07, 0x06, 0x0B, 0x0A, 0x09, 0x0E, 0x0D, 0x0C, 0x11, 0x10, 0x0F]
    description: |
      Stores the configuration of CS* pins.
      Each 3 consecutive numbers must be R, G and B pins for a single LED.
      Matches the reference design from the datasheet by default.

  riset:
    type: int
    required: true
    description: Riset resistor value in kiloohms.

  led-max-current:
    type: int
    required: true
    description: Maximum allowed LED current in mAh. The maximum allowed by the chip is 34.

  sync:
    type: int
    enum:
      - 0x00
      - 0x10
      - 0x11
    required: false
    default: 0x00
    description: |
      Controls the SYNC function. Set to 0x11 to set the device as main or 0x10 for secondary.

  sdb-gpios:
    type: phandle-array
    required: true
    description: |
      GPIO pin for hardware shutdown functionality.
```

## app/dts/bindings/macros/zmk,macro-control-mode-press.yaml
```yaml
# Copyright (c) 2022 The ZMK Contributors
# SPDX-License-Identifier: MIT

description: Set Macro To Press Mode

compatible: "zmk,macro-control-mode-press"

include: zero_param.yaml
```

## app/dts/bindings/macros/zmk,macro-control-mode-release.yaml
```yaml
# Copyright (c) 2022 The ZMK Contributors
# SPDX-License-Identifier: MIT

description: Set Macro To Release Mode

compatible: "zmk,macro-control-mode-release"

include: zero_param.yaml
```

## app/dts/bindings/macros/zmk,macro-control-mode-tap.yaml
```yaml
# Copyright (c) 2022 The ZMK Contributors
# SPDX-License-Identifier: MIT

description: Set Macro To Tap Mode

compatible: "zmk,macro-control-mode-tap"

include: zero_param.yaml
```

## app/dts/bindings/macros/zmk,macro-control-tap-time.yaml
```yaml
# Copyright (c) 2022 The ZMK Contributors
# SPDX-License-Identifier: MIT

description: Set Macro Tap Duration

compatible: "zmk,macro-control-tap-time"

include: one_param.yaml
```

## app/dts/bindings/macros/zmk,macro-control-wait-time.yaml
```yaml
# Copyright (c) 2022 The ZMK Contributors
# SPDX-License-Identifier: MIT

description: Set Macro Wait Duration

compatible: "zmk,macro-control-wait-time"

include: one_param.yaml
```

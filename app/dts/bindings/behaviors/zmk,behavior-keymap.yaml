## app/dts/bindings/behaviors/zmk,behavior-keymap.yaml
```yaml
# Copyright (c) 2020, Pete Johanson
# SPDX-License-Identifier: MIT

description: Keymap Behavior

compatible: "zmk,behavior-keymap"

include: zero_param.yaml
```

## app/dts/bindings/behaviors/zmk,behavior-last-device.yaml
```yaml
# Copyright (c) 2022 The ZMK Contributors
# SPDX-License-Identifier: MIT

description: Last Device Behavior

compatible: "zmk,behavior-last-device"

include: zero_param.yaml
```

## app/dts/bindings/behaviors/zmk,behavior-layer-lock.yaml
```yaml
# Copyright (c) 2025 The ZMK Contributors
# SPDX-License-Identifier: MIT

description: Layer Lock behavior

compatible: "zmk,behavior-layer-lock"

include: "zero_param.yaml"
```

## app/dts/bindings/behaviors/zmk,behavior-macro-one-param.yaml
```yaml
# Copyright (c) 2022 The ZMK Contributors
# SPDX-License-Identifier: MIT

description: Macro Behavior

compatible: "zmk,behavior-macro-one-param"

include: [one_param.yaml, macro_base.yaml]
```

## app/dts/bindings/behaviors/zmk,behavior-macro-two-param.yaml
```yaml
# Copyright (c) 2022 The ZMK Contributors
# SPDX-License-Identifier: MIT

description: Macro Behavior

compatible: "zmk,behavior-macro-two-param"

include: [two_param.yaml, macro_base.yaml]
```

## app/dts/bindings/behaviors/zmk,behavior-macro.yaml
```yaml
# Copyright (c) 2022 The ZMK Contributors
# SPDX-License-Identifier: MIT

description: Macro Behavior

compatible: "zmk,behavior-macro"

include: [zero_param.yaml, macro_base.yaml]
```

## app/dts/bindings/behaviors/zmk,behavior-midi-key-press.yaml
```yaml
# Copyright (c) 2024 The ZMK Contributors
# SPDX-License-Identifier: MIT

description: Midi key press/release behavior

compatible: "zmk,behavior-midi-key-press"

include: one_param.yaml
```

## app/dts/bindings/behaviors/zmk,behavior-mod-morph-param.yaml
```yaml
# Copyright (c) 2024 The ZMK Contributors
# SPDX-License-Identifier: MIT

description: Mod Morph Behavior

compatible: "zmk,behavior-mod-morph-param"

include: [two_param.yaml, mod_morph_base.yaml, binding_params.yaml]
```

## app/dts/bindings/behaviors/zmk,behavior-mod-morph.yaml
```yaml
# Copyright (c) 2020 The ZMK Contributors
# SPDX-License-Identifier: MIT

description: Mod Morph Behavior

compatible: "zmk,behavior-mod-morph"

include: [zero_param.yaml, mod_morph_base.yaml]
```

## app/dts/bindings/behaviors/zmk,behavior-mod-tap.yaml
```yaml
# Copyright (c) 2020, Pete Johanson
# SPDX-License-Identifier: MIT

description: Mod-Tap Beavhior

compatible: "zmk,behavior-mod-tap"

include: two_param.yaml
```

## app/dts/bindings/behaviors/zmk,behavior-momentary-layer-lock.yaml
```yaml
# Copyright (c) 2023 The ZMK Contributors
# SPDX-License-Identifier: MIT

description: Momentary layer on press/release behavior

compatible: "zmk,behavior-momentary-layer-lock"

include: zero_param.yaml

properties:
  bindings:
    type: phandle-array
    required: true
```

## app/dts/bindings/behaviors/zmk,behavior-momentary-layer.yaml
```yaml
# Copyright (c) 2020 The ZMK Contributors
# SPDX-License-Identifier: MIT

description: Momentary layer on press/release behavior

compatible: "zmk,behavior-momentary-layer"

include: one_param.yaml

properties:
  locking:
    type: boolean
    description: Whether to "lock" the layer active, preventing behaviors without the "locking" property from deactivating the layer
```

## app/dts/bindings/behaviors/zmk,behavior-mouse-key-press.yaml
```yaml
description: Mouse key press/release behavior

compatible: "zmk,behavior-mouse-key-press"

include: one_param.yaml
```

## app/dts/bindings/behaviors/zmk,behavior-mouse-move.yaml
```yaml
description: Mouse move

compatible: "zmk,behavior-mouse-move"

include: one_param.yaml

properties:
  delay-ms:
    type: int
  time-to-max-speed-ms:
    type: int
  acceleration-exponent:
    type: int
```

## app/dts/bindings/behaviors/zmk,behavior-mouse-scroll.yaml
```yaml
description: Mouse scroll

compatible: "zmk,behavior-mouse-scroll"

include: one_param.yaml

properties:
  delay-ms:
    type: int
  time-to-max-speed-ms:
    type: int
  acceleration-exponent:
    type: int
```

## app/dts/bindings/behaviors/zmk,behavior-mouse-setting.yaml
```yaml
description: Mouse Setting

compatible: "zmk,behavior-mouse-setting"

include: one_param.yaml
```

## app/dts/bindings/behaviors/zmk,behavior-mouse-speed.yaml
```yaml
# Copyright (c) 2024 The ZMK Contributors
# SPDX-License-Identifier: MIT

description: Mouse speed modifier behavior

compatible: "zmk,behavior-mouse-speed"

include: one_param.yaml

properties:
  target:
    type: phandle
    required: true
    description: The behavior-input-two-axis instance to apply the speed multiplier to.
```

## app/dts/bindings/behaviors/zmk,behavior-mouse-wheel.yaml
```yaml
description: Mouse wheel

compatible: "zmk,behavior-mouse-wheel"

include: one_param.yaml
```

## app/dts/bindings/behaviors/zmk,behavior-non-overlap.yaml
```yaml
# Copyright (c) 2024 The ZMK Contributors
# SPDX-License-Identifier: MIT

description: Non-overlap behavior

compatible: "zmk,behavior-non-overlap"

include: one_param.yaml

properties:
  bindings:
    type: phandles
    required: true
  keep-active-size:
    type: int
  no-active:
    type: boolean
```

## app/dts/bindings/behaviors/zmk,behavior-none.yaml
```yaml
# Copyright (c) 2020 The ZMK Contributors
# SPDX-License-Identifier: MIT

description: None Binding Behavior

compatible: "zmk,behavior-none"

include: zero_param.yaml
```

## app/dts/bindings/behaviors/zmk,behavior-one-shot.yaml
```yaml
# Copyright (c) 2020 The ZMK Contributors
# SPDX-License-Identifier: MIT

description: One Shot behavior

compatible: "zmk,behavior-one-shot"

include: one_param.yaml

properties:
  bindings:
    type: phandles
    required: true
  release-after-ms:
    type: int 
```

## app/dts/bindings/behaviors/zmk,behavior-outputs.yaml
```yaml
# Copyright (c) 2020 The ZMK Contributors
# SPDX-License-Identifier: MIT

description: Output Selection Behavior

compatible: "zmk,behavior-outputs"

include: one_param.yaml
```

## app/dts/bindings/behaviors/zmk,behavior-programmable-buttons.yaml
```yaml
# Copyright (c) 2020 The ZMK Contributors
# SPDX-License-Identifier: MIT

description: Programmable buttons press/release behavior

compatible: "zmk,behavior-programmable-buttons"

include: one_param.yaml
```

## app/dts/bindings/behaviors/zmk,behavior-reset.yaml
```yaml
# Copyright (c) 2020 The ZMK Contributors
# SPDX-License-Identifier: MIT

description: Keyboard Reset Behavior

compatible: "zmk,behavior-reset"

include: zero_param.yaml

properties:
  type:
    type: int
    default: 0
```

## app/dts/bindings/behaviors/zmk,behavior-retro-hold-tap.yaml
```yaml
# Copyright (c) 2022 The ZMK Contributors
# SPDX-License-Identifier: MIT

description: Retro-Hold-Tap Behavior

compatible: "zmk,behavior-retro-hold-tap"

include: zero_param.yaml

properties:
  bindings:
    type: phandle-array
    required: true
  tapping-term-ms:
    type: int
    default: 200
  quick-tap-ms:
    type: int
    default: -1
  quick_tap_ms: # deprecated
    type: int
  global-quick-tap:
    type: boolean
  flavor:
    type: string
    required: false
    default: "balanced"
    enum:
      - "hold-preferred"
      - "balanced"
      - "tap-preferred"
      - "tap-unless-interrupted"
  hold-trigger-key-positions:
    type: array
    required: false
    default: []
```

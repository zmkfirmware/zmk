## app/dts/bindings/behaviors/zero_param.yaml
```yaml
# Copyright (c) 2020 The ZMK Contributors
# SPDX-License-Identifier: MIT

properties:
  label:
    type: string
    required: false
    deprecated: true
  "#binding-cells":
    type: int
    required: true
    const: 0
```

## app/dts/bindings/behaviors/zmk,behavior-animation.yaml
```yaml
# Copyright (c) 2020 The ZMK Contributors
# SPDX-License-Identifier: MIT

description: Animation Action

compatible: "zmk,behavior-animation"

include: one_param.yaml
```

## app/dts/bindings/behaviors/zmk,behavior-antecedent-morph.yaml
```yaml
# Copyright (c) 2023 The ZMK Contributors
# SPDX-License-Identifier: MIT

description: Antecedent Morph Behavior

compatible: "zmk,behavior-antecedent-morph"

include: zero_param.yaml

properties:
  defaults:
    type: phandle-array
    required: true
    specifier-space: binding
  bindings:
    type: phandle-array
    required: true
  antecedents:
    type: array
    required: true
  max-delay-ms:
    type: int
    default: -1
```

## app/dts/bindings/behaviors/zmk,behavior-array.yaml
```yaml
# Copyright (c) 2025 The ZMK Contributors
# SPDX-License-Identifier: MIT

description: Array of Behaviors

compatible: "zmk,behavior-array"

include: one_param.yaml

properties:
  bindings:
    type: phandle-array
    required: true
```

## app/dts/bindings/behaviors/zmk,behavior-backlight.yaml
```yaml
# Copyright (c) 2021 The ZMK Contributors
# SPDX-License-Identifier: MIT

description: Backlight behavior

compatible: "zmk,behavior-backlight"

include: one_param.yaml
```

## app/dts/bindings/behaviors/zmk,behavior-base-layer.yaml
```yaml
# Copyright (c) 2025 The ZMK Contributors
# SPDX-License-Identifier: MIT

description: Base Layer

compatible: "zmk,behavior-base-layer"

include: one_param.yaml

properties:
  base-layers:
    type: array
    required: false
    default: []
```

## app/dts/bindings/behaviors/zmk,behavior-bluetooth.yaml
```yaml
# Copyright (c) 2020 The ZMK Contributors
# SPDX-License-Identifier: MIT

description: Bluetooth Behavior

compatible: "zmk,behavior-bluetooth"

include: two_param.yaml
```

## app/dts/bindings/behaviors/zmk,behavior-caps-word.yaml
```yaml
# Copyright (c) 2021 The ZMK Contributors
# SPDX-License-Identifier: MIT

description: Caps word behavior

compatible: "zmk,behavior-caps-word"

include: zero_param.yaml

properties:
  continue-list:
    type: array
    required: true
    description: |
      List of key codes which should continue the caps word behavior but not have
      modifiers applied when caps word is active.
      Alphanumeric keys are included automatically unless no-default-keys is set.
  shift-list:
    type: array
    description: |
      List of key codes which should have modifiers applied when caps word is active.
      Alpha keys are included automatically unless no-default-keys is set.
  mods:
    type: int
    description: Bitmask of modifiers to apply. Default is MOD_LSFT.
  no-default-keys:
    type: boolean
    description: Do not automatically include any keys in continue-list or shift-list.
```

## app/dts/bindings/behaviors/zmk,behavior-capslock.yaml
```yaml
# Copyright (c) 2023 The ZMK Contributors
# SPDX-License-Identifier: MIT

description: Caps word behavior

compatible: "zmk,behavior-capslock"

include: zero_param.yaml

properties:
  enable-on-press:
    type: boolean
  disable-on-release:
    type: boolean
  disable-on-next-release:
    type: boolean
  disable-on-keys:
    type: array
    required: false
    default: []
  enable-while-keys:
    type: array
    required: false
    default: []
  capslock-press-keycode:
    type: int
    default: 0 # will default to `CAPSLOCK`
  capslock-press-duration:
    type: int
    default: 95 # seems to be the shortest reliable delay on Mac
```

## app/dts/bindings/behaviors/zmk,behavior-combo-trigger.yaml
```yaml
# Copyright (c) 2025 The ZMK Contributors
# SPDX-License-Identifier: MIT

description: Combo Trigger

compatible: "zmk,behavior-combo-trigger"

include: two_param.yaml

properties:
  fallback-behavior:
    type: phandle
    required: true
```

## app/dts/bindings/behaviors/zmk,behavior-custom-lock.yaml
```yaml
# Copyright (c) 2022 The ZMK Contributors
# SPDX-License-Identifier: MIT

description: Custom lock behavior variable definition

compatible: "zmk,behavior-custom-lock"

include: zero_param.yaml

child-binding:
  description: Key definitions for lock variable

  include: two_param.yaml
  
  properties:
    bindings:
      type: phandles
      required: true
```

## app/dts/bindings/behaviors/zmk,behavior-default-layer.yaml
```yaml
# Copyright (c) 2024 The ZMK Contributors
# SPDX-License-Identifier: MIT

description: Behavior to change default layer for current endpoint

compatible: "zmk,behavior-default-layer"

include: one_param.yaml
```

## app/dts/bindings/behaviors/zmk,behavior-dynamic-macro.yaml
```yaml
# Copyright (c) 2022 The ZMK Contributors
# SPDX-License-Identifier: MIT

description: Dynamic Macro Behavior

compatible: "zmk,behavior-dynamic-macro"

include: one_param.yaml

properties:
  wait-ms:
    type: int
    default: -1
    description: The default time to wait (in milliseconds) before triggering the next behavior in the macro bindings list.
  no-output:
    type: boolean
```

## app/dts/bindings/behaviors/zmk,behavior-dynamic-nkro.yaml
```yaml
# Copyright (c) 2025 The ZMK Contributors
# SPDX-License-Identifier: MIT

description: |
  Switches the active USB/BLE HID keyboard report mode between full NKRO and
  "boot keyboard" compatible HKRO (see CONFIG_ZMK_HID_REPORT_TYPE_DYNAMIC). The
  chosen mode is persisted to flash and only takes effect after the reboot
  this behavior triggers, since the report descriptor can't change without a
  full HID re-enumeration.

compatible: "zmk,behavior-dynamic-nkro"

include: one_param.yaml
```

## app/dts/bindings/behaviors/zmk,behavior-endpoints.yaml
```yaml
#
# Copyright (c) 2020, The ZMK Contributors
# SPDX-License-Identifier: MIT
#

description: Endpoints Behavior

compatible: "zmk,behavior-endpoints"

include: one_param.yaml
```

## app/dts/bindings/behaviors/zmk,behavior-ext-power.yaml
```yaml
# Copyright (c) 2020 The ZMK Contributors
# SPDX-License-Identifier: MIT

description: External power control Behavior

compatible: "zmk,behavior-ext-power"

include: one_param.yaml

properties:
  power-domain:
    required: false
    type: phandle
    description: |

      Power domain the behavior should execute the action on.
```

## app/dts/bindings/behaviors/zmk,behavior-hid.yaml
```yaml
# Copyright (c) 2020, Pete Johanson
# SPDX-License-Identifier: MIT

description: HID Report Behavior

compatible: "zmk,behavior-hid"

include: zero_param.yaml
```

## app/dts/bindings/behaviors/zmk,behavior-hold-single-double.yaml
```yaml
# Copyright (c) 2025 The ZMK Contributors
# SPDX-License-Identifier: MIT

description: Hold / Single / Double behavior

compatible: "zmk,behavior-hold-single-double"

include: zero_param.yaml

properties:
  bindings:
    type: phandle-array
    required: true
  tapping-term-ms:
    type: int
    default: 200
```

## app/dts/bindings/behaviors/zmk,behavior-hold-tap.yaml
```yaml
# Copyright (c) 2020 The ZMK Contributors
# SPDX-License-Identifier: MIT

description: Hold or Tap behavior

compatible: "zmk,behavior-hold-tap"

include: two_param.yaml

properties:
  bindings:
    type: phandles
    required: true
  tapping-term-ms:
    type: int
  tapping_term_ms:
    type: int
    deprecated: true
  quick-tap-ms:
    type: int
    default: -1
  quick_tap_ms:
    type: int
    deprecated: true
  global-quick-tap:
    type: boolean
    deprecated: true
  require-prior-idle-ms:
    type: int
    default: -1
  flavor:
    type: string
    required: false
    default: "hold-preferred"
    enum:
      - "hold-preferred"
      - "balanced"
      - "tap-preferred"
      - "tap-unless-interrupted"
  hold-while-undecided:
    type: boolean
  hold-while-undecided-linger:
    type: boolean
  retro-tap:
    type: boolean
  hold-trigger-key-positions:
    type: array
    required: false
    default: []
  hold-trigger-on-release:
    type: boolean
```

## app/dts/bindings/behaviors/zmk,behavior-indicators.yaml
```yaml
description: Indicators Behavior

compatible: "zmk,behavior-indicators"

include: one_param.yaml
```

## app/dts/bindings/behaviors/zmk,behavior-input-two-axis.yaml
```yaml
description: Two axis input behavior

compatible: "zmk,behavior-input-two-axis"

include: one_param.yaml

properties:
  x-input-code:
    type: int
    required: true
  y-input-code:
    type: int
    required: true
  trigger-period-ms:
    type: int
    default: 16
    description: The time (in ms) between generated inputs when an input has non-zero speed.
  delay-ms:
    type: int
  time-to-max-speed-ms:
    type: int
    required: true
  acceleration-exponent:
    type: int
    default: 1
```

## app/dts/bindings/behaviors/zmk,behavior-key-press.yaml
```yaml
# Copyright (c) 2020 The ZMK Contributors
# SPDX-License-Identifier: MIT

description: Key press/release behavior

compatible: "zmk,behavior-key-press"

include: one_param.yaml
```

## app/dts/bindings/behaviors/zmk,behavior-key-repeat.yaml
```yaml
# Copyright (c) 2021 The ZMK Contributors
# SPDX-License-Identifier: MIT

description: Key repeat behavior

compatible: "zmk,behavior-key-repeat"

include: zero_param.yaml

properties:
  usage-pages:
    type: array
    required: true
```

## app/dts/bindings/behaviors/zmk,behavior-key-tap.yaml
```yaml
# Copyright (c) 2022 The ZMK Contributors
# SPDX-License-Identifier: MIT

description: Key press/immediate release behavior

compatible: "zmk,behavior-key-tap"

include: one_param.yaml
```

## app/dts/bindings/behaviors/zmk,behavior-key-toggle.yaml
```yaml
# Copyright (c) 2022 The ZMK Contributors
# SPDX-License-Identifier: MIT

description: Key toggle behavior

compatible: "zmk,behavior-key-toggle"

include: one_param.yaml

properties:
  toggle-mode:
    type: string
    required: false
    default: "flip"
    enum:
      - "on"
      - "off"
      - "flip"
```
